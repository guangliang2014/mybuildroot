## fullsys/configs/my_qemu_x86_64_defconfig
```kconfig
BR2_x86_64=y
BR2_PACKAGE_HOST_LINUX_HEADERS_CUSTOM_6_12=y
BR2_PACKAGE_GLIBC_UTILS=y
BR2_GCC_VERSION_14_X=y
BR2_TOOLCHAIN_BUILDROOT_CXX=y
BR2_PACKAGE_HOST_GDB=y
BR2_PACKAGE_HOST_GDB_TUI=y
BR2_PACKAGE_HOST_GDB_PYTHON3=y
BR2_PACKAGE_HOST_GDB_SIM=y
BR2_GDB_VERSION_14=y
BR2_WGET="wget --passive-ftp -nd -t 3"
BR2_SVN="svn --non-interactive"
BR2_SCP="scp"
BR2_SFTP="sftp"
BR2_DL_DIR="$(TOPDIR)/../../dl"
BR2_BACKUP_SITE="http://sources.buildroot.net"
BR2_GNU_MIRROR="http://ftpmirror.gnu.org"
BR2_CPAN_MIRROR="http://cpan.metacpan.org"
BR2_JLEVEL=16
BR2_CCACHE=y
BR2_CCACHE_DIR="$(TOPDIR)/../../ccache"
BR2_ENABLE_DEBUG=y
BR2_DEBUG_3=y
BR2_ENABLE_RUNTIME_DEBUG=y
BR2_OPTIMIZE_G=y
BR2_PACKAGE_OVERRIDE_FILE="$(BR2_EXTERNAL_MY_PATH)/local.mk"
BR2_ROOTFS_DEVICE_CREATION_DYNAMIC_EUDEV=y
BR2_TARGET_GENERIC_ROOT_PASSWD="123"
BR2_SYSTEM_DHCP="eth0"
BR2_ROOTFS_POST_BUILD_SCRIPT="board/qemu/x86_64/post-build.sh"
BR2_ROOTFS_POST_IMAGE_SCRIPT="$(BR2_EXTERNAL_MY_PATH)/board/ext_board/post-image.sh"
BR2_ROOTFS_POST_SCRIPT_ARGS="$(BR2_DEFCONFIG)"
BR2_LINUX_KERNEL=y
BR2_LINUX_KERNEL_CUSTOM_VERSION=y
BR2_LINUX_KERNEL_CUSTOM_VERSION_VALUE="6.12.9"
BR2_LINUX_KERNEL_USE_CUSTOM_CONFIG=y
BR2_LINUX_KERNEL_CUSTOM_CONFIG_FILE="$(BR2_EXTERNAL_MY_PATH)/board/ext_board/linux.config"
BR2_LINUX_KERNEL_INSTALL_TARGET=y
BR2_LINUX_KERNEL_NEEDS_HOST_LIBELF=y
BR2_PACKAGE_LINUX_TOOLS_PCI=y
BR2_PACKAGE_BUSYBOX_SHOW_OTHERS=y
BR2_PACKAGE_BLKTRACE=y
BR2_PACKAGE_CACHE_CALIBRATOR=y
BR2_PACKAGE_FIO=y
BR2_PACKAGE_GDB=y
BR2_PACKAGE_GDB_SERVER=y
BR2_PACKAGE_GDB_DEBUGGER=y
BR2_PACKAGE_GDB_TUI=y
BR2_PACKAGE_LIBBPF=y
BR2_PACKAGE_LSOF=y
BR2_PACKAGE_LTRACE=y
BR2_PACKAGE_STRACE=y
BR2_PACKAGE_TRACE_CMD=y
BR2_PACKAGE_UFTRACE=y
BR2_PACKAGE_BINUTILS=y
BR2_PACKAGE_BINUTILS_TARGET=y
BR2_PACKAGE_BITWISE=y
BR2_PACKAGE_CHECK=y
BR2_PACKAGE_SDL=y
BR2_PACKAGE_SDL_TTF=y
BR2_PACKAGE_SDL2_TTF=y
BR2_PACKAGE_AER_INJECT=y
BR2_PACKAGE_LIBUIO=y
BR2_PACKAGE_LSSCSI=y
BR2_PACKAGE_LSUIO=y
BR2_PACKAGE_NVME=y
BR2_PACKAGE_PCIUTILS=y
BR2_PACKAGE_LIBOPENSSL_ENGINES=y
BR2_PACKAGE_LIBSYSFS=y
BR2_PACKAGE_CPUINFO=y
BR2_PACKAGE_SKALIBS=y
BR2_PACKAGE_PCRE=y
BR2_PACKAGE_PCRE_UCP=y
BR2_PACKAGE_QEMU=y
BR2_PACKAGE_QEMU_SYSTEM=y
BR2_PACKAGE_QEMU_SLIRP=y
BR2_PACKAGE_QEMU_SDL=y
BR2_PACKAGE_QEMU_TRACING=y
BR2_PACKAGE_QEMU_CHOOSE_TARGETS=y
BR2_PACKAGE_QEMU_TARGET_AARCH64=y
BR2_PACKAGE_QEMU_TARGET_ARM=y
BR2_PACKAGE_QEMU_TARGET_RISCV32=y
BR2_PACKAGE_QEMU_TARGET_RISCV64=y
BR2_PACKAGE_QEMU_TARGET_X86_64=y
BR2_PACKAGE_QEMU_TOOLS=y
BR2_PACKAGE_QEMU_GUEST_AGENT=y
BR2_PACKAGE_IFUPDOWN=y
BR2_PACKAGE_OPENSSH=y
BR2_PACKAGE_BASH=y
BR2_PACKAGE_BASH_COMPLETION=y
BR2_PACKAGE_FILE=y
BR2_PACKAGE_SUDO=y
BR2_PACKAGE_TIME=y
BR2_PACKAGE_START_STOP_DAEMON=y
BR2_PACKAGE_SYSKLOGD=y
BR2_PACKAGE_SYSKLOGD_LOGGER=y
BR2_PACKAGE_SYSLOG_NG=y
BR2_PACKAGE_TAR=y
BR2_PACKAGE_UTIL_LINUX_LIBFDISK=y
BR2_PACKAGE_UTIL_LINUX_KILL=y
BR2_PACKAGE_UTIL_LINUX_LAST=y
BR2_PACKAGE_UTIL_LINUX_LOSETUP=y
BR2_PACKAGE_UTIL_LINUX_LSFD=y
BR2_PACKAGE_UTIL_LINUX_MORE=y
BR2_PACKAGE_UTIL_LINUX_MOUNT=y
BR2_PACKAGE_UTIL_LINUX_SU=y
BR2_TARGET_ROOTFS_EXT2=y
BR2_TARGET_ROOTFS_EXT2_SIZE="600M"
# BR2_TARGET_ROOTFS_TAR is not set
BR2_PACKAGE_HOST_DOS2UNIX=y
BR2_PACKAGE_HOST_DTC=y
BR2_PACKAGE_HOST_QEMU=y
BR2_PACKAGE_HOST_QEMU_SYSTEM_MODE=y
BR2_PACKAGE_HOST_QEMU_VIRTFS=y
BR2_PACKAGE_HOST_RISCV_ISA_SIM=y
```

## kitos/Config.in
```kconfig
config BR2_EXTERNAL_KITOS
    bool "Enable Kitos external"
    help
      Enable the Kitos external tree.

source "$BR2_EXTERNAL_KITOS_PATH/package/edu-test/Config.in"
```

## kitos/package/edu-test/Config.in
```kconfig
config BR2_PACKAGE_EDU_TEST
	bool "edu-test: install EDU test program into rootfs"
	depends on BR2_TOOLCHAIN_BUILDROOT_C99
	help
	  Small user-space test program for the EDU device. When enabled,
	  the test program will be built and installed to /usr/bin in the
	  target root filesystem.
```

## minisys/package/revere-demo/Config.in
```kconfig
config BR2_PACKAGE_REVEREDEMO
	bool "demo for vfio"
	help
	  Add support to STM32MP1 Firmware examples for the CM4 of the DKx.
	  Install the examples to the /usr/lib/Cube-M4-examples folder.
```

## pcie/configs/pcie_qemu_x86_64_defconfig
```kconfig
BR2_x86_64=y
BR2_PACKAGE_HOST_LINUX_HEADERS_CUSTOM_6_12=y
BR2_PACKAGE_GLIBC_UTILS=y
BR2_GCC_VERSION_14_X=y
BR2_TOOLCHAIN_BUILDROOT_CXX=y
BR2_PACKAGE_HOST_GDB=y
BR2_PACKAGE_HOST_GDB_TUI=y
BR2_PACKAGE_HOST_GDB_PYTHON3=y
BR2_PACKAGE_HOST_GDB_SIM=y
BR2_GDB_VERSION_14=y
BR2_WGET="wget --passive-ftp -nd -t 3"
BR2_SVN="svn --non-interactive"
BR2_SCP="scp"
BR2_SFTP="sftp"
BR2_DL_DIR="$(TOPDIR)/../../dl"
BR2_BACKUP_SITE="http://sources.buildroot.net"
BR2_GNU_MIRROR="http://ftpmirror.gnu.org"
BR2_CPAN_MIRROR="http://cpan.metacpan.org"
BR2_JLEVEL=16
BR2_CCACHE=y
BR2_CCACHE_DIR="$(TOPDIR)/../../ccache"
BR2_ENABLE_DEBUG=y
BR2_DEBUG_3=y
BR2_ENABLE_RUNTIME_DEBUG=y
BR2_OPTIMIZE_G=y
BR2_PACKAGE_OVERRIDE_FILE="$(BR2_EXTERNAL_PCIE_PATH)/local.mk"
BR2_ROOTFS_DEVICE_CREATION_DYNAMIC_EUDEV=y
BR2_SYSTEM_DHCP="eth0"
BR2_ROOTFS_POST_BUILD_SCRIPT="board/qemu/x86_64/post-build.sh"
BR2_ROOTFS_POST_IMAGE_SCRIPT="$(BR2_EXTERNAL_PCIE_PATH)/board/board_ext/post-image.sh"
BR2_ROOTFS_POST_SCRIPT_ARGS="$(BR2_DEFCONFIG)"
BR2_LINUX_KERNEL=y
BR2_LINUX_KERNEL_CUSTOM_VERSION=y
BR2_LINUX_KERNEL_CUSTOM_VERSION_VALUE="6.12.9"
BR2_LINUX_KERNEL_USE_CUSTOM_CONFIG=y
BR2_LINUX_KERNEL_CUSTOM_CONFIG_FILE="$(BR2_EXTERNAL_PCIE_PATH)/board/board_ext/linux.config"
BR2_LINUX_KERNEL_INSTALL_TARGET=y
BR2_LINUX_KERNEL_NEEDS_HOST_LIBELF=y
BR2_PACKAGE_LINUX_TOOLS_PCI=y
BR2_PACKAGE_BUSYBOX_SHOW_OTHERS=y
BR2_PACKAGE_BLKTRACE=y
BR2_PACKAGE_CACHE_CALIBRATOR=y
BR2_PACKAGE_FIO=y
BR2_PACKAGE_LIBBPF=y
BR2_PACKAGE_LSOF=y
BR2_PACKAGE_LTRACE=y
BR2_PACKAGE_STRACE=y
BR2_PACKAGE_TRACE_CMD=y
BR2_PACKAGE_UFTRACE=y
BR2_PACKAGE_BINUTILS=y
BR2_PACKAGE_BINUTILS_TARGET=y
BR2_PACKAGE_BITWISE=y
BR2_PACKAGE_CHECK=y
BR2_PACKAGE_LIBUIO=y
BR2_PACKAGE_LSSCSI=y
BR2_PACKAGE_LSUIO=y
BR2_PACKAGE_NVME=y
BR2_PACKAGE_PCIUTILS=y
BR2_PACKAGE_OPENSSL=y
BR2_PACKAGE_LIBOPENSSL_ENGINES=y
BR2_PACKAGE_LIBSYSFS=y
BR2_PACKAGE_FREETYPE=y
BR2_PACKAGE_PIXMAN=y
BR2_PACKAGE_CPUINFO=y
BR2_PACKAGE_DTC=y
BR2_PACKAGE_JSON_C=y
BR2_PACKAGE_SLIRP=y
BR2_PACKAGE_MPFR=y
BR2_PACKAGE_SKALIBS=y
BR2_PACKAGE_PCRE=y
BR2_PACKAGE_PCRE_UCP=y
BR2_PACKAGE_IFUPDOWN=y
BR2_PACKAGE_BASH=y
BR2_PACKAGE_FILE=y
BR2_PACKAGE_TIME=y
BR2_PACKAGE_TAR=y
BR2_PACKAGE_UTIL_LINUX_LIBFDISK=y
BR2_PACKAGE_UTIL_LINUX_KILL=y
BR2_PACKAGE_UTIL_LINUX_LAST=y
BR2_PACKAGE_UTIL_LINUX_LOSETUP=y
BR2_PACKAGE_UTIL_LINUX_LSFD=y
BR2_PACKAGE_UTIL_LINUX_MORE=y
BR2_PACKAGE_UTIL_LINUX_MOUNT=y
BR2_PACKAGE_UTIL_LINUX_SU=y
BR2_TARGET_ROOTFS_EXT2=y
BR2_TARGET_ROOTFS_EXT2_SIZE="100M"
# BR2_TARGET_ROOTFS_TAR is not set
BR2_PACKAGE_HOST_MKPASSWD=y
BR2_PACKAGE_HOST_QEMU=y
BR2_PACKAGE_HOST_QEMU_SYSTEM_MODE=y

BR2_PACKAGE_EDU_TEST=y
```
