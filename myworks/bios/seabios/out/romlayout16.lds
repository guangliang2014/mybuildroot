
/* DO NOT EDIT!  This is an autogenerated file.  See scripts/layoutrom.py. */
OUTPUT_FORMAT("elf32-i386")
OUTPUT_ARCH("i386")
SECTIONS
{
Call16Data = 0xff9c ;
ExtraStack = 0xf798 ;
sercon_split = 0xf752 ;
rx_bytes = 0xf739 ;
rx_buf = 0xf73c ;
DebugOutputPort = 0x4f34 ;
cdemu_drive_gf = 0x4f88 ;
CDEmu = 0xf76c ;
RTCusers = 0xf730 ;
FloppyDOR = 0xf720 ;
FloppyCount = 0x5060 ;
diskette_param_table2 = 0x4f1c ;
TimerPort = 0x4f38 ;
ShiftTSC = 0x4f36 ;
TimerLast = 0xf734 ;
TimerKHz = 0x4f3c ;
sercon_row_last = 0xf74e ;
DefaultDPTE = 0xf780 ;
StackPos = 0xf790 ;
HaveSmmCall32 = 0x5074 ;
_cfunc32flat_xhci_poll_intr = 0xece45 ;
_cfunc32flat_call32_params_helper = 0xeb3bc ;
_cfunc16__farcall16 = 0x71b8 ;
CDRom_locks = 0xf758 ;
_cfunc16_check_irqs = 0x79a9 ;
sercon_port = 0xf754 ;
sercon_attr_last = 0xf750 ;
sercon_char = 0xf74d ;
sercon_attr = 0xf74c ;
sercon_col_last = 0xf74f ;
reply_msg = 0xf71c ;
Ps2ctr = 0xf72c ;
keyboard_pipe = 0x4f30 ;
mouse_pipe = 0x4f2c ;
FloppyInfo = 0x4ec0 ;
_cfunc32flat_process_op_32 = 0xeb3cc ;
emulated_drive_gf = 0xf768 ;
bounce_buf_fl = 0x4f8c ;
IDMap = 0x4fa0 ;
_cfunc16_wait_irq = 0xa8a5 ;
acpi_pm1a_cnt = 0x4484 ;
_cfunc16_invoke_mouse_handler = 0xabf6 ;
VGAHookHandlerType = 0x4f5c ;
ViaFBsize = 0x4f58 ;
ViaRamSpeed = 0x4f54 ;
IntelDisplayType = 0x4f52 ;
IntelDisplayId = 0x4f51 ;
SmiBootDisplay = 0x4f50 ;
HaveRunPost = 0x50c8 ;
pmode_IDT_info = 0x50b8 ;
rmode_IDT_info = 0x50c0 ;
LegacyRamSize = 0x44a0 ;
BIOS_CONFIG_TABLE = 0xe6f5 ;
e820_count = 0x44a4 ;
e820_list = 0x44c0 ;
sercon_enable = 0xf751 ;
_cfunc32flat_tpm_interrupt_handler32 = 0xecb35 ;
Century = 0xf738 ;
LastUSBkey = 0xf724 ;
CanPreempt = 0x5064 ;
MainThread = 0x5068 ;
_cfunc32flat_yield_preempt = 0xdf465 ;
_cfunc32flat_handle_resume32 = 0xec66d ;
MaxPCIBus = 0x448c ;
PirAddr = 0x4488 ;
rombios32_gdt_48 = 0x5078 ;
_cfunc32flat_handle_smi = 0xeced4 ;
SMPLock = 0xf398c ;
SMPStack = 0xf3988 ;
_cfunc32flat_handle_smp = 0xed147 ;
_cfunc32flat_handle_pmm = 0xe4c32 ;
_cfunc32seg_handle_apm = 0x5953 ;
_cfunc32seg_handle_pcibios = 0x55df ;
sercon_real_vga_handler = 0x4f84 ;
_cfunc32flat_handle_19 = 0xecb0b ;
_cfunc32flat_handle_18 = 0xecadf ;
_cfunc32flat_handle_post = 0xec9fa ;

    zonelow_base = 0xd6000 ;
    _zonelow_seg = 0xd600 ;

.text.set_a20 0x5c00 : { *(.text.set_a20) }
.text.set_code_success 0xec4d : { *(.text.set_code_success) }
.text.pic_eoi2 0x5c20 : { *(.text.pic_eoi2) }
.text.call32_prep 0x5c28 : { *(.text.call32_prep) }
.text.need_hop_back 0x5cc1 : { *(.text.need_hop_back) }
.text.enqueue_key 0x5ce6 : { *(.text.enqueue_key) }
.text.kbd_set_flag 0x5d3f : { *(.text.kbd_set_flag) }
.text.cursor_pos_row 0x5d9c : { *(.text.cursor_pos_row) }
.text.sercon_cursor_pos_set 0xe6ff : { *(.text.sercon_cursor_pos_set) }
.text.shiftbuf 0x5dae : { *(.text.shiftbuf) }
.text.irqtimer_check 0x5df4 : { *(.text.irqtimer_check) }
.text.qemu_debug_putc 0x5e2d : { *(.text.qemu_debug_putc) }
.text.ehci_reset_pipe 0x5e39 : { *(.text.ehci_reset_pipe) }
.text.lba2chs 0x5e7c : { *(.text.lba2chs) }
.text.getLCHS 0x5ec3 : { *(.text.getLCHS) }
.text.clear_usertimer 0x5f6d : { *(.text.clear_usertimer) }
.text.putsinglehex.constprop.0 0x5fae : { *(.text.putsinglehex.constprop.0) }
.text.puthex.constprop.0 0x5fcf : { *(.text.puthex.constprop.0) }
.text.call32_post 0x609b : { *(.text.call32_post) }
.text.default_process_op.isra.0 0x613e : { *(.text.default_process_op.isra.0) }
.text.memset.isra.0 0x615e : { *(.text.memset.isra.0) }
.text.scsi_fill_cmd 0x616d : { *(.text.scsi_fill_cmd) }
.text.floppy_dor_mask 0x61db : { *(.text.floppy_dor_mask) }
.text.pci_next 0xff5d : { *(.text.pci_next) }
.text.putuint.constprop.0 0x61fe : { *(.text.putuint.constprop.0) }
.text.bvprintf.constprop.0 0xe411 : { *(.text.bvprintf.constprop.0) }
.text.panic.constprop.0 0xe2ad : { *(.text.panic.constprop.0) }
.text.__dprintf 0x6255 : { *(.text.__dprintf) }
.text.dump_regs 0x6269 : { *(.text.dump_regs) }
.text.__debug_enter 0x6300 : { *(.text.__debug_enter) }
.text.__warn_invalid 0x6322 : { *(.text.__warn_invalid) }
.text.__set_invalid 0x6348 : { *(.text.__set_invalid) }
.text.getComAddr 0x635c : { *(.text.getComAddr) }
.text.getLptAddr 0x63ac : { *(.text.getLptAddr) }
.text.__set_code_invalid 0x63fd : { *(.text.__set_code_invalid) }
.text.__disk_ret 0x6423 : { *(.text.__disk_ret) }
.text.disk_1308 0x6450 : { *(.text.disk_1308) }
.text.disk_1315 0xef60 : { *(.text.disk_1315) }
.text.__warn_unimplemented 0x6588 : { *(.text.__warn_unimplemented) }
.text.__set_code_unimplemented 0x65ae : { *(.text.__set_code_unimplemented) }
.text.__disk_ret_unimplemented 0xef2f : { *(.text.__disk_ret_unimplemented) }
.text.__disk_stub 0x65d4 : { *(.text.__disk_stub) }
.text.__warn_timeout 0x6609 : { *(.text.__warn_timeout) }
.text.floppy_disable_controller 0x661f : { *(.text.floppy_disable_controller) }
.text.rtc_setup 0xfe7e : { *(.text.rtc_setup) }
.text.set_usertimer 0x6639 : { *(.text.set_usertimer) }
.text.timer_read 0x66b2 : { *(.text.timer_read) }
.text.timer_calc 0x674f : { *(.text.timer_calc) }
.text.timer_calc_usec 0x676b : { *(.text.timer_calc_usec) }
.text.timer_check 0xf825 : { *(.text.timer_check) }
.text.udelay 0x679b : { *(.text.udelay) }
.text.i8042_wait_write 0x67bc : { *(.text.i8042_wait_write) }
.text.i8042_command 0x680d : { *(.text.i8042_command) }
.text.sercon_lazy_lf 0x6886 : { *(.text.sercon_lazy_lf) }
.text.fill_generic_edd 0x68d6 : { *(.text.fill_generic_edd) }
.text.fill_edd 0xe079 : { *(.text.fill_edd) }
.text.__stack_hop_back.isra.0 0x6c36 : { *(.text.__stack_hop_back.isra.0) }
.text.handle_12 0x6c92 : { *(.text.handle_12) }
.text.handle_11 0x6cb7 : { *(.text.handle_11) }
.text.handle_05 0x6cdc : { *(.text.handle_05) }
.text.handle_02 0x6ce5 : { *(.text.handle_02) }
.text.call16_helper 0x6d0a : { *(.text.call16_helper) }
.text.__call32 0x6d4a : { *(.text.__call32) }
.text.__call32_params.constprop.0 0x6e0e : { *(.text.__call32_params.constprop.0) }
.text.usb_poll_intr 0x6e55 : { *(.text.usb_poll_intr) }
.text._farcall16 0x71b8 : { *(.text._farcall16) }
.text.__call16_int 0x7203 : { *(.text.__call16_int) }
.text.handle_75 0x7216 : { *(.text.handle_75) }
.text.process_key 0x7282 : { *(.text.process_key) }
.text.prockeys 0x7664 : { *(.text.prockeys) }
.text.procmodkey 0x76db : { *(.text.procmodkey) }
.text.procscankey 0x772c : { *(.text.procscankey) }
.text.ramdisk_copy 0x7752 : { *(.text.ramdisk_copy) }
.text.disk_1346.isra.0 0x78ef : { *(.text.disk_1346.isra.0) }
.text.check_irqs 0x79a9 : { *(.text.check_irqs) }
.text.sercon_putchar 0xefdb : { *(.text.sercon_putchar) }
.text.sercon_term_clear_screen 0x79cb : { *(.text.sercon_term_clear_screen) }
.text.sercon_print_utf8 0x79f8 : { *(.text.sercon_print_utf8) }
.text.sercon_term_cursor_goto 0x7a61 : { *(.text.sercon_term_cursor_goto) }
.text.sercon_set_attr 0x7b00 : { *(.text.sercon_set_attr) }
.text.sercon_lazy_flush 0xe2e8 : { *(.text.sercon_lazy_flush) }
.text.sercon_lazy_putchar 0x7bf5 : { *(.text.sercon_lazy_putchar) }
.text.timer_sleep 0xf046 : { *(.text.timer_sleep) }
.text.usleep 0x7caa : { *(.text.usleep) }
.text.lsi_scsi_process_op 0x7cb3 : { *(.text.lsi_scsi_process_op) }
.text.esp_scsi_process_op 0xf869 : { *(.text.esp_scsi_process_op) }
.text.mpt_scsi_process_op 0x7ed0 : { *(.text.mpt_scsi_process_op) }
.text.rtc_updating 0x80ae : { *(.text.rtc_updating) }
.text.ps2_recvbyte 0x80fb : { *(.text.ps2_recvbyte) }
.text.ps2_sendbyte 0x81e9 : { *(.text.ps2_sendbyte) }
.text.ps2_command 0x829a : { *(.text.ps2_command) }
.text.set_leds 0x8544 : { *(.text.set_leds) }
.text.mouse_command 0x85aa : { *(.text.mouse_command) }
.text.mouse_15c201 0x8678 : { *(.text.mouse_15c201) }
.text.handle_160a 0x86bf : { *(.text.handle_160a) }
.text.uhci_waittick 0x8708 : { *(.text.uhci_waittick) }
.text.uhci_send_pipe.constprop.0 0xf0fc : { *(.text.uhci_send_pipe.constprop.0) }
.text.ehci_send_pipe.constprop.0 0xf517 : { *(.text.ehci_send_pipe.constprop.0) }
.text.usb_send_bulk 0xff00 : { *(.text.usb_send_bulk) }
.text.uas_process_op 0x8764 : { *(.text.uas_process_op) }
.text.usb_process_op 0x8986 : { *(.text.usb_process_op) }
.text.floppy_wait_irq 0x8b0f : { *(.text.floppy_wait_irq) }
.text.floppy_pio 0xe837 : { *(.text.floppy_pio) }
.text.floppy_enable_controller 0x8b8c : { *(.text.floppy_enable_controller) }
.text.floppy_drive_pio 0x8bfd : { *(.text.floppy_drive_pio) }
.text.floppy_dma_cmd 0x8caf : { *(.text.floppy_dma_cmd) }
.text.floppy_prep 0x8de9 : { *(.text.floppy_prep) }
.text.floppy_read 0x9157 : { *(.text.floppy_read) }
.text.floppy_write 0x9210 : { *(.text.floppy_write) }
.text.floppy_format 0x92c9 : { *(.text.floppy_format) }
.text.megasas_process_op 0xe990 : { *(.text.megasas_process_op) }
.text.await_ide.constprop.0 0x9351 : { *(.text.await_ide.constprop.0) }
.text.await_not_bsy 0x93c2 : { *(.text.await_not_bsy) }
.text.ndelay_await_not_bsy 0x93d2 : { *(.text.ndelay_await_not_bsy) }
.text.ata_wait_data 0x9422 : { *(.text.ata_wait_data) }
.text.send_cmd 0x948b : { *(.text.send_cmd) }
.text.ata_pio_transfer 0x95b7 : { *(.text.ata_pio_transfer) }
.text.ata_readwrite 0x970e : { *(.text.ata_readwrite) }
.text.ata_atapi_process_op 0x98a5 : { *(.text.ata_atapi_process_op) }
.text.process_op 0x9a59 : { *(.text.process_op) }
.text.cdemu_read 0x9e1d : { *(.text.cdemu_read) }
.text.disk_1300 0xa07e : { *(.text.disk_1300) }
.text.basic_access 0xa0c0 : { *(.text.basic_access) }
.text.disk_1305 0xa232 : { *(.text.disk_1305) }
.text.disk_1310 0xfeae : { *(.text.disk_1310) }
.text.extended_access 0xa35f : { *(.text.extended_access) }
.text.disk_13 0xa45f : { *(.text.disk_13) }
.text.handle_legacy_disk 0xa807 : { *(.text.handle_legacy_disk) }
.text.wait_irq 0xa8a5 : { *(.text.wait_irq) }
.text.dequeue_key 0xa8c5 : { *(.text.dequeue_key) }
.text.handle_1553 0xa99e : { *(.text.handle_1553) }
.text.handle_40 0xab0e : { *(.text.handle_40) }
.text.handle_13 0xab31 : { *(.text.handle_13) }
.text.handle_76 0xabe5 : { *(.text.handle_76) }
.text.invoke_mouse_handler 0xabf6 : { *(.text.invoke_mouse_handler) }
.text.process_mouse 0xac68 : { *(.text.process_mouse) }
.text.handle_16 0xacbf : { *(.text.handle_16) }
.text.handle_1589 0xadd6 : { *(.text.handle_1589) }
.text.handle_15 0xae70 : { *(.text.handle_15) }
.text.handle_14 0xb6fd : { *(.text.handle_14) }
.text.handle_17 0xb8f0 : { *(.text.handle_17) }
.text.handle_sercon 0xba5a : { *(.text.handle_sercon) }
.text.handle_1a 0xec62 : { *(.text.handle_1a) }
.text.handle_08 0xbe5e : { *(.text.handle_08) }
.text.handle_70 0xe742 : { *(.text.handle_70) }
.text.handle_resume 0xc279 : { *(.text.handle_resume) }
.text.handle_pnp 0xc34b : { *(.text.handle_pnp) }
.text.handle_pcibios 0xc394 : { *(.text.handle_pcibios) }
.text.handle_apm 0xf84a : { *(.text.handle_apm) }
.text.handle_hwpic1 0xc72c : { *(.text.handle_hwpic1) }
.text.handle_hwpic2 0xc74e : { *(.text.handle_hwpic2) }
.text.handle_74 0xf066 : { *(.text.handle_74) }
.text.handle_09 0xc76d : { *(.text.handle_09) }
.text.handle_0e 0xc7b6 : { *(.text.handle_0e) }
.text.asm.transition32 0xc7d0 : { *(.text.asm.transition32) }
.text.asm.transition16 0xc81e : { *(.text.asm.transition16) }
.text.asm.__farcall16 0xc86c : { *(.text.asm.__farcall16) }
.text.asm.irq_trampoline_0x02 0xc8f9 : { *(.text.asm.irq_trampoline_0x02) }
.text.asm.irq_trampoline_0x05 0xc8fc : { *(.text.asm.irq_trampoline_0x05) }
.text.asm.irq_trampoline_0x10 0xe6ee : { *(.text.asm.irq_trampoline_0x10) }
.text.asm.irq_trampoline_0x13 0xfa6b : { *(.text.asm.irq_trampoline_0x13) }
.text.asm.irq_trampoline_0x15 0xe983 : { *(.text.asm.irq_trampoline_0x15) }
.text.asm.irq_trampoline_0x16 0xe980 : { *(.text.asm.irq_trampoline_0x16) }
.text.asm.irq_trampoline_0x18 0xe3fb : { *(.text.asm.irq_trampoline_0x18) }
.text.asm.irq_trampoline_0x19 0xe3f8 : { *(.text.asm.irq_trampoline_0x19) }
.text.asm.irq_trampoline_0x1b 0xe829 : { *(.text.asm.irq_trampoline_0x1b) }
.text.asm.irq_trampoline_0x1c 0xf0a0 : { *(.text.asm.irq_trampoline_0x1c) }
.text.asm.irq_trampoline_0x4a 0xf856 : { *(.text.asm.irq_trampoline_0x4a) }
.text.asm.entry_smi 0xc8ff : { *(.text.asm.entry_smi) }
.text.asm.entry_smp 0xc914 : { *(.text.asm.entry_smp) }
.text.asm.entry_resume 0xc944 : { *(.text.asm.entry_resume) }
.text.asm.entry_pmm 0xc959 : { *(.text.asm.entry_pmm) }
.text.asm.entry_pnp_real 0xc9b7 : { *(.text.asm.entry_pnp_real) }
.text.asm.entry_apm16 0xc9ff : { *(.text.asm.entry_apm16) }
.text.asm.entry_apm32 0xca40 : { *(.text.asm.entry_apm32) }
.text.asm.entry_pcibios32 0xca72 : { *(.text.asm.entry_pcibios32) }
.text.asm.entry_pcibios16 0xcaa0 : { *(.text.asm.entry_pcibios16) }
.text.asm.entry_1589 0xcada : { *(.text.asm.entry_1589) }
.text.asm.entry_bios32 0xcb14 : { *(.text.asm.entry_bios32) }
.text.asm.entry_sercon 0xcb33 : { *(.text.asm.entry_sercon) }
.text.asm.irqentry_extrastack 0xcb7a : { *(.text.asm.irqentry_extrastack) }
.text.asm.irqentry_arg_extrastack 0xcc07 : { *(.text.asm.irqentry_arg_extrastack) }
.text.asm.entry_13 0xcca9 : { *(.text.asm.entry_13) }
.text.asm.entry_76 0xccb2 : { *(.text.asm.entry_76) }
.text.asm.entry_70 0xccbb : { *(.text.asm.entry_70) }
.text.asm.entry_74 0xccc4 : { *(.text.asm.entry_74) }
.text.asm.entry_75 0xcccd : { *(.text.asm.entry_75) }
.text.asm.entry_hwpic1 0xccd6 : { *(.text.asm.entry_hwpic1) }
.text.asm.entry_hwpic2 0xccdf : { *(.text.asm.entry_hwpic2) }
.text.asm.entry_19 0xcce8 : { *(.text.asm.entry_19) }
.text.asm.entry_18 0xccfb : { *(.text.asm.entry_18) }
.rodata 0xcd0e : { *(.rodata) }
.rodata.__func__.0 0xd4d4 : { *(.rodata.__func__.0) }
.rodata.__func__.2 0xd4e8 : { *(.rodata.__func__.2) }
.rodata.__func__.3 0xd4f4 : { *(.rodata.__func__.3) }
.rodata.__func__.4 0xd500 : { *(.rodata.__func__.4) }
.rodata.__func__.5 0xd50c : { *(.rodata.__func__.5) }
.rodata.__func__.9 0xd51c : { *(.rodata.__func__.9) }
.rodata.__func__.10 0xd52c : { *(.rodata.__func__.10) }
.rodata.__func__.20 0xd53c : { *(.rodata.__func__.20) }
.rodata.__func__.21 0xd548 : { *(.rodata.__func__.21) }
.rodata.__func__.24 0xd550 : { *(.rodata.__func__.24) }
.rodata.__func__.29 0xd560 : { *(.rodata.__func__.29) }
.rodata.__func__.30 0xd570 : { *(.rodata.__func__.30) }
.rodata.__func__.31 0xd584 : { *(.rodata.__func__.31) }
.rodata.__func__.32 0xd594 : { *(.rodata.__func__.32) }
.rodata.__func__.33 0xd5a4 : { *(.rodata.__func__.33) }
.rodata.__func__.34 0xd5b4 : { *(.rodata.__func__.34) }
.rodata.__func__.35 0xd5c4 : { *(.rodata.__func__.35) }
.rodata.__func__.37 0xd5d4 : { *(.rodata.__func__.37) }
.rodata.__func__.38 0xd5e4 : { *(.rodata.__func__.38) }
.rodata.__func__.39 0xd5f4 : { *(.rodata.__func__.39) }
.rodata.__func__.40 0xd600 : { *(.rodata.__func__.40) }
.rodata.__func__.41 0xd610 : { *(.rodata.__func__.41) }
.rodata.__func__.42 0xd620 : { *(.rodata.__func__.42) }
.rodata.__func__.43 0xd62c : { *(.rodata.__func__.43) }
.rodata.__func__.44 0xd638 : { *(.rodata.__func__.44) }
.rodata.__func__.45 0xd644 : { *(.rodata.__func__.45) }
.rodata.__func__.46 0xd650 : { *(.rodata.__func__.46) }
.rodata.__func__.47 0xd65c : { *(.rodata.__func__.47) }
.rodata.__func__.48 0xd668 : { *(.rodata.__func__.48) }
.rodata.__func__.49 0xd674 : { *(.rodata.__func__.49) }
.rodata.__func__.50 0xd680 : { *(.rodata.__func__.50) }
.rodata.__func__.51 0xd68c : { *(.rodata.__func__.51) }
.rodata.__func__.52 0xd698 : { *(.rodata.__func__.52) }
.rodata.__func__.53 0xd6a4 : { *(.rodata.__func__.53) }
.rodata.__func__.54 0xd6b0 : { *(.rodata.__func__.54) }
.rodata.__func__.55 0xd6bc : { *(.rodata.__func__.55) }
.rodata.__func__.56 0xd6c8 : { *(.rodata.__func__.56) }
.rodata.__func__.57 0xd6d8 : { *(.rodata.__func__.57) }
.rodata.__func__.58 0xd6e8 : { *(.rodata.__func__.58) }
.rodata.__func__.59 0xd6f8 : { *(.rodata.__func__.59) }
.rodata.__func__.60 0xd704 : { *(.rodata.__func__.60) }
.rodata.__func__.61 0xd714 : { *(.rodata.__func__.61) }
.rodata.__func__.62 0xd724 : { *(.rodata.__func__.62) }
.rodata.__func__.63 0xd734 : { *(.rodata.__func__.63) }
.rodata.__func__.64 0xd744 : { *(.rodata.__func__.64) }
.rodata.__func__.65 0xd754 : { *(.rodata.__func__.65) }
.rodata.__func__.66 0xd764 : { *(.rodata.__func__.66) }
.rodata.__func__.67 0xd774 : { *(.rodata.__func__.67) }
.rodata.__func__.68 0xd784 : { *(.rodata.__func__.68) }
.rodata.__func__.69 0xd794 : { *(.rodata.__func__.69) }
.rodata.__func__.70 0xd7a4 : { *(.rodata.__func__.70) }
.rodata.__func__.71 0xd7b4 : { *(.rodata.__func__.71) }
.rodata.__func__.72 0xd7c4 : { *(.rodata.__func__.72) }
.rodata.__func__.73 0xd7d4 : { *(.rodata.__func__.73) }
.rodata.__func__.74 0xd7e0 : { *(.rodata.__func__.74) }
.rodata.__func__.75 0xd7ec : { *(.rodata.__func__.75) }
.rodata.__func__.76 0xd7f8 : { *(.rodata.__func__.76) }
.rodata.__func__.77 0xd804 : { *(.rodata.__func__.77) }
.rodata.__func__.78 0xd810 : { *(.rodata.__func__.78) }
.rodata.__func__.79 0xd81c : { *(.rodata.__func__.79) }
.rodata.__func__.80 0xd828 : { *(.rodata.__func__.80) }
.rodata.__func__.81 0xd834 : { *(.rodata.__func__.81) }
.rodata.__func__.82 0xd840 : { *(.rodata.__func__.82) }
.rodata.__func__.83 0xd84c : { *(.rodata.__func__.83) }
.rodata.__func__.84 0xd858 : { *(.rodata.__func__.84) }
.rodata.__func__.85 0xd864 : { *(.rodata.__func__.85) }
.rodata.__func__.86 0xd870 : { *(.rodata.__func__.86) }
.rodata.__func__.87 0xd87c : { *(.rodata.__func__.87) }
.rodata.__func__.88 0xd88c : { *(.rodata.__func__.88) }
.rodata.__func__.89 0xd898 : { *(.rodata.__func__.89) }
.rodata.__func__.90 0xd8a4 : { *(.rodata.__func__.90) }
.rodata.__func__.91 0xd8b0 : { *(.rodata.__func__.91) }
.rodata.__func__.92 0xd8bc : { *(.rodata.__func__.92) }
.rodata.__func__.93 0xd8c8 : { *(.rodata.__func__.93) }
.rodata.__func__.94 0xd8d4 : { *(.rodata.__func__.94) }
.rodata.__func__.95 0xd8e0 : { *(.rodata.__func__.95) }
.rodata.__func__.96 0xd8ec : { *(.rodata.__func__.96) }
.rodata.__func__.97 0xd8f8 : { *(.rodata.__func__.97) }
.rodata.__func__.98 0xd904 : { *(.rodata.__func__.98) }
.rodata.__func__.99 0xd910 : { *(.rodata.__func__.99) }
.rodata.__func__.100 0xd920 : { *(.rodata.__func__.100) }
.rodata.__func__.101 0xd92c : { *(.rodata.__func__.101) }
.rodata.__func__.102 0xd938 : { *(.rodata.__func__.102) }
.rodata.__func__.103 0xd94c : { *(.rodata.__func__.103) }
.rodata.__func__.106 0xd958 : { *(.rodata.__func__.106) }
.rodata.__func__.107 0xd964 : { *(.rodata.__func__.107) }
.rodata.__func__.108 0xd970 : { *(.rodata.__func__.108) }
.rodata.__func__.109 0xd97c : { *(.rodata.__func__.109) }
.rodata.__func__.110 0xd988 : { *(.rodata.__func__.110) }
.data16../src/hw/usb-hid.c.187 0xd994 : { *(.data16../src/hw/usb-hid.c.187) }
.data16../src/hw/usb-hid.c.170 0xd9c0 : { *(.data16../src/hw/usb-hid.c.170) }
.data16../src/cp437.c.11 0xdaa0 : { *(.data16../src/cp437.c.11) }
.data16../src/sercon.c.554 0xdca0 : { *(.data16../src/sercon.c.554) }
.data16../src/sercon.c.70 0xdd50 : { *(.data16../src/sercon.c.70) }
.data16../src/kbd.c.374 0xdd58 : { *(.data16../src/kbd.c.374) }
.data16../src/kbd.c.371 0xdd60 : { *(.data16../src/kbd.c.371) }
.data16../src/kbd.c.279 0xdd80 : { *(.data16../src/kbd.c.279) }
.data16../src/mouse.c.106 0xe048 : { *(.data16../src/mouse.c.106) }
.fixedaddr.0xe05b 0xe05b : { *(.fixedaddr.0xe05b) }
.fixedaddr.0xe2c3 0xe2c3 : { *(.fixedaddr.0xe2c3) }
.fixedaddr.0xe3fe 0xe3fe : { *(.fixedaddr.0xe3fe) }
.fixedaddr.0xe6f2 0xe6f2 : { *(.fixedaddr.0xe6f2) }
.fixedaddr.0xe739 0xe739 : { *(.fixedaddr.0xe739) }
.fixedaddr.0xe82e 0xe82e : { *(.fixedaddr.0xe82e) }
.fixedaddr.0xe987 0xe987 : { *(.fixedaddr.0xe987) }
.fixedaddr.0xec59 0xec59 : { *(.fixedaddr.0xec59) }
.fixedaddr.0xef57 0xef57 : { *(.fixedaddr.0xef57) }
.fixedaddr.0xefd2 0xefd2 : { *(.fixedaddr.0xefd2) }
.fixedaddr.0xf045 0xf045 : { *(.fixedaddr.0xf045) }
.fixedaddr.0xf065 0xf065 : { *(.fixedaddr.0xf065) }
.fixedaddr.0xf841 0xf841 : { *(.fixedaddr.0xf841) }
.fixedaddr.0xf84d 0xf84d : { *(.fixedaddr.0xf84d) }
.fixedaddr.0xf859 0xf859 : { *(.fixedaddr.0xf859) }
.fixedaddr.0xfe6e 0xfe6e : { *(.fixedaddr.0xfe6e) }
.fixedaddr.0xfea5 0xfea5 : { *(.fixedaddr.0xfea5) }
.fixedaddr.0xff53 0xff53 : { *(.fixedaddr.0xff53) }
.fixedaddr.0xff54 0xff54 : { *(.fixedaddr.0xff54) }
.fixedaddr.0xfff0 0xfff0 : { *(.fixedaddr.0xfff0) }



        /* Discard regular data sections to force a link error if
         * code attempts to access data not marked with VAR16 (or other
         * appropriate macro)
         */
        /DISCARD/ : {
                *(.text*) *(.data*) *(.bss*) *(.rodata*)
                *(COMMON) *(.discard*) *(.eh_frame) *(.note*)
                }
}
