
/* DO NOT EDIT!  This is an autogenerated file.  See scripts/layoutrom.py. */
OUTPUT_FORMAT("elf32-i386")
OUTPUT_ARCH("i386")
SECTIONS
{
TPM_interface_shutdown = 0xe5700 ;
sercon_attr = 0xe574c ;
BootSequence = 0xe5718 ;
sercon_col_last = 0xe574f ;
TimerLast = 0xe5734 ;
tpm_state = 0xe5704 ;
emulated_drive_gf = 0xe5768 ;
sercon_port = 0xe5754 ;
StackPos = 0xe5790 ;
LastUSBkey = 0xe5724 ;
CDEmu = 0xe576c ;
reply_msg = 0xe571c ;
Century = 0xe5738 ;
sercon_split = 0xe5752 ;
ExtraStack = 0xe5798 ;
sercon_attr_last = 0xe5750 ;
DefaultDPTE = 0xe5780 ;
sercon_enable = 0xe5751 ;
sercon_row_last = 0xe574e ;
rx_buf = 0xe573c ;
Ps2ctr = 0xe572c ;
rx_bytes = 0xe5739 ;
Call16Data = 0xe5f9c ;
sercon_char = 0xe574d ;
RTCusers = 0xe5730 ;
CDRom_locks = 0xe5758 ;
TPM_working = 0xe5701 ;
FloppyDOR = 0xe5720 ;
reset_vector = 0xffff0 ;
entry_smi = 0xfc8ff ;
transition16big = 0xfc833 ;
transition16 = 0xfc81e ;
_cfunc16_call16_helper = 0xf6d0a ;
transition32_nmi_off = 0xfc7e8 ;
_cfunc16_check_irqs = 0xf79a9 ;
_cfunc16_wait_irq = 0xfa8a5 ;
_cfunc16__farcall16 = 0xf71b8 ;
entry_10 = 0xff065 ;
irq_trampoline_0x10 = 0xfe6ee ;
irq_trampoline_0x16 = 0xfe980 ;
entry_08 = 0xffea5 ;
entry_70 = 0xfccbb ;
entry_smp = 0xfc914 ;
entry_19_official = 0xfe6f2 ;
irq_trampoline_0x13 = 0xffa6b ;
entry_09 = 0xfe987 ;
entry_74 = 0xfccc4 ;
entry_0e = 0xfef57 ;
entry_76 = 0xfccb2 ;
entry_iret_official = 0xfff53 ;
entry_hwpic1 = 0xfccd6 ;
entry_hwpic2 = 0xfccdf ;
entry_02 = 0xfe2c3 ;
entry_05 = 0xfff54 ;
entry_11 = 0xff84d ;
entry_12 = 0xff841 ;
entry_13_official = 0xfe3fe ;
entry_14 = 0xfe739 ;
entry_15_official = 0xff859 ;
entry_16 = 0xfe82e ;
entry_17 = 0xfefd2 ;
entry_18 = 0xfccfb ;
entry_1a_official = 0xffe6e ;
entry_40 = 0xfec59 ;
entry_bios32 = 0xfcb14 ;
entry_pmm = 0xfc959 ;
entry_pnp_real = 0xfc9bb ;
entry_pnp_prot = 0xfc9b7 ;
irq_trampoline_0x18 = 0xfe3fb ;
irq_trampoline_0x19 = 0xfe3f8 ;
entry_75 = 0xfcccd ;
entry_sercon = 0xfcb33 ;

    _reloc_min_align = 0x20 ;
    zonefseg_start = 0xf3c80 ;
    zonefseg_end = 0xf4480 ;
    zonelow_base = 0xd6000 ;
    final_varlow_start = 0xe5700 ;
    final_readonly_start = 0xe5fc0 ;
    varlow_start = 0xcfaa0 ;
    varlow_end = 0xd0360 ;
    code32init_start = 0xd0360 ;
    code32init_end = 0xe5fc0 ;

    code32flat_start = 0xcdde0 ;
    .text code32flat_start : {

        _reloc_abs_start = ABSOLUTE(.) ;
LONG(0xd06ca - code32init_start)
LONG(0xd06ed - code32init_start)
LONG(0xd06f5 - code32init_start)
LONG(0xd0725 - code32init_start)
LONG(0xd072d - code32init_start)
LONG(0xd0746 - code32init_start)
LONG(0xd07e1 - code32init_start)
LONG(0xd08d2 - code32init_start)
LONG(0xd08db - code32init_start)
LONG(0xd090e - code32init_start)
LONG(0xd0917 - code32init_start)
LONG(0xd0963 - code32init_start)
LONG(0xd0974 - code32init_start)
LONG(0xd097f - code32init_start)
LONG(0xd09c1 - code32init_start)
LONG(0xd09da - code32init_start)
LONG(0xd0ab8 - code32init_start)
LONG(0xd0ad0 - code32init_start)
LONG(0xd0b08 - code32init_start)
LONG(0xd0b36 - code32init_start)
LONG(0xd0b42 - code32init_start)
LONG(0xd0c84 - code32init_start)
LONG(0xd0c8c - code32init_start)
LONG(0xd13cc - code32init_start)
LONG(0xd13e6 - code32init_start)
LONG(0xd13f9 - code32init_start)
LONG(0xd140c - code32init_start)
LONG(0xd141f - code32init_start)
LONG(0xd142e - code32init_start)
LONG(0xd1441 - code32init_start)
LONG(0xd1450 - code32init_start)
LONG(0xd1e74 - code32init_start)
LONG(0xd20ce - code32init_start)
LONG(0xd2529 - code32init_start)
LONG(0xd2611 - code32init_start)
LONG(0xd267b - code32init_start)
LONG(0xd2ba2 - code32init_start)
LONG(0xd2bbd - code32init_start)
LONG(0xd2bf9 - code32init_start)
LONG(0xd2c26 - code32init_start)
LONG(0xd2c68 - code32init_start)
LONG(0xd2cb8 - code32init_start)
LONG(0xd2cbf - code32init_start)
LONG(0xd2d3c - code32init_start)
LONG(0xd2dbe - code32init_start)
LONG(0xd2dc5 - code32init_start)
LONG(0xd2e07 - code32init_start)
LONG(0xd2e86 - code32init_start)
LONG(0xd2ea0 - code32init_start)
LONG(0xd2eaf - code32init_start)
LONG(0xd2f8d - code32init_start)
LONG(0xd300d - code32init_start)
LONG(0xd3084 - code32init_start)
LONG(0xd3561 - code32init_start)
LONG(0xd35ef - code32init_start)
LONG(0xd362e - code32init_start)
LONG(0xd363c - code32init_start)
LONG(0xd36c7 - code32init_start)
LONG(0xd374f - code32init_start)
LONG(0xd3759 - code32init_start)
LONG(0xd386e - code32init_start)
LONG(0xd3874 - code32init_start)
LONG(0xd389e - code32init_start)
LONG(0xd38b0 - code32init_start)
LONG(0xd38b5 - code32init_start)
LONG(0xd3b40 - code32init_start)
LONG(0xd3b78 - code32init_start)
LONG(0xd3bab - code32init_start)
LONG(0xd3beb - code32init_start)
LONG(0xd3c4c - code32init_start)
LONG(0xd3c8c - code32init_start)
LONG(0xd3cae - code32init_start)
LONG(0xd3e1a - code32init_start)
LONG(0xd3e5d - code32init_start)
LONG(0xd3e8f - code32init_start)
LONG(0xd3ed9 - code32init_start)
LONG(0xd3ef1 - code32init_start)
LONG(0xd40b7 - code32init_start)
LONG(0xd40c6 - code32init_start)
LONG(0xd40d9 - code32init_start)
LONG(0xd40e4 - code32init_start)
LONG(0xd40ea - code32init_start)
LONG(0xd40f0 - code32init_start)
LONG(0xd4100 - code32init_start)
LONG(0xd4104 - code32init_start)
LONG(0xd4190 - code32init_start)
LONG(0xd431e - code32init_start)
LONG(0xd43f1 - code32init_start)
LONG(0xd4429 - code32init_start)
LONG(0xd4478 - code32init_start)
LONG(0xd4528 - code32init_start)
LONG(0xd452e - code32init_start)
LONG(0xd453e - code32init_start)
LONG(0xd4544 - code32init_start)
LONG(0xd461d - code32init_start)
LONG(0xd48d7 - code32init_start)
LONG(0xd4992 - code32init_start)
LONG(0xd4a0d - code32init_start)
LONG(0xd4a2b - code32init_start)
LONG(0xd4c44 - code32init_start)
LONG(0xd4ec4 - code32init_start)
LONG(0xd4fcf - code32init_start)
LONG(0xd4fe0 - code32init_start)
LONG(0xd5013 - code32init_start)
LONG(0xd5026 - code32init_start)
LONG(0xd5083 - code32init_start)
LONG(0xd50d4 - code32init_start)
LONG(0xd50e5 - code32init_start)
LONG(0xd50ed - code32init_start)
LONG(0xd5101 - code32init_start)
LONG(0xd5122 - code32init_start)
LONG(0xd5144 - code32init_start)
LONG(0xd5165 - code32init_start)
LONG(0xd51ab - code32init_start)
LONG(0xd51bc - code32init_start)
LONG(0xd51ed - code32init_start)
LONG(0xd5240 - code32init_start)
LONG(0xd5324 - code32init_start)
LONG(0xd536f - code32init_start)
LONG(0xd53bb - code32init_start)
LONG(0xd53dc - code32init_start)
LONG(0xd5400 - code32init_start)
LONG(0xd5478 - code32init_start)
LONG(0xd5519 - code32init_start)
LONG(0xd5547 - code32init_start)
LONG(0xd5614 - code32init_start)
LONG(0xd56b4 - code32init_start)
LONG(0xd5737 - code32init_start)
LONG(0xd578d - code32init_start)
LONG(0xd5897 - code32init_start)
LONG(0xd58df - code32init_start)
LONG(0xd58ef - code32init_start)
LONG(0xd59a5 - code32init_start)
LONG(0xd59f3 - code32init_start)
LONG(0xd5ac6 - code32init_start)
LONG(0xd5c12 - code32init_start)
LONG(0xd5fee - code32init_start)
LONG(0xd6026 - code32init_start)
LONG(0xd602e - code32init_start)
LONG(0xd6084 - code32init_start)
LONG(0xd60f8 - code32init_start)
LONG(0xd6128 - code32init_start)
LONG(0xd6297 - code32init_start)
LONG(0xd6342 - code32init_start)
LONG(0xd6380 - code32init_start)
LONG(0xd639b - code32init_start)
LONG(0xd63a1 - code32init_start)
LONG(0xd63ae - code32init_start)
LONG(0xd63b4 - code32init_start)
LONG(0xd63c5 - code32init_start)
LONG(0xd63ce - code32init_start)
LONG(0xd63d7 - code32init_start)
LONG(0xd63e0 - code32init_start)
LONG(0xd6444 - code32init_start)
LONG(0xd6449 - code32init_start)
LONG(0xd6451 - code32init_start)
LONG(0xd6456 - code32init_start)
LONG(0xd6490 - code32init_start)
LONG(0xd64c5 - code32init_start)
LONG(0xd64fa - code32init_start)
LONG(0xd69c7 - code32init_start)
LONG(0xd69e0 - code32init_start)
LONG(0xd69e6 - code32init_start)
LONG(0xd6a3d - code32init_start)
LONG(0xd6ac0 - code32init_start)
LONG(0xd6b22 - code32init_start)
LONG(0xd6b28 - code32init_start)
LONG(0xd6b7b - code32init_start)
LONG(0xd6b81 - code32init_start)
LONG(0xd6b94 - code32init_start)
LONG(0xd6bef - code32init_start)
LONG(0xd6bf5 - code32init_start)
LONG(0xd6c5a - code32init_start)
LONG(0xd6c60 - code32init_start)
LONG(0xd6c85 - code32init_start)
LONG(0xd6c8b - code32init_start)
LONG(0xd6ce5 - code32init_start)
LONG(0xd6e2f - code32init_start)
LONG(0xd6e35 - code32init_start)
LONG(0xd6e56 - code32init_start)
LONG(0xd6e5c - code32init_start)
LONG(0xd6ec9 - code32init_start)
LONG(0xd6f0c - code32init_start)
LONG(0xd6f2f - code32init_start)
LONG(0xd6f8b - code32init_start)
LONG(0xd6fbc - code32init_start)
LONG(0xd70a4 - code32init_start)
LONG(0xd70fb - code32init_start)
LONG(0xd7224 - code32init_start)
LONG(0xd7265 - code32init_start)
LONG(0xd72dd - code32init_start)
LONG(0xd737e - code32init_start)
LONG(0xd77ad - code32init_start)
LONG(0xd79ea - code32init_start)
LONG(0xd7d36 - code32init_start)
LONG(0xd7ed2 - code32init_start)
LONG(0xd7ee4 - code32init_start)
LONG(0xd7f45 - code32init_start)
LONG(0xd7fc5 - code32init_start)
LONG(0xd8023 - code32init_start)
LONG(0xd806b - code32init_start)
LONG(0xd823a - code32init_start)
LONG(0xd82e8 - code32init_start)
LONG(0xd836a - code32init_start)
LONG(0xd83c5 - code32init_start)
LONG(0xd83d0 - code32init_start)
LONG(0xd840e - code32init_start)
LONG(0xd8479 - code32init_start)
LONG(0xd84fb - code32init_start)
LONG(0xd85c8 - code32init_start)
LONG(0xd88b2 - code32init_start)
LONG(0xd8c0c - code32init_start)
LONG(0xd8e16 - code32init_start)
LONG(0xd8e31 - code32init_start)
LONG(0xd8e8d - code32init_start)
LONG(0xd8eb9 - code32init_start)
LONG(0xd8ee4 - code32init_start)
LONG(0xd8f18 - code32init_start)
LONG(0xd8f40 - code32init_start)
LONG(0xd8f72 - code32init_start)
LONG(0xd91b3 - code32init_start)
LONG(0xd91de - code32init_start)
LONG(0xd9212 - code32init_start)
LONG(0xd922c - code32init_start)
LONG(0xd9279 - code32init_start)
LONG(0xd9299 - code32init_start)
LONG(0xd9379 - code32init_start)
LONG(0xd95f0 - code32init_start)
LONG(0xd9698 - code32init_start)
LONG(0xd96a3 - code32init_start)
LONG(0xd96a9 - code32init_start)
LONG(0xd96ad - code32init_start)
LONG(0xd96cd - code32init_start)
LONG(0xd96d3 - code32init_start)
LONG(0xd96ec - code32init_start)
LONG(0xd96fa - code32init_start)
LONG(0xd9725 - code32init_start)
LONG(0xd980d - code32init_start)
LONG(0xd9890 - code32init_start)
LONG(0xd98a2 - code32init_start)
LONG(0xd99db - code32init_start)
LONG(0xd99ef - code32init_start)
LONG(0xd9bd5 - code32init_start)
LONG(0xd9be8 - code32init_start)
LONG(0xd9c04 - code32init_start)
LONG(0xd9c72 - code32init_start)
LONG(0xd9e3f - code32init_start)
LONG(0xd9e58 - code32init_start)
LONG(0xd9e60 - code32init_start)
LONG(0xd9ea3 - code32init_start)
LONG(0xda0b2 - code32init_start)
LONG(0xda0de - code32init_start)
LONG(0xda1ba - code32init_start)
LONG(0xda232 - code32init_start)
LONG(0xda2d6 - code32init_start)
LONG(0xda2ec - code32init_start)
LONG(0xda2fd - code32init_start)
LONG(0xda3ac - code32init_start)
LONG(0xda4c8 - code32init_start)
LONG(0xda4cd - code32init_start)
LONG(0xda51d - code32init_start)
LONG(0xda58d - code32init_start)
LONG(0xda5e0 - code32init_start)
LONG(0xda5f7 - code32init_start)
LONG(0xda664 - code32init_start)
LONG(0xda6ec - code32init_start)
LONG(0xda71e - code32init_start)
LONG(0xda91e - code32init_start)
LONG(0xda992 - code32init_start)
LONG(0xda9b3 - code32init_start)
LONG(0xda9c6 - code32init_start)
LONG(0xdaa19 - code32init_start)
LONG(0xdaa88 - code32init_start)
LONG(0xdaa98 - code32init_start)
LONG(0xdab10 - code32init_start)
LONG(0xdab20 - code32init_start)
LONG(0xdab53 - code32init_start)
LONG(0xdac2c - code32init_start)
LONG(0xdac4d - code32init_start)
LONG(0xdadcc - code32init_start)
LONG(0xdae0f - code32init_start)
LONG(0xdae1b - code32init_start)
LONG(0xdae44 - code32init_start)
LONG(0xdaf74 - code32init_start)
LONG(0xdaf82 - code32init_start)
LONG(0xdaf8d - code32init_start)
LONG(0xdaf9c - code32init_start)
LONG(0xdafc1 - code32init_start)
LONG(0xdb0e0 - code32init_start)
LONG(0xdb163 - code32init_start)
LONG(0xdb41d - code32init_start)
LONG(0xdb516 - code32init_start)
LONG(0xdbab6 - code32init_start)
LONG(0xdbabc - code32init_start)
LONG(0xdbac2 - code32init_start)
LONG(0xdbc25 - code32init_start)
LONG(0xdbc69 - code32init_start)
LONG(0xdbc72 - code32init_start)
LONG(0xdbc9a - code32init_start)
LONG(0xdbca0 - code32init_start)
LONG(0xdbd0e - code32init_start)
LONG(0xdbd59 - code32init_start)
LONG(0xdbd62 - code32init_start)
LONG(0xdbdbc - code32init_start)
LONG(0xdbec7 - code32init_start)
LONG(0xdbf3c - code32init_start)
LONG(0xdc047 - code32init_start)
LONG(0xdc075 - code32init_start)
LONG(0xdc0ff - code32init_start)
LONG(0xdc10d - code32init_start)
LONG(0xdc15b - code32init_start)
LONG(0xdc19c - code32init_start)
LONG(0xdc211 - code32init_start)
LONG(0xdc293 - code32init_start)
LONG(0xdc39b - code32init_start)
LONG(0xdc3a2 - code32init_start)
LONG(0xdc3e7 - code32init_start)
LONG(0xdc410 - code32init_start)
LONG(0xdc417 - code32init_start)
LONG(0xdc451 - code32init_start)
LONG(0xdc5c0 - code32init_start)
LONG(0xdc605 - code32init_start)
LONG(0xdc60c - code32init_start)
LONG(0xdc629 - code32init_start)
LONG(0xdc642 - code32init_start)
LONG(0xdc660 - code32init_start)
LONG(0xdc6b5 - code32init_start)
LONG(0xdc70a - code32init_start)
LONG(0xdc76d - code32init_start)
LONG(0xdc7db - code32init_start)
LONG(0xdc7ea - code32init_start)
LONG(0xdc7f0 - code32init_start)
LONG(0xdc808 - code32init_start)
LONG(0xdc80e - code32init_start)
LONG(0xdc8a2 - code32init_start)
LONG(0xdc9a0 - code32init_start)
LONG(0xdc9f1 - code32init_start)
LONG(0xdca7f - code32init_start)
LONG(0xdcbd4 - code32init_start)
LONG(0xdcc87 - code32init_start)
LONG(0xdcdab - code32init_start)
LONG(0xdcdc2 - code32init_start)
LONG(0xdcf77 - code32init_start)
LONG(0xdcfee - code32init_start)
LONG(0xdd03d - code32init_start)
LONG(0xdd06b - code32init_start)
LONG(0xdd0c0 - code32init_start)
LONG(0xdd253 - code32init_start)
LONG(0xdd3eb - code32init_start)
LONG(0xdd620 - code32init_start)
LONG(0xdd6ed - code32init_start)
LONG(0xdd70b - code32init_start)
LONG(0xdd73f - code32init_start)
LONG(0xdd88c - code32init_start)
LONG(0xdd895 - code32init_start)
LONG(0xdd8a5 - code32init_start)
LONG(0xdd953 - code32init_start)
LONG(0xdd963 - code32init_start)
LONG(0xdd9c0 - code32init_start)
LONG(0xdda88 - code32init_start)
LONG(0xddb25 - code32init_start)
LONG(0xddb5d - code32init_start)
LONG(0xddb8d - code32init_start)
LONG(0xddba1 - code32init_start)
LONG(0xddbd7 - code32init_start)
LONG(0xddc0b - code32init_start)
LONG(0xddc40 - code32init_start)
LONG(0xddc60 - code32init_start)
LONG(0xddc70 - code32init_start)
LONG(0xddc9b - code32init_start)
LONG(0xddce3 - code32init_start)
LONG(0xddd10 - code32init_start)
LONG(0xddd67 - code32init_start)
LONG(0xddd93 - code32init_start)
LONG(0xdddde - code32init_start)
LONG(0xdde07 - code32init_start)
LONG(0xdde61 - code32init_start)
LONG(0xdde66 - code32init_start)
LONG(0xddec0 - code32init_start)
LONG(0xddf2d - code32init_start)
LONG(0xddf40 - code32init_start)
LONG(0xddf95 - code32init_start)
LONG(0xddfd9 - code32init_start)
LONG(0xddff3 - code32init_start)
LONG(0xde00b - code32init_start)
LONG(0xde05c - code32init_start)
LONG(0xde0cd - code32init_start)
LONG(0xde0e5 - code32init_start)
LONG(0xde12c - code32init_start)
LONG(0xde17c - code32init_start)
LONG(0xde195 - code32init_start)
LONG(0xde227 - code32init_start)
LONG(0xde2bd - code32init_start)
LONG(0xde2c2 - code32init_start)
LONG(0xde30e - code32init_start)
LONG(0xde349 - code32init_start)
LONG(0xde3a4 - code32init_start)
LONG(0xde441 - code32init_start)
LONG(0xde4ab - code32init_start)
LONG(0xde53c - code32init_start)
LONG(0xde574 - code32init_start)
LONG(0xde5c1 - code32init_start)
LONG(0xde5de - code32init_start)
LONG(0xde635 - code32init_start)
LONG(0xde67d - code32init_start)
LONG(0xde6a0 - code32init_start)
LONG(0xde6e8 - code32init_start)
LONG(0xde704 - code32init_start)
LONG(0xde71d - code32init_start)
LONG(0xde739 - code32init_start)
LONG(0xde752 - code32init_start)
LONG(0xde76e - code32init_start)
LONG(0xde7c5 - code32init_start)
LONG(0xde7e1 - code32init_start)
LONG(0xde7fa - code32init_start)
LONG(0xde816 - code32init_start)
LONG(0xde842 - code32init_start)
LONG(0xde85e - code32init_start)
LONG(0xde88d - code32init_start)
LONG(0xde9a3 - code32init_start)
LONG(0xde9b3 - code32init_start)
LONG(0xdea2d - code32init_start)
LONG(0xdea65 - code32init_start)
LONG(0xdea9a - code32init_start)
LONG(0xdeaa4 - code32init_start)
LONG(0xdead9 - code32init_start)
LONG(0xdedc0 - code32init_start)
LONG(0xdedc6 - code32init_start)
LONG(0xdeddc - code32init_start)
LONG(0xdede2 - code32init_start)
LONG(0xdee76 - code32init_start)
LONG(0xdee98 - code32init_start)
LONG(0xdeedb - code32init_start)
LONG(0xdeef3 - code32init_start)
LONG(0xdeefb - code32init_start)
LONG(0xdf11c - code32init_start)
LONG(0xdf126 - code32init_start)
LONG(0xdf130 - code32init_start)
LONG(0xdf13a - code32init_start)
LONG(0xdf167 - code32init_start)
LONG(0xdf174 - code32init_start)
LONG(0xdf17c - code32init_start)
LONG(0xdf184 - code32init_start)
LONG(0xdf1bc - code32init_start)
LONG(0xdf1e8 - code32init_start)
LONG(0xdf1ed - code32init_start)
LONG(0xdf1fa - code32init_start)
LONG(0xdf203 - code32init_start)
LONG(0xdf21c - code32init_start)
LONG(0xdf230 - code32init_start)
LONG(0xdf285 - code32init_start)
LONG(0xdf2b1 - code32init_start)
LONG(0xdf2b6 - code32init_start)
LONG(0xdf2c3 - code32init_start)
LONG(0xdf2cc - code32init_start)
LONG(0xdf2e5 - code32init_start)
LONG(0xdf2fd - code32init_start)
LONG(0xdf56b - code32init_start)
LONG(0xdf73f - code32init_start)
LONG(0xdfa68 - code32init_start)
LONG(0xdfafe - code32init_start)
LONG(0xdfc18 - code32init_start)
LONG(0xdfd38 - code32init_start)
LONG(0xdfd7b - code32init_start)
LONG(0xdfe1d - code32init_start)
LONG(0xdfe92 - code32init_start)
LONG(0xdff4f - code32init_start)
LONG(0xe0335 - code32init_start)
LONG(0xe04ad - code32init_start)
LONG(0xe0601 - code32init_start)
LONG(0xe0782 - code32init_start)
LONG(0xe09a5 - code32init_start)
LONG(0xe0be3 - code32init_start)
LONG(0xe0c8e - code32init_start)
LONG(0xe0d9d - code32init_start)
LONG(0xe0de4 - code32init_start)
LONG(0xe0ea6 - code32init_start)
LONG(0xe0fb5 - code32init_start)
LONG(0xe1016 - code32init_start)
LONG(0xe10d6 - code32init_start)
LONG(0xe11ab - code32init_start)
LONG(0xe1276 - code32init_start)
LONG(0xe1358 - code32init_start)
LONG(0xe13a8 - code32init_start)
LONG(0xe13b9 - code32init_start)
LONG(0xe1961 - code32init_start)
LONG(0xe1bc2 - code32init_start)
LONG(0xe1d64 - code32init_start)
LONG(0xe1e5e - code32init_start)
LONG(0xe1e78 - code32init_start)
LONG(0xe1f6a - code32init_start)
LONG(0xe2365 - code32init_start)
LONG(0xe25ba - code32init_start)
LONG(0xe34c4 - code32init_start)
LONG(0xe3511 - code32init_start)
LONG(0xe351b - code32init_start)
LONG(0xe3549 - code32init_start)
LONG(0xe3575 - code32init_start)
LONG(0xe385f - code32init_start)
LONG(0xe38c1 - code32init_start)
LONG(0xe3d88 - code32init_start)
LONG(0xe3da6 - code32init_start)
LONG(0xe3dd9 - code32init_start)
LONG(0xe3dfe - code32init_start)
LONG(0xe3fdd - code32init_start)
LONG(0xe3fe4 - code32init_start)
LONG(0xe4020 - code32init_start)
LONG(0xe41fe - code32init_start)
LONG(0xe423d - code32init_start)
LONG(0xe425c - code32init_start)
LONG(0xe42be - code32init_start)
LONG(0xe4310 - code32init_start)
LONG(0xe433b - code32init_start)
LONG(0xe434a - code32init_start)
LONG(0xe43d7 - code32init_start)
LONG(0xe459e - code32init_start)
LONG(0xe45a5 - code32init_start)
LONG(0xe4682 - code32init_start)
LONG(0xe4699 - code32init_start)
LONG(0xe4710 - code32init_start)
LONG(0xe4722 - code32init_start)
LONG(0xe473b - code32init_start)
LONG(0xe4925 - code32init_start)
LONG(0xe4947 - code32init_start)
LONG(0xe4958 - code32init_start)
LONG(0xe4969 - code32init_start)
LONG(0xe496e - code32init_start)
LONG(0xe4978 - code32init_start)
LONG(0xe497e - code32init_start)
LONG(0xe498a - code32init_start)
LONG(0xe499a - code32init_start)
LONG(0xe49a0 - code32init_start)
LONG(0xe49f0 - code32init_start)
LONG(0xe4a05 - code32init_start)
LONG(0xe4b10 - code32init_start)
LONG(0xe4b2d - code32init_start)
LONG(0xe4b40 - code32init_start)
LONG(0xe4bfa - code32init_start)
LONG(0xe4c12 - code32init_start)
LONG(0xe4c93 - code32init_start)
LONG(0xe4c98 - code32init_start)
LONG(0xe4c9f - code32init_start)
LONG(0xe4ca4 - code32init_start)
LONG(0xe4d58 - code32init_start)
LONG(0xe4de2 - code32init_start)
LONG(0xe4e34 - code32init_start)
LONG(0xe4e38 - code32init_start)
LONG(0xe4e3c - code32init_start)
LONG(0xe4e40 - code32init_start)
LONG(0xe4e44 - code32init_start)
LONG(0xe4e48 - code32init_start)
LONG(0xe4e4c - code32init_start)
LONG(0xe4e50 - code32init_start)
LONG(0xe4e54 - code32init_start)
LONG(0xe4e58 - code32init_start)
LONG(0xe4e5c - code32init_start)
LONG(0xe4e60 - code32init_start)
LONG(0xe4e64 - code32init_start)
LONG(0xe4e68 - code32init_start)
LONG(0xe4e6c - code32init_start)
LONG(0xe4e70 - code32init_start)
LONG(0xe4e74 - code32init_start)
LONG(0xe4e78 - code32init_start)
LONG(0xe4e7c - code32init_start)
LONG(0xe4e80 - code32init_start)
LONG(0xe4e84 - code32init_start)
LONG(0xe4e88 - code32init_start)
LONG(0xe4e8c - code32init_start)
LONG(0xe4e90 - code32init_start)
LONG(0xe4e94 - code32init_start)
LONG(0xe4e98 - code32init_start)
LONG(0xe4e9c - code32init_start)
LONG(0xe4ea0 - code32init_start)
LONG(0xe4ea4 - code32init_start)
LONG(0xe4ea8 - code32init_start)
LONG(0xe4eac - code32init_start)
LONG(0xe4eb0 - code32init_start)
LONG(0xe4eb4 - code32init_start)
LONG(0xe4eb8 - code32init_start)
LONG(0xe4ebc - code32init_start)
LONG(0xe4ec0 - code32init_start)
LONG(0xe4ec4 - code32init_start)
LONG(0xe4ec8 - code32init_start)
LONG(0xe4ecc - code32init_start)
LONG(0xe4ed0 - code32init_start)
LONG(0xe4ed4 - code32init_start)
LONG(0xe4ed8 - code32init_start)
LONG(0xe4edc - code32init_start)
LONG(0xe4ee0 - code32init_start)
LONG(0xe4ee4 - code32init_start)
LONG(0xe4ee8 - code32init_start)
LONG(0xe4eec - code32init_start)
LONG(0xe4ef0 - code32init_start)
LONG(0xe4ef4 - code32init_start)
LONG(0xe4ef8 - code32init_start)
LONG(0xe4efc - code32init_start)
LONG(0xe4f00 - code32init_start)
LONG(0xe4f04 - code32init_start)
LONG(0xe4f08 - code32init_start)
LONG(0xe4f0c - code32init_start)
LONG(0xe4f10 - code32init_start)
LONG(0xe4f14 - code32init_start)
LONG(0xe4f18 - code32init_start)
LONG(0xe4f1c - code32init_start)
LONG(0xe4f20 - code32init_start)
LONG(0xe4f24 - code32init_start)
LONG(0xe4f28 - code32init_start)
LONG(0xe4f2c - code32init_start)
LONG(0xe4f30 - code32init_start)
LONG(0xe4f34 - code32init_start)
LONG(0xe4f38 - code32init_start)
LONG(0xe4f3c - code32init_start)
LONG(0xe4f40 - code32init_start)
LONG(0xe5990 - code32init_start)
LONG(0xe59a4 - code32init_start)
LONG(0xe59d0 - code32init_start)
LONG(0xe59e4 - code32init_start)
LONG(0xe5a10 - code32init_start)
LONG(0xe5a24 - code32init_start)
LONG(0xe5a38 - code32init_start)
LONG(0xe5a4c - code32init_start)
LONG(0xe5a60 - code32init_start)
LONG(0xe5a74 - code32init_start)
LONG(0xe5a88 - code32init_start)
LONG(0xe5a9c - code32init_start)
LONG(0xe5ab0 - code32init_start)
LONG(0xe5ac4 - code32init_start)
LONG(0xe5ad8 - code32init_start)
LONG(0xe5aec - code32init_start)
LONG(0xe5b00 - code32init_start)
LONG(0xe5c30 - code32init_start)
LONG(0xe5c44 - code32init_start)
LONG(0xe5dd8 - code32init_start)
LONG(0xe5e00 - code32init_start)
LONG(0xe5e04 - code32init_start)
LONG(0xe5e0c - code32init_start)
LONG(0xe5e10 - code32init_start)
LONG(0xe5e14 - code32init_start)
LONG(0xe5e18 - code32init_start)
LONG(0xe5e1c - code32init_start)
LONG(0xe5ea4 - code32init_start)
LONG(0xe5ea8 - code32init_start)
LONG(0xe5eac - code32init_start)
LONG(0xe5eb0 - code32init_start)
LONG(0xe5eb4 - code32init_start)
LONG(0xe5ee4 - code32init_start)
LONG(0xe5ee8 - code32init_start)
LONG(0xe5ef0 - code32init_start)
LONG(0xe5ef4 - code32init_start)
LONG(0xe5ef8 - code32init_start)
LONG(0xe5f00 - code32init_start)
LONG(0xe5f04 - code32init_start)
LONG(0xe5f08 - code32init_start)
LONG(0xe5f10 - code32init_start)
        _reloc_abs_end = ABSOLUTE(.) ;
        _reloc_rel_start = ABSOLUTE(.) ;
LONG(0xd03c3 - code32init_start)
LONG(0xd0403 - code32init_start)
LONG(0xd041b - code32init_start)
LONG(0xd043b - code32init_start)
LONG(0xd044b - code32init_start)
LONG(0xd0473 - code32init_start)
LONG(0xd048b - code32init_start)
LONG(0xd0758 - code32init_start)
LONG(0xd07d5 - code32init_start)
LONG(0xd07f1 - code32init_start)
LONG(0xd0817 - code32init_start)
LONG(0xd082e - code32init_start)
LONG(0xd0b59 - code32init_start)
LONG(0xd0b66 - code32init_start)
LONG(0xd0b73 - code32init_start)
LONG(0xd0e2c - code32init_start)
LONG(0xd0f12 - code32init_start)
LONG(0xd0f23 - code32init_start)
LONG(0xd0f3a - code32init_start)
LONG(0xd0f5c - code32init_start)
LONG(0xd0f6d - code32init_start)
LONG(0xd0f81 - code32init_start)
LONG(0xd0f92 - code32init_start)
LONG(0xd0fa6 - code32init_start)
LONG(0xd0fec - code32init_start)
LONG(0xd0fff - code32init_start)
LONG(0xd1014 - code32init_start)
LONG(0xd1043 - code32init_start)
LONG(0xd1056 - code32init_start)
LONG(0xd106b - code32init_start)
LONG(0xd1084 - code32init_start)
LONG(0xd109d - code32init_start)
LONG(0xd1131 - code32init_start)
LONG(0xd1193 - code32init_start)
LONG(0xd1718 - code32init_start)
LONG(0xd175b - code32init_start)
LONG(0xd177b - code32init_start)
LONG(0xd17a2 - code32init_start)
LONG(0xd17c8 - code32init_start)
LONG(0xd17dc - code32init_start)
LONG(0xd1857 - code32init_start)
LONG(0xd1869 - code32init_start)
LONG(0xd1895 - code32init_start)
LONG(0xd18b4 - code32init_start)
LONG(0xd1912 - code32init_start)
LONG(0xd198d - code32init_start)
LONG(0xd19a2 - code32init_start)
LONG(0xd1e63 - code32init_start)
LONG(0xd1ed8 - code32init_start)
LONG(0xd1f16 - code32init_start)
LONG(0xd1fad - code32init_start)
LONG(0xd1fc0 - code32init_start)
LONG(0xd1fd9 - code32init_start)
LONG(0xd1ff1 - code32init_start)
LONG(0xd203f - code32init_start)
LONG(0xd20ab - code32init_start)
LONG(0xd20c5 - code32init_start)
LONG(0xd20de - code32init_start)
LONG(0xd215c - code32init_start)
LONG(0xd218c - code32init_start)
LONG(0xd219c - code32init_start)
LONG(0xd21b5 - code32init_start)
LONG(0xd2215 - code32init_start)
LONG(0xd2225 - code32init_start)
LONG(0xd2232 - code32init_start)
LONG(0xd2261 - code32init_start)
LONG(0xd228d - code32init_start)
LONG(0xd2296 - code32init_start)
LONG(0xd229f - code32init_start)
LONG(0xd2361 - code32init_start)
LONG(0xd237b - code32init_start)
LONG(0xd238e - code32init_start)
LONG(0xd23a5 - code32init_start)
LONG(0xd23b3 - code32init_start)
LONG(0xd23dc - code32init_start)
LONG(0xd2403 - code32init_start)
LONG(0xd2413 - code32init_start)
LONG(0xd2419 - code32init_start)
LONG(0xd245f - code32init_start)
LONG(0xd2476 - code32init_start)
LONG(0xd2485 - code32init_start)
LONG(0xd24cf - code32init_start)
LONG(0xd24e8 - code32init_start)
LONG(0xd2507 - code32init_start)
LONG(0xd2542 - code32init_start)
LONG(0xd262c - code32init_start)
LONG(0xd269d - code32init_start)
LONG(0xd26ac - code32init_start)
LONG(0xd26f0 - code32init_start)
LONG(0xd27d2 - code32init_start)
LONG(0xd27e3 - code32init_start)
LONG(0xd2893 - code32init_start)
LONG(0xd2a52 - code32init_start)
LONG(0xd2a63 - code32init_start)
LONG(0xd2b99 - code32init_start)
LONG(0xd2bc7 - code32init_start)
LONG(0xd2c04 - code32init_start)
LONG(0xd2c30 - code32init_start)
LONG(0xd2c74 - code32init_start)
LONG(0xd2d46 - code32init_start)
LONG(0xd2e18 - code32init_start)
LONG(0xd2eb9 - code32init_start)
LONG(0xd2f6e - code32init_start)
LONG(0xd2f84 - code32init_start)
LONG(0xd2f97 - code32init_start)
LONG(0xd2fa7 - code32init_start)
LONG(0xd2fd4 - code32init_start)
LONG(0xd2fe5 - code32init_start)
LONG(0xd2ffc - code32init_start)
LONG(0xd3003 - code32init_start)
LONG(0xd3017 - code32init_start)
LONG(0xd301e - code32init_start)
LONG(0xd3031 - code32init_start)
LONG(0xd3040 - code32init_start)
LONG(0xd3052 - code32init_start)
LONG(0xd306a - code32init_start)
LONG(0xd307b - code32init_start)
LONG(0xd308e - code32init_start)
LONG(0xd3098 - code32init_start)
LONG(0xd32d6 - code32init_start)
LONG(0xd330a - code32init_start)
LONG(0xd334d - code32init_start)
LONG(0xd3360 - code32init_start)
LONG(0xd3369 - code32init_start)
LONG(0xd3480 - code32init_start)
LONG(0xd34a1 - code32init_start)
LONG(0xd34c4 - code32init_start)
LONG(0xd34f4 - code32init_start)
LONG(0xd34f9 - code32init_start)
LONG(0xd3516 - code32init_start)
LONG(0xd353b - code32init_start)
LONG(0xd3551 - code32init_start)
LONG(0xd356b - code32init_start)
LONG(0xd3583 - code32init_start)
LONG(0xd3594 - code32init_start)
LONG(0xd35ab - code32init_start)
LONG(0xd35d3 - code32init_start)
LONG(0xd35e4 - code32init_start)
LONG(0xd35f9 - code32init_start)
LONG(0xd3621 - code32init_start)
LONG(0xd3633 - code32init_start)
LONG(0xd3646 - code32init_start)
LONG(0xd3650 - code32init_start)
LONG(0xd3664 - code32init_start)
LONG(0xd3699 - code32init_start)
LONG(0xd36d1 - code32init_start)
LONG(0xd3716 - code32init_start)
LONG(0xd3735 - code32init_start)
LONG(0xd374a - code32init_start)
LONG(0xd3868 - code32init_start)
LONG(0xd3b4a - code32init_start)
LONG(0xd3b82 - code32init_start)
LONG(0xd3ba2 - code32init_start)
LONG(0xd3bc3 - code32init_start)
LONG(0xd3bd1 - code32init_start)
LONG(0xd3bf5 - code32init_start)
LONG(0xd3c56 - code32init_start)
LONG(0xd3c6b - code32init_start)
LONG(0xd3c83 - code32init_start)
LONG(0xd3c96 - code32init_start)
LONG(0xd3c9d - code32init_start)
LONG(0xd3cc0 - code32init_start)
LONG(0xd3cea - code32init_start)
LONG(0xd3d42 - code32init_start)
LONG(0xd3d5e - code32init_start)
LONG(0xd3d82 - code32init_start)
LONG(0xd3d9b - code32init_start)
LONG(0xd3daf - code32init_start)
LONG(0xd3dd8 - code32init_start)
LONG(0xd3de6 - code32init_start)
LONG(0xd3df8 - code32init_start)
LONG(0xd3e24 - code32init_start)
LONG(0xd3e50 - code32init_start)
LONG(0xd3e67 - code32init_start)
LONG(0xd3e78 - code32init_start)
LONG(0xd3e86 - code32init_start)
LONG(0xd3e99 - code32init_start)
LONG(0xd3ecd - code32init_start)
LONG(0xd3ee3 - code32init_start)
LONG(0xd3efb - code32init_start)
LONG(0xd3f08 - code32init_start)
LONG(0xd3f1e - code32init_start)
LONG(0xd3f2d - code32init_start)
LONG(0xd3f3d - code32init_start)
LONG(0xd3f4c - code32init_start)
LONG(0xd3f6c - code32init_start)
LONG(0xd3f80 - code32init_start)
LONG(0xd3f90 - code32init_start)
LONG(0xd3f9f - code32init_start)
LONG(0xd3fb5 - code32init_start)
LONG(0xd3fec - code32init_start)
LONG(0xd4015 - code32init_start)
LONG(0xd4036 - code32init_start)
LONG(0xd4056 - code32init_start)
LONG(0xd4071 - code32init_start)
LONG(0xd4085 - code32init_start)
LONG(0xd40a0 - code32init_start)
LONG(0xd40b2 - code32init_start)
LONG(0xd40fa - code32init_start)
LONG(0xd41a6 - code32init_start)
LONG(0xd4203 - code32init_start)
LONG(0xd4211 - code32init_start)
LONG(0xd422f - code32init_start)
LONG(0xd423d - code32init_start)
LONG(0xd4263 - code32init_start)
LONG(0xd4281 - code32init_start)
LONG(0xd42a4 - code32init_start)
LONG(0xd42c2 - code32init_start)
LONG(0xd42d2 - code32init_start)
LONG(0xd42e2 - code32init_start)
LONG(0xd4343 - code32init_start)
LONG(0xd436f - code32init_start)
LONG(0xd4399 - code32init_start)
LONG(0xd43b6 - code32init_start)
LONG(0xd44cf - code32init_start)
LONG(0xd44f3 - code32init_start)
LONG(0xd45ac - code32init_start)
LONG(0xd45ba - code32init_start)
LONG(0xd45eb - code32init_start)
LONG(0xd4606 - code32init_start)
LONG(0xd4636 - code32init_start)
LONG(0xd4679 - code32init_start)
LONG(0xd469d - code32init_start)
LONG(0xd46ab - code32init_start)
LONG(0xd46c8 - code32init_start)
LONG(0xd4703 - code32init_start)
LONG(0xd4792 - code32init_start)
LONG(0xd47d3 - code32init_start)
LONG(0xd47e6 - code32init_start)
LONG(0xd484b - code32init_start)
LONG(0xd486d - code32init_start)
LONG(0xd489f - code32init_start)
LONG(0xd48b5 - code32init_start)
LONG(0xd48c4 - code32init_start)
LONG(0xd48ce - code32init_start)
LONG(0xd48e1 - code32init_start)
LONG(0xd48fe - code32init_start)
LONG(0xd490e - code32init_start)
LONG(0xd4929 - code32init_start)
LONG(0xd4985 - code32init_start)
LONG(0xd4aa6 - code32init_start)
LONG(0xd4ad7 - code32init_start)
LONG(0xd4aec - code32init_start)
LONG(0xd4b03 - code32init_start)
LONG(0xd4b17 - code32init_start)
LONG(0xd4b24 - code32init_start)
LONG(0xd4b32 - code32init_start)
LONG(0xd4b71 - code32init_start)
LONG(0xd4b89 - code32init_start)
LONG(0xd4ba1 - code32init_start)
LONG(0xd4bd7 - code32init_start)
LONG(0xd4c07 - code32init_start)
LONG(0xd4c1a - code32init_start)
LONG(0xd4c4e - code32init_start)
LONG(0xd4c5d - code32init_start)
LONG(0xd4c7a - code32init_start)
LONG(0xd4c8b - code32init_start)
LONG(0xd4ccd - code32init_start)
LONG(0xd4ee4 - code32init_start)
LONG(0xd4eee - code32init_start)
LONG(0xd4f1a - code32init_start)
LONG(0xd4f27 - code32init_start)
LONG(0xd4fb6 - code32init_start)
LONG(0xd501d - code32init_start)
LONG(0xd5043 - code32init_start)
LONG(0xd5094 - code32init_start)
LONG(0xd50a2 - code32init_start)
LONG(0xd50e0 - code32init_start)
LONG(0xd512c - code32init_start)
LONG(0xd516f - code32init_start)
LONG(0xd517d - code32init_start)
LONG(0xd5254 - code32init_start)
LONG(0xd5262 - code32init_start)
LONG(0xd526f - code32init_start)
LONG(0xd527c - code32init_start)
LONG(0xd52fe - code32init_start)
LONG(0xd533a - code32init_start)
LONG(0xd539c - code32init_start)
LONG(0xd53c0 - code32init_start)
LONG(0xd53e6 - code32init_start)
LONG(0xd53f4 - code32init_start)
LONG(0xd5413 - code32init_start)
LONG(0xd5482 - code32init_start)
LONG(0xd5495 - code32init_start)
LONG(0xd54af - code32init_start)
LONG(0xd54c7 - code32init_start)
LONG(0xd5521 - code32init_start)
LONG(0xd5533 - code32init_start)
LONG(0xd555f - code32init_start)
LONG(0xd558b - code32init_start)
LONG(0xd561e - code32init_start)
LONG(0xd5631 - code32init_start)
LONG(0xd563e - code32init_start)
LONG(0xd568e - code32init_start)
LONG(0xd56ab - code32init_start)
LONG(0xd56be - code32init_start)
LONG(0xd573f - code32init_start)
LONG(0xd5777 - code32init_start)
LONG(0xd57a1 - code32init_start)
LONG(0xd57c4 - code32init_start)
LONG(0xd58a1 - code32init_start)
LONG(0xd58bd - code32init_start)
LONG(0xd58d6 - code32init_start)
LONG(0xd58e9 - code32init_start)
LONG(0xd58f9 - code32init_start)
LONG(0xd5911 - code32init_start)
LONG(0xd595f - code32init_start)
LONG(0xd59e0 - code32init_start)
LONG(0xd5a0f - code32init_start)
LONG(0xd5a37 - code32init_start)
LONG(0xd5ad0 - code32init_start)
LONG(0xd5ae3 - code32init_start)
LONG(0xd5b36 - code32init_start)
LONG(0xd5b4a - code32init_start)
LONG(0xd5b5c - code32init_start)
LONG(0xd5b66 - code32init_start)
LONG(0xd5b7a - code32init_start)
LONG(0xd5b8f - code32init_start)
LONG(0xd5ba0 - code32init_start)
LONG(0xd5bba - code32init_start)
LONG(0xd5bc4 - code32init_start)
LONG(0xd5bda - code32init_start)
LONG(0xd5be6 - code32init_start)
LONG(0xd5bfa - code32init_start)
LONG(0xd5c09 - code32init_start)
LONG(0xd5c1c - code32init_start)
LONG(0xd5c2a - code32init_start)
LONG(0xd5c3a - code32init_start)
LONG(0xd5c51 - code32init_start)
LONG(0xd5c60 - code32init_start)
LONG(0xd5c77 - code32init_start)
LONG(0xd5c9b - code32init_start)
LONG(0xd5cae - code32init_start)
LONG(0xd5e70 - code32init_start)
LONG(0xd5e7f - code32init_start)
LONG(0xd5ea4 - code32init_start)
LONG(0xd5ec6 - code32init_start)
LONG(0xd5eec - code32init_start)
LONG(0xd5f03 - code32init_start)
LONG(0xd5f1e - code32init_start)
LONG(0xd5f35 - code32init_start)
LONG(0xd5f67 - code32init_start)
LONG(0xd5ffd - code32init_start)
LONG(0xd6021 - code32init_start)
LONG(0xd60ae - code32init_start)
LONG(0xd60be - code32init_start)
LONG(0xd613c - code32init_start)
LONG(0xd6148 - code32init_start)
LONG(0xd619e - code32init_start)
LONG(0xd61ae - code32init_start)
LONG(0xd61ca - code32init_start)
LONG(0xd61e2 - code32init_start)
LONG(0xd621e - code32init_start)
LONG(0xd626c - code32init_start)
LONG(0xd62a1 - code32init_start)
LONG(0xd62b2 - code32init_start)
LONG(0xd635e - code32init_start)
LONG(0xd637a - code32init_start)
LONG(0xd63ee - code32init_start)
LONG(0xd643a - code32init_start)
LONG(0xd6487 - code32init_start)
LONG(0xd64a9 - code32init_start)
LONG(0xd64d6 - code32init_start)
LONG(0xd64eb - code32init_start)
LONG(0xd64f5 - code32init_start)
LONG(0xd657e - code32init_start)
LONG(0xd6595 - code32init_start)
LONG(0xd660e - code32init_start)
LONG(0xd6619 - code32init_start)
LONG(0xd6630 - code32init_start)
LONG(0xd6649 - code32init_start)
LONG(0xd665b - code32init_start)
LONG(0xd6668 - code32init_start)
LONG(0xd6679 - code32init_start)
LONG(0xd6798 - code32init_start)
LONG(0xd681c - code32init_start)
LONG(0xd6826 - code32init_start)
LONG(0xd6858 - code32init_start)
LONG(0xd6866 - code32init_start)
LONG(0xd6876 - code32init_start)
LONG(0xd688b - code32init_start)
LONG(0xd689b - code32init_start)
LONG(0xd68a9 - code32init_start)
LONG(0xd68d4 - code32init_start)
LONG(0xd693c - code32init_start)
LONG(0xd6956 - code32init_start)
LONG(0xd6963 - code32init_start)
LONG(0xd6976 - code32init_start)
LONG(0xd6a49 - code32init_start)
LONG(0xd6ad3 - code32init_start)
LONG(0xd6b02 - code32init_start)
LONG(0xd6b6e - code32init_start)
LONG(0xd6b8b - code32init_start)
LONG(0xd6bff - code32init_start)
LONG(0xd6e6a - code32init_start)
LONG(0xd6ec4 - code32init_start)
LONG(0xd6eeb - code32init_start)
LONG(0xd6efa - code32init_start)
LONG(0xd6f1b - code32init_start)
LONG(0xd6f26 - code32init_start)
LONG(0xd6f73 - code32init_start)
LONG(0xd6f86 - code32init_start)
LONG(0xd6fab - code32init_start)
LONG(0xd6fe2 - code32init_start)
LONG(0xd6ff0 - code32init_start)
LONG(0xd7016 - code32init_start)
LONG(0xd70ae - code32init_start)
LONG(0xd70c6 - code32init_start)
LONG(0xd70d3 - code32init_start)
LONG(0xd70e0 - code32init_start)
LONG(0xd70ed - code32init_start)
LONG(0xd7105 - code32init_start)
LONG(0xd722e - code32init_start)
LONG(0xd726f - code32init_start)
LONG(0xd72ca - code32init_start)
LONG(0xd72f7 - code32init_start)
LONG(0xd7388 - code32init_start)
LONG(0xd739b - code32init_start)
LONG(0xd73de - code32init_start)
LONG(0xd73f7 - code32init_start)
LONG(0xd741c - code32init_start)
LONG(0xd743a - code32init_start)
LONG(0xd745a - code32init_start)
LONG(0xd746b - code32init_start)
LONG(0xd7484 - code32init_start)
LONG(0xd74aa - code32init_start)
LONG(0xd74e3 - code32init_start)
LONG(0xd74f5 - code32init_start)
LONG(0xd7584 - code32init_start)
LONG(0xd75b0 - code32init_start)
LONG(0xd75c5 - code32init_start)
LONG(0xd75e0 - code32init_start)
LONG(0xd75f5 - code32init_start)
LONG(0xd7613 - code32init_start)
LONG(0xd7628 - code32init_start)
LONG(0xd763d - code32init_start)
LONG(0xd765a - code32init_start)
LONG(0xd7678 - code32init_start)
LONG(0xd769f - code32init_start)
LONG(0xd76b4 - code32init_start)
LONG(0xd76cf - code32init_start)
LONG(0xd76e4 - code32init_start)
LONG(0xd7702 - code32init_start)
LONG(0xd7717 - code32init_start)
LONG(0xd772c - code32init_start)
LONG(0xd773d - code32init_start)
LONG(0xd7763 - code32init_start)
LONG(0xd7798 - code32init_start)
LONG(0xd77c1 - code32init_start)
LONG(0xd77cf - code32init_start)
LONG(0xd783b - code32init_start)
LONG(0xd7863 - code32init_start)
LONG(0xd7887 - code32init_start)
LONG(0xd789d - code32init_start)
LONG(0xd78cd - code32init_start)
LONG(0xd78e6 - code32init_start)
LONG(0xd7907 - code32init_start)
LONG(0xd791a - code32init_start)
LONG(0xd7931 - code32init_start)
LONG(0xd7948 - code32init_start)
LONG(0xd79d5 - code32init_start)
LONG(0xd79fe - code32init_start)
LONG(0xd7a0c - code32init_start)
LONG(0xd7aa4 - code32init_start)
LONG(0xd7ac8 - code32init_start)
LONG(0xd7ade - code32init_start)
LONG(0xd7b0c - code32init_start)
LONG(0xd7b37 - code32init_start)
LONG(0xd7b4a - code32init_start)
LONG(0xd7b61 - code32init_start)
LONG(0xd7b78 - code32init_start)
LONG(0xd7ba7 - code32init_start)
LONG(0xd7bcc - code32init_start)
LONG(0xd7c48 - code32init_start)
LONG(0xd7c61 - code32init_start)
LONG(0xd7d40 - code32init_start)
LONG(0xd7d53 - code32init_start)
LONG(0xd7dd2 - code32init_start)
LONG(0xd7e3c - code32init_start)
LONG(0xd7e70 - code32init_start)
LONG(0xd7e9e - code32init_start)
LONG(0xd7eee - code32init_start)
LONG(0xd7f00 - code32init_start)
LONG(0xd7f2e - code32init_start)
LONG(0xd7f4f - code32init_start)
LONG(0xd7f5f - code32init_start)
LONG(0xd8075 - code32init_start)
LONG(0xd809a - code32init_start)
LONG(0xd80a5 - code32init_start)
LONG(0xd80b4 - code32init_start)
LONG(0xd80e1 - code32init_start)
LONG(0xd81b1 - code32init_start)
LONG(0xd81d3 - code32init_start)
LONG(0xd8203 - code32init_start)
LONG(0xd8231 - code32init_start)
LONG(0xd8244 - code32init_start)
LONG(0xd8275 - code32init_start)
LONG(0xd82ad - code32init_start)
LONG(0xd82c5 - code32init_start)
LONG(0xd82f2 - code32init_start)
LONG(0xd8301 - code32init_start)
LONG(0xd8326 - code32init_start)
LONG(0xd8384 - code32init_start)
LONG(0xd839c - code32init_start)
LONG(0xd83ae - code32init_start)
LONG(0xd83e6 - code32init_start)
LONG(0xd83f7 - code32init_start)
LONG(0xd8430 - code32init_start)
LONG(0xd8465 - code32init_start)
LONG(0xd848a - code32init_start)
LONG(0xd8499 - code32init_start)
LONG(0xd84b2 - code32init_start)
LONG(0xd8505 - code32init_start)
LONG(0xd8551 - code32init_start)
LONG(0xd855d - code32init_start)
LONG(0xd8569 - code32init_start)
LONG(0xd8589 - code32init_start)
LONG(0xd85d2 - code32init_start)
LONG(0xd8609 - code32init_start)
LONG(0xd8640 - code32init_start)
LONG(0xd8668 - code32init_start)
LONG(0xd8698 - code32init_start)
LONG(0xd8735 - code32init_start)
LONG(0xd8752 - code32init_start)
LONG(0xd8763 - code32init_start)
LONG(0xd87cc - code32init_start)
LONG(0xd8801 - code32init_start)
LONG(0xd8842 - code32init_start)
LONG(0xd885f - code32init_start)
LONG(0xd8882 - code32init_start)
LONG(0xd88a9 - code32init_start)
LONG(0xd88bc - code32init_start)
LONG(0xd88f0 - code32init_start)
LONG(0xd8929 - code32init_start)
LONG(0xd895b - code32init_start)
LONG(0xd89b8 - code32init_start)
LONG(0xd8a46 - code32init_start)
LONG(0xd8b08 - code32init_start)
LONG(0xd8b55 - code32init_start)
LONG(0xd8b61 - code32init_start)
LONG(0xd8bba - code32init_start)
LONG(0xd8c16 - code32init_start)
LONG(0xd8c24 - code32init_start)
LONG(0xd8ca1 - code32init_start)
LONG(0xd8cc2 - code32init_start)
LONG(0xd8ce8 - code32init_start)
LONG(0xd8d11 - code32init_start)
LONG(0xd8d23 - code32init_start)
LONG(0xd8e3b - code32init_start)
LONG(0xd8e97 - code32init_start)
LONG(0xd8f22 - code32init_start)
LONG(0xd8f4a - code32init_start)
LONG(0xd8fea - code32init_start)
LONG(0xd8ffd - code32init_start)
LONG(0xd9082 - code32init_start)
LONG(0xd90e2 - code32init_start)
LONG(0xd91bd - code32init_start)
LONG(0xd91d6 - code32init_start)
LONG(0xd9283 - code32init_start)
LONG(0xd92a3 - code32init_start)
LONG(0xd92bf - code32init_start)
LONG(0xd92d9 - code32init_start)
LONG(0xd92e9 - code32init_start)
LONG(0xd930d - code32init_start)
LONG(0xd932d - code32init_start)
LONG(0xd9351 - code32init_start)
LONG(0xd9366 - code32init_start)
LONG(0xd9370 - code32init_start)
LONG(0xd9383 - code32init_start)
LONG(0xd938d - code32init_start)
LONG(0xd93b4 - code32init_start)
LONG(0xd93bf - code32init_start)
LONG(0xd93c4 - code32init_start)
LONG(0xd9407 - code32init_start)
LONG(0xd9430 - code32init_start)
LONG(0xd9450 - code32init_start)
LONG(0xd950b - code32init_start)
LONG(0xd95ac - code32init_start)
LONG(0xd95c8 - code32init_start)
LONG(0xd95e3 - code32init_start)
LONG(0xd95fd - code32init_start)
LONG(0xd9602 - code32init_start)
LONG(0xd965d - code32init_start)
LONG(0xd9670 - code32init_start)
LONG(0xd967d - code32init_start)
LONG(0xd9704 - code32init_start)
LONG(0xd971b - code32init_start)
LONG(0xd972f - code32init_start)
LONG(0xd9743 - code32init_start)
LONG(0xd974c - code32init_start)
LONG(0xd9792 - code32init_start)
LONG(0xd97c8 - code32init_start)
LONG(0xd97d9 - code32init_start)
LONG(0xd97f2 - code32init_start)
LONG(0xd9817 - code32init_start)
LONG(0xd9828 - code32init_start)
LONG(0xd9853 - code32init_start)
LONG(0xd98ac - code32init_start)
LONG(0xd990d - code32init_start)
LONG(0xd991a - code32init_start)
LONG(0xd995c - code32init_start)
LONG(0xd9983 - code32init_start)
LONG(0xd99f9 - code32init_start)
LONG(0xd9a17 - code32init_start)
LONG(0xd9a3c - code32init_start)
LONG(0xd9a47 - code32init_start)
LONG(0xd9a65 - code32init_start)
LONG(0xd9ab7 - code32init_start)
LONG(0xd9ae3 - code32init_start)
LONG(0xd9aeb - code32init_start)
LONG(0xd9af6 - code32init_start)
LONG(0xd9b17 - code32init_start)
LONG(0xd9b65 - code32init_start)
LONG(0xd9bbd - code32init_start)
LONG(0xd9c0e - code32init_start)
LONG(0xd9c1f - code32init_start)
LONG(0xd9c7c - code32init_start)
LONG(0xd9cca - code32init_start)
LONG(0xd9d16 - code32init_start)
LONG(0xd9d61 - code32init_start)
LONG(0xd9d84 - code32init_start)
LONG(0xd9d92 - code32init_start)
LONG(0xd9dbb - code32init_start)
LONG(0xd9ddc - code32init_start)
LONG(0xd9dea - code32init_start)
LONG(0xd9dfe - code32init_start)
LONG(0xd9e50 - code32init_start)
LONG(0xd9e9c - code32init_start)
LONG(0xd9ec6 - code32init_start)
LONG(0xda1c4 - code32init_start)
LONG(0xda211 - code32init_start)
LONG(0xda285 - code32init_start)
LONG(0xda29b - code32init_start)
LONG(0xda2bf - code32init_start)
LONG(0xda2e7 - code32init_start)
LONG(0xda373 - code32init_start)
LONG(0xda474 - code32init_start)
LONG(0xda4b0 - code32init_start)
LONG(0xda4c2 - code32init_start)
LONG(0xda52a - code32init_start)
LONG(0xda6aa - code32init_start)
LONG(0xda707 - code32init_start)
LONG(0xda719 - code32init_start)
LONG(0xda74d - code32init_start)
LONG(0xda760 - code32init_start)
LONG(0xda789 - code32init_start)
LONG(0xda79c - code32init_start)
LONG(0xda7b3 - code32init_start)
LONG(0xda7c6 - code32init_start)
LONG(0xda7ef - code32init_start)
LONG(0xda802 - code32init_start)
LONG(0xda876 - code32init_start)
LONG(0xda8b3 - code32init_start)
LONG(0xda8ca - code32init_start)
LONG(0xda919 - code32init_start)
LONG(0xda947 - code32init_start)
LONG(0xdaa52 - code32init_start)
LONG(0xdaa6b - code32init_start)
LONG(0xdaaa7 - code32init_start)
LONG(0xdaac1 - code32init_start)
LONG(0xdaada - code32init_start)
LONG(0xdab2a - code32init_start)
LONG(0xdab39 - code32init_start)
LONG(0xdabd9 - code32init_start)
LONG(0xdabef - code32init_start)
LONG(0xdac16 - code32init_start)
LONG(0xdac47 - code32init_start)
LONG(0xdac8f - code32init_start)
LONG(0xdacbc - code32init_start)
LONG(0xdacc4 - code32init_start)
LONG(0xdacd4 - code32init_start)
LONG(0xdace1 - code32init_start)
LONG(0xdad3f - code32init_start)
LONG(0xdad5a - code32init_start)
LONG(0xdade3 - code32init_start)
LONG(0xdae27 - code32init_start)
LONG(0xdae33 - code32init_start)
LONG(0xdae79 - code32init_start)
LONG(0xdaf00 - code32init_start)
LONG(0xdaf43 - code32init_start)
LONG(0xdaf54 - code32init_start)
LONG(0xdaf6e - code32init_start)
LONG(0xdaf87 - code32init_start)
LONG(0xdafab - code32init_start)
LONG(0xdafcb - code32init_start)
LONG(0xdafdc - code32init_start)
LONG(0xdb024 - code32init_start)
LONG(0xdb087 - code32init_start)
LONG(0xdb0f4 - code32init_start)
LONG(0xdb115 - code32init_start)
LONG(0xdb146 - code32init_start)
LONG(0xdb1a6 - code32init_start)
LONG(0xdb1bd - code32init_start)
LONG(0xdb20f - code32init_start)
LONG(0xdb272 - code32init_start)
LONG(0xdb300 - code32init_start)
LONG(0xdb316 - code32init_start)
LONG(0xdb33c - code32init_start)
LONG(0xdb427 - code32init_start)
LONG(0xdb44c - code32init_start)
LONG(0xdb46a - code32init_start)
LONG(0xdb49d - code32init_start)
LONG(0xdb4d1 - code32init_start)
LONG(0xdb4f3 - code32init_start)
LONG(0xdb4fe - code32init_start)
LONG(0xdb520 - code32init_start)
LONG(0xdb535 - code32init_start)
LONG(0xdb654 - code32init_start)
LONG(0xdb7ff - code32init_start)
LONG(0xdbe5e - code32init_start)
LONG(0xdbf46 - code32init_start)
LONG(0xdbf69 - code32init_start)
LONG(0xdbfd8 - code32init_start)
LONG(0xdbff0 - code32init_start)
LONG(0xdc016 - code32init_start)
LONG(0xdc051 - code32init_start)
LONG(0xdc07f - code32init_start)
LONG(0xdc2ab - code32init_start)
LONG(0xdc3ac - code32init_start)
LONG(0xdc3c9 - code32init_start)
LONG(0xdc3f1 - code32init_start)
LONG(0xdc421 - code32init_start)
LONG(0xdc45b - code32init_start)
LONG(0xdc55f - code32init_start)
LONG(0xdc587 - code32init_start)
LONG(0xdc5a7 - code32init_start)
LONG(0xdc5ef - code32init_start)
LONG(0xdc633 - code32init_start)
LONG(0xdc63d - code32init_start)
LONG(0xdc6bf - code32init_start)
LONG(0xdc6da - code32init_start)
LONG(0xdc6f4 - code32init_start)
LONG(0xdc777 - code32init_start)
LONG(0xdc9e8 - code32init_start)
LONG(0xdc9fb - code32init_start)
LONG(0xdca89 - code32init_start)
LONG(0xdca99 - code32init_start)
LONG(0xdcb1a - code32init_start)
LONG(0xdcb51 - code32init_start)
LONG(0xdcbde - code32init_start)
LONG(0xdcbec - code32init_start)
LONG(0xdcc91 - code32init_start)
LONG(0xdcca5 - code32init_start)
LONG(0xdcce2 - code32init_start)
LONG(0xdcd2c - code32init_start)
LONG(0xdce25 - code32init_start)
LONG(0xdce87 - code32init_start)
LONG(0xdcee9 - code32init_start)
LONG(0xdcf81 - code32init_start)
LONG(0xdcf98 - code32init_start)
LONG(0xdcff8 - code32init_start)
LONG(0xdd047 - code32init_start)
LONG(0xdd098 - code32init_start)
LONG(0xdd0d4 - code32init_start)
LONG(0xdd0dd - code32init_start)
LONG(0xdd10c - code32init_start)
LONG(0xdd139 - code32init_start)
LONG(0xdd1cc - code32init_start)
LONG(0xdd25d - code32init_start)
LONG(0xdd27b - code32init_start)
LONG(0xdd3a7 - code32init_start)
LONG(0xdd401 - code32init_start)
LONG(0xdd485 - code32init_start)
LONG(0xdd52a - code32init_start)
LONG(0xdd5d9 - code32init_start)
LONG(0xdd636 - code32init_start)
LONG(0xdd6a6 - code32init_start)
LONG(0xdd749 - code32init_start)
LONG(0xdd76a - code32init_start)
LONG(0xdd775 - code32init_start)
LONG(0xdd780 - code32init_start)
LONG(0xdd851 - code32init_start)
LONG(0xdd8bb - code32init_start)
LONG(0xdd96d - code32init_start)
LONG(0xdd97b - code32init_start)
LONG(0xdd9ca - code32init_start)
LONG(0xdda92 - code32init_start)
LONG(0xddb2f - code32init_start)
LONG(0xddb97 - code32init_start)
LONG(0xddbab - code32init_start)
LONG(0xddbe1 - code32init_start)
LONG(0xddbf0 - code32init_start)
LONG(0xddc15 - code32init_start)
LONG(0xddc4a - code32init_start)
LONG(0xddc6a - code32init_start)
LONG(0xddc7a - code32init_start)
LONG(0xddca5 - code32init_start)
LONG(0xddced - code32init_start)
LONG(0xddd71 - code32init_start)
LONG(0xddd9d - code32init_start)
LONG(0xddde8 - code32init_start)
LONG(0xdde11 - code32init_start)
LONG(0xdde4b - code32init_start)
LONG(0xddea1 - code32init_start)
LONG(0xddf16 - code32init_start)
LONG(0xddf9f - code32init_start)
LONG(0xddfad - code32init_start)
LONG(0xddfe5 - code32init_start)
LONG(0xde066 - code32init_start)
LONG(0xde074 - code32init_start)
LONG(0xde08b - code32init_start)
LONG(0xde0a4 - code32init_start)
LONG(0xde0b8 - code32init_start)
LONG(0xde136 - code32init_start)
LONG(0xde144 - code32init_start)
LONG(0xde15a - code32init_start)
LONG(0xde1e4 - code32init_start)
LONG(0xde1f0 - code32init_start)
LONG(0xde259 - code32init_start)
LONG(0xde2ae - code32init_start)
LONG(0xde2b8 - code32init_start)
LONG(0xde344 - code32init_start)
LONG(0xde3ae - code32init_start)
LONG(0xde3c5 - code32init_start)
LONG(0xde3da - code32init_start)
LONG(0xde411 - code32init_start)
LONG(0xde454 - code32init_start)
LONG(0xde4b5 - code32init_start)
LONG(0xde4c6 - code32init_start)
LONG(0xde4d3 - code32init_start)
LONG(0xde4e0 - code32init_start)
LONG(0xde4f1 - code32init_start)
LONG(0xde505 - code32init_start)
LONG(0xde520 - code32init_start)
LONG(0xde533 - code32init_start)
LONG(0xde5ab - code32init_start)
LONG(0xde61e - code32init_start)
LONG(0xde630 - code32init_start)
LONG(0xde672 - code32init_start)
LONG(0xde69b - code32init_start)
LONG(0xde6dd - code32init_start)
LONG(0xde6ff - code32init_start)
LONG(0xde734 - code32init_start)
LONG(0xde769 - code32init_start)
LONG(0xde7dc - code32init_start)
LONG(0xde811 - code32init_start)
LONG(0xde859 - code32init_start)
LONG(0xde882 - code32init_start)
LONG(0xde8a4 - code32init_start)
LONG(0xde915 - code32init_start)
LONG(0xde933 - code32init_start)
LONG(0xde97c - code32init_start)
LONG(0xde9bd - code32init_start)
LONG(0xdea0b - code32init_start)
LONG(0xdea5b - code32init_start)
LONG(0xdeacd - code32init_start)
LONG(0xdeaf6 - code32init_start)
LONG(0xdeb4f - code32init_start)
LONG(0xdeba6 - code32init_start)
LONG(0xdebc7 - code32init_start)
LONG(0xdebfd - code32init_start)
LONG(0xdec1d - code32init_start)
LONG(0xdec3f - code32init_start)
LONG(0xdecb1 - code32init_start)
LONG(0xdecd1 - code32init_start)
LONG(0xdecda - code32init_start)
LONG(0xdecf4 - code32init_start)
LONG(0xdecfd - code32init_start)
LONG(0xded3b - code32init_start)
LONG(0xded58 - code32init_start)
LONG(0xdedec - code32init_start)
LONG(0xdee15 - code32init_start)
LONG(0xdee31 - code32init_start)
LONG(0xdeea2 - code32init_start)
LONG(0xdeeb3 - code32init_start)
LONG(0xdeeee - code32init_start)
LONG(0xdf08b - code32init_start)
LONG(0xdf09c - code32init_start)
LONG(0xdf0bd - code32init_start)
LONG(0xdf20d - code32init_start)
LONG(0xdf228 - code32init_start)
LONG(0xdf262 - code32init_start)
LONG(0xdf2d6 - code32init_start)
LONG(0xdf2f4 - code32init_start)
LONG(0xdf361 - code32init_start)
LONG(0xdf375 - code32init_start)
LONG(0xdf38e - code32init_start)
LONG(0xdf39e - code32init_start)
LONG(0xdf3c1 - code32init_start)
LONG(0xdf3d1 - code32init_start)
LONG(0xdf3f6 - code32init_start)
LONG(0xdf406 - code32init_start)
LONG(0xdf43b - code32init_start)
LONG(0xdf471 - code32init_start)
LONG(0xdf488 - code32init_start)
LONG(0xdf491 - code32init_start)
LONG(0xdf4c4 - code32init_start)
LONG(0xdf4dd - code32init_start)
LONG(0xdf505 - code32init_start)
LONG(0xdf5a4 - code32init_start)
LONG(0xdf5e6 - code32init_start)
LONG(0xdf60d - code32init_start)
LONG(0xdf66e - code32init_start)
LONG(0xdf6bc - code32init_start)
LONG(0xdf6d5 - code32init_start)
LONG(0xdf6f0 - code32init_start)
LONG(0xdf710 - code32init_start)
LONG(0xdf720 - code32init_start)
LONG(0xdf736 - code32init_start)
LONG(0xdf749 - code32init_start)
LONG(0xdf76a - code32init_start)
LONG(0xdf77e - code32init_start)
LONG(0xdf82a - code32init_start)
LONG(0xdf887 - code32init_start)
LONG(0xdf99e - code32init_start)
LONG(0xdf9ed - code32init_start)
LONG(0xdfa3b - code32init_start)
LONG(0xdfa72 - code32init_start)
LONG(0xdfb08 - code32init_start)
LONG(0xdfb3e - code32init_start)
LONG(0xdfb54 - code32init_start)
LONG(0xdfb67 - code32init_start)
LONG(0xdfb80 - code32init_start)
LONG(0xdfb90 - code32init_start)
LONG(0xdfc22 - code32init_start)
LONG(0xdfc31 - code32init_start)
LONG(0xdfc3e - code32init_start)
LONG(0xdfc4d - code32init_start)
LONG(0xdfcfc - code32init_start)
LONG(0xdfd15 - code32init_start)
LONG(0xdfd60 - code32init_start)
LONG(0xdfd8c - code32init_start)
LONG(0xdfdef - code32init_start)
LONG(0xdfe77 - code32init_start)
LONG(0xdfea3 - code32init_start)
LONG(0xdfeff - code32init_start)
LONG(0xdffb7 - code32init_start)
LONG(0xdffc9 - code32init_start)
LONG(0xdfff9 - code32init_start)
LONG(0xe008d - code32init_start)
LONG(0xe00ec - code32init_start)
LONG(0xe00fd - code32init_start)
LONG(0xe0117 - code32init_start)
LONG(0xe0142 - code32init_start)
LONG(0xe0153 - code32init_start)
LONG(0xe016c - code32init_start)
LONG(0xe0184 - code32init_start)
LONG(0xe01a2 - code32init_start)
LONG(0xe01b5 - code32init_start)
LONG(0xe01d0 - code32init_start)
LONG(0xe0205 - code32init_start)
LONG(0xe02c1 - code32init_start)
LONG(0xe0307 - code32init_start)
LONG(0xe03c2 - code32init_start)
LONG(0xe0438 - code32init_start)
LONG(0xe04b7 - code32init_start)
LONG(0xe05e3 - code32init_start)
LONG(0xe0683 - code32init_start)
LONG(0xe06c4 - code32init_start)
LONG(0xe078c - code32init_start)
LONG(0xe079a - code32init_start)
LONG(0xe07ed - code32init_start)
LONG(0xe082e - code32init_start)
LONG(0xe0877 - code32init_start)
LONG(0xe0958 - code32init_start)
LONG(0xe09c0 - code32init_start)
LONG(0xe09fd - code32init_start)
LONG(0xe0a8e - code32init_start)
LONG(0xe0abe - code32init_start)
LONG(0xe0b05 - code32init_start)
LONG(0xe0b4f - code32init_start)
LONG(0xe0bed - code32init_start)
LONG(0xe0c15 - code32init_start)
LONG(0xe0c98 - code32init_start)
LONG(0xe0cb4 - code32init_start)
LONG(0xe0d61 - code32init_start)
LONG(0xe0d7a - code32init_start)
LONG(0xe0dee - code32init_start)
LONG(0xe0e0b - code32init_start)
LONG(0xe0eb0 - code32init_start)
LONG(0xe0ecc - code32init_start)
LONG(0xe0f84 - code32init_start)
LONG(0xe0ff4 - code32init_start)
LONG(0xe10bc - code32init_start)
LONG(0xe10e0 - code32init_start)
LONG(0xe1173 - code32init_start)
LONG(0xe11b5 - code32init_start)
LONG(0xe11c6 - code32init_start)
LONG(0xe128a - code32init_start)
LONG(0xe129c - code32init_start)
LONG(0xe12a8 - code32init_start)
LONG(0xe12e7 - code32init_start)
LONG(0xe1300 - code32init_start)
LONG(0xe1328 - code32init_start)
LONG(0xe1362 - code32init_start)
LONG(0xe1373 - code32init_start)
LONG(0xe13c3 - code32init_start)
LONG(0xe1461 - code32init_start)
LONG(0xe1498 - code32init_start)
LONG(0xe1511 - code32init_start)
LONG(0xe15a4 - code32init_start)
LONG(0xe15c0 - code32init_start)
LONG(0xe15cd - code32init_start)
LONG(0xe15d6 - code32init_start)
LONG(0xe1613 - code32init_start)
LONG(0xe1641 - code32init_start)
LONG(0xe1652 - code32init_start)
LONG(0xe1672 - code32init_start)
LONG(0xe16b8 - code32init_start)
LONG(0xe16f3 - code32init_start)
LONG(0xe1720 - code32init_start)
LONG(0xe1778 - code32init_start)
LONG(0xe180c - code32init_start)
LONG(0xe1823 - code32init_start)
LONG(0xe18ad - code32init_start)
LONG(0xe18dd - code32init_start)
LONG(0xe18fa - code32init_start)
LONG(0xe193f - code32init_start)
LONG(0xe1954 - code32init_start)
LONG(0xe19bd - code32init_start)
LONG(0xe19dd - code32init_start)
LONG(0xe1a17 - code32init_start)
LONG(0xe1a32 - code32init_start)
LONG(0xe1a4a - code32init_start)
LONG(0xe1ab6 - code32init_start)
LONG(0xe1acf - code32init_start)
LONG(0xe1b42 - code32init_start)
LONG(0xe1b58 - code32init_start)
LONG(0xe1b71 - code32init_start)
LONG(0xe1bcc - code32init_start)
LONG(0xe1c21 - code32init_start)
LONG(0xe1c37 - code32init_start)
LONG(0xe1c49 - code32init_start)
LONG(0xe1c4e - code32init_start)
LONG(0xe1c83 - code32init_start)
LONG(0xe1cbf - code32init_start)
LONG(0xe1ce3 - code32init_start)
LONG(0xe1d25 - code32init_start)
LONG(0xe1d77 - code32init_start)
LONG(0xe1d81 - code32init_start)
LONG(0xe1dcc - code32init_start)
LONG(0xe1df5 - code32init_start)
LONG(0xe1e41 - code32init_start)
LONG(0xe1e82 - code32init_start)
LONG(0xe1e94 - code32init_start)
LONG(0xe1eaf - code32init_start)
LONG(0xe1ef9 - code32init_start)
LONG(0xe1f47 - code32init_start)
LONG(0xe1f7e - code32init_start)
LONG(0xe2341 - code32init_start)
LONG(0xe236f - code32init_start)
LONG(0xe237e - code32init_start)
LONG(0xe23f2 - code32init_start)
LONG(0xe241e - code32init_start)
LONG(0xe2459 - code32init_start)
LONG(0xe2469 - code32init_start)
LONG(0xe2484 - code32init_start)
LONG(0xe24d7 - code32init_start)
LONG(0xe2563 - code32init_start)
LONG(0xe2571 - code32init_start)
LONG(0xe2584 - code32init_start)
LONG(0xe258f - code32init_start)
LONG(0xe25c4 - code32init_start)
LONG(0xe25e6 - code32init_start)
LONG(0xe26ce - code32init_start)
LONG(0xe33c3 - code32init_start)
LONG(0xe3438 - code32init_start)
LONG(0xe3447 - code32init_start)
LONG(0xe345a - code32init_start)
LONG(0xe3496 - code32init_start)
LONG(0xe34a3 - code32init_start)
LONG(0xe34be - code32init_start)
LONG(0xe353f - code32init_start)
LONG(0xe3580 - code32init_start)
LONG(0xe359f - code32init_start)
LONG(0xe35b5 - code32init_start)
LONG(0xe3618 - code32init_start)
LONG(0xe3649 - code32init_start)
LONG(0xe3664 - code32init_start)
LONG(0xe36be - code32init_start)
LONG(0xe36db - code32init_start)
LONG(0xe36f8 - code32init_start)
LONG(0xe3715 - code32init_start)
LONG(0xe372c - code32init_start)
LONG(0xe373c - code32init_start)
LONG(0xe3747 - code32init_start)
LONG(0xe375d - code32init_start)
LONG(0xe377a - code32init_start)
LONG(0xe3795 - code32init_start)
LONG(0xe37b2 - code32init_start)
LONG(0xe37cf - code32init_start)
LONG(0xe37ec - code32init_start)
LONG(0xe380e - code32init_start)
LONG(0xe382e - code32init_start)
LONG(0xe3945 - code32init_start)
LONG(0xe3977 - code32init_start)
LONG(0xe39ad - code32init_start)
LONG(0xe39b7 - code32init_start)
LONG(0xe39c1 - code32init_start)
LONG(0xe3a3d - code32init_start)
LONG(0xe3ac6 - code32init_start)
LONG(0xe3aed - code32init_start)
LONG(0xe3b19 - code32init_start)
LONG(0xe3b5d - code32init_start)
LONG(0xe3b70 - code32init_start)
LONG(0xe3b7b - code32init_start)
LONG(0xe3b8e - code32init_start)
LONG(0xe3b9d - code32init_start)
LONG(0xe3c56 - code32init_start)
LONG(0xe3c7c - code32init_start)
LONG(0xe3cad - code32init_start)
LONG(0xe3cc3 - code32init_start)
LONG(0xe3cde - code32init_start)
LONG(0xe3ced - code32init_start)
LONG(0xe3d25 - code32init_start)
LONG(0xe3d81 - code32init_start)
LONG(0xe3dc5 - code32init_start)
LONG(0xe3e1a - code32init_start)
LONG(0xe3e8e - code32init_start)
LONG(0xe3ef1 - code32init_start)
LONG(0xe3fab - code32init_start)
LONG(0xe3fc5 - code32init_start)
LONG(0xe3fd4 - code32init_start)
LONG(0xe3ff0 - code32init_start)
LONG(0xe4069 - code32init_start)
LONG(0xe407c - code32init_start)
LONG(0xe40e3 - code32init_start)
LONG(0xe41b3 - code32init_start)
LONG(0xe41f7 - code32init_start)
LONG(0xe4266 - code32init_start)
LONG(0xe4279 - code32init_start)
LONG(0xe429a - code32init_start)
LONG(0xe42b2 - code32init_start)
LONG(0xe42b7 - code32init_start)
LONG(0xe42c9 - code32init_start)
LONG(0xe432e - code32init_start)
LONG(0xe4345 - code32init_start)
LONG(0xe4381 - code32init_start)
LONG(0xe4399 - code32init_start)
LONG(0xe43ee - code32init_start)
LONG(0xe4410 - code32init_start)
LONG(0xe441b - code32init_start)
LONG(0xe442a - code32init_start)
LONG(0xe444a - code32init_start)
LONG(0xe444f - code32init_start)
LONG(0xe4471 - code32init_start)
LONG(0xe448d - code32init_start)
LONG(0xe449c - code32init_start)
LONG(0xe44aa - code32init_start)
LONG(0xe44e5 - code32init_start)
LONG(0xe44f4 - code32init_start)
LONG(0xe4510 - code32init_start)
LONG(0xe454c - code32init_start)
LONG(0xe456d - code32init_start)
LONG(0xe458f - code32init_start)
LONG(0xe45ef - code32init_start)
LONG(0xe4609 - code32init_start)
LONG(0xe4629 - code32init_start)
LONG(0xe468c - code32init_start)
LONG(0xe46bf - code32init_start)
LONG(0xe46f7 - code32init_start)
LONG(0xe4703 - code32init_start)
LONG(0xe472f - code32init_start)
LONG(0xe4756 - code32init_start)
LONG(0xe4764 - code32init_start)
LONG(0xe4784 - code32init_start)
LONG(0xe478d - code32init_start)
LONG(0xe47a7 - code32init_start)
LONG(0xe47f2 - code32init_start)
LONG(0xe47fb - code32init_start)
LONG(0xe4815 - code32init_start)
LONG(0xe4828 - code32init_start)
LONG(0xe4842 - code32init_start)
LONG(0xe4853 - code32init_start)
LONG(0xe488b - code32init_start)
LONG(0xe48ce - code32init_start)
LONG(0xe4907 - code32init_start)
LONG(0xe4994 - code32init_start)
LONG(0xe49aa - code32init_start)
LONG(0xe4a0f - code32init_start)
LONG(0xe4a34 - code32init_start)
LONG(0xe4b7e - code32init_start)
LONG(0xe4b8f - code32init_start)
LONG(0xe4c47 - code32init_start)
LONG(0xe4c7f - code32init_start)
LONG(0xe4dce - code32init_start)
LONG(0xe4e10 - code32init_start)
        _reloc_rel_end = ABSOLUTE(.) ;
        _reloc_init_start = ABSOLUTE(.) ;
LONG(0xecadb - code32flat_start)
LONG(0xfc97e - code32flat_start)
LONG(0xfe7c8 - code32flat_start)
        _reloc_init_end = ABSOLUTE(.) ;

. = ( 0xcfaa0 - code32flat_start ) ;
*32flat.*(.data.varlow../src/tcgbios.c.1414)
. = ( 0xcfaa1 - code32flat_start ) ;
*32flat.*(.data.varlow../src/tcgbios.c.962)
. = ( 0xcfaa4 - code32flat_start ) ;
*32flat.*(.data.varlow../src/tcgbios.c.49)
. = ( 0xcfab8 - code32flat_start ) ;
*32flat.*(.data.varlow../src/boot.c.1024)
. = ( 0xcfabc - code32flat_start ) ;
*32flat.*(.data.varlow../src/hw/mpt-scsi.c.48)
. = ( 0xcfac0 - code32flat_start ) ;
*32flat.*(.data.varlow../src/hw/floppy.c.194)
. = ( 0xcfac4 - code32flat_start ) ;
*32flat.*(.data.varlow../src/hw/usb-hid.c.256)
. = ( 0xcfacc - code32flat_start ) ;
*32flat.*(.data.varlow../src/hw/ps2port.c.211)
. = ( 0xcfad0 - code32flat_start ) ;
*32flat.*(.data.varlow../src/hw/rtc.c.74)
. = ( 0xcfad4 - code32flat_start ) ;
*32flat.*(.data.varlow../src/hw/timer.c.155)
. = ( 0xcfad8 - code32flat_start ) ;
*32flat.*(.data.varlow../src/clock.c.30)
. = ( 0xcfad9 - code32flat_start ) ;
*32flat.*(.data.varlow../src/sercon.c.552)
. = ( 0xcfadc - code32flat_start ) ;
*32flat.*(.data.varlow../src/sercon.c.551)
. = ( 0xcfaec - code32flat_start ) ;
*32flat.*(.data.varlow../src/sercon.c.68)
. = ( 0xcfaed - code32flat_start ) ;
*32flat.*(.data.varlow../src/sercon.c.67)
. = ( 0xcfaee - code32flat_start ) ;
*32flat.*(.data.varlow../src/sercon.c.66)
. = ( 0xcfaef - code32flat_start ) ;
*32flat.*(.data.varlow../src/sercon.c.65)
. = ( 0xcfaf0 - code32flat_start ) ;
*32flat.*(.data.varlow../src/sercon.c.64)
. = ( 0xcfaf1 - code32flat_start ) ;
*32flat.*(.data.varlow../src/sercon.c.51)
. = ( 0xcfaf2 - code32flat_start ) ;
*32flat.*(.data.varlow../src/sercon.c.50)
. = ( 0xcfaf4 - code32flat_start ) ;
*32flat.*(.data.varlow../src/sercon.c.49)
. = ( 0xcfaf8 - code32flat_start ) ;
*32flat.*(.data.varlow../src/disk.c.439)
. = ( 0xcfb08 - code32flat_start ) ;
*32flat.*(.data.varlow../src/cdrom.c.26)
. = ( 0xcfb0c - code32flat_start ) ;
*32flat.*(.data.varlow../src/cdrom.c.25)
. = ( 0xcfb20 - code32flat_start ) ;
*32flat.*(.data.varlow../src/block.c.418)
. = ( 0xcfb30 - code32flat_start ) ;
*32flat.*(.data.varlow../src/stacks.c.327)
. = ( 0xcfb38 - code32flat_start ) ;
*32flat.*(.data.varlow../src/stacks.c.326)
. = ( 0xd033c - code32flat_start ) ;
*32flat.*(.data.varlow../src/stacks.c.33)
. = ( 0xd0360 - code32flat_start ) ;
*32flat.*(.text.set_equipment_flags)
. = ( 0xd0371 - code32flat_start ) ;
*32flat.*(.text.hlist_del)
. = ( 0xd0380 - code32flat_start ) ;
*32flat.*(.text.hlist_add)
. = ( 0xd0391 - code32flat_start ) ;
*32flat.*(.text.putc_str)
. = ( 0xd039f - code32flat_start ) ;
*32flat.*(.text.strtcpy)
. = ( 0xd03bf - code32flat_start ) ;
*32flat.*(.text.nullTrailingSpace)
. = ( 0xd03ed - code32flat_start ) ;
*32flat.*(.text.pci_find_capability)
. = ( 0xd0460 - code32flat_start ) ;
*32flat.*(.text.pci_next)
. = ( 0xd04a6 - code32flat_start ) ;
*32flat.*(.text.usb_add_freelist)
. = ( 0xd04b3 - code32flat_start ) ;
*32flat.*(.text.usb_get_freelist)
. = ( 0xd04cc - code32flat_start ) ;
*32flat.*(.text.usb_desc2pipe)
. = ( 0xd0506 - code32flat_start ) ;
*32flat.*(.text.usb_find_desc)
. = ( 0xd054d - code32flat_start ) ;
*32flat.*(.text.uhci_hub_disconnect)
. = ( 0xd055c - code32flat_start ) ;
*32flat.*(.text.ohci_hub_detect)
. = ( 0xd056d - code32flat_start ) ;
*32flat.*(.text.ohci_hub_disconnect)
. = ( 0xd057f - code32flat_start ) ;
*32flat.*(.text.ohci_desc2pipe)
. = ( 0xd05c8 - code32flat_start ) ;
*32flat.*(.text.ehci_hub_disconnect)
. = ( 0xd05dd - code32flat_start ) ;
*32flat.*(.text.ehci_desc2pipe)
. = ( 0xd0680 - code32flat_start ) ;
*32flat.*(.text.ata_extract_version)
. = ( 0xd06a9 - code32flat_start ) ;
*32flat.*(.text.found_compatibleahci)
. = ( 0xd06aa - code32flat_start ) ;
*32flat.*(.text.alloc_free)
. = ( 0xd06c3 - code32flat_start ) ;
*32flat.*(.text.alloc_find)
. = ( 0xd06e1 - code32flat_start ) ;
*32flat.*(.text.malloc_getspace)
. = ( 0xd0743 - code32flat_start ) ;
*32flat.*(.text.rom_reserve)
. = ( 0xd077f - code32flat_start ) ;
*32flat.*(.text.calcRamSize)
. = ( 0xd07cd - code32flat_start ) ;
*32flat.*(.text.romfile_findprefix)
. = ( 0xd0803 - code32flat_start ) ;
*32flat.*(.text.is_pci_vga)
. = ( 0xd0847 - code32flat_start ) ;
*32flat.*(.text.glob_prefix)
. = ( 0xd0881 - code32flat_start ) ;
*32flat.*(.text.parse_u32)
. = ( 0xd08af - code32flat_start ) ;
*32flat.*(.text.usb_portmap)
. = ( 0xd08c8 - code32flat_start ) ;
*32flat.*(.text.add_bev)
. = ( 0xd091f - code32flat_start ) ;
*32flat.*(.text.getword)
. = ( 0xd0948 - code32flat_start ) ;
*32flat.*(.text.idctqtab)
. = ( 0xd09a4 - code32flat_start ) ;
*32flat.*(.text.tpm_can_show_menu)
. = ( 0xd09d6 - code32flat_start ) ;
*32flat.*(.text.pci_find_device)
. = ( 0xd09fe - code32flat_start ) ;
*32flat.*(.text.xhci_hub_detect)
. = ( 0xd0a0d - code32flat_start ) ;
*32flat.*(.text.xhci_hub_portmap)
. = ( 0xd0a52 - code32flat_start ) ;
*32flat.*(.text.xhci_hub_disconnect)
. = ( 0xd0a53 - code32flat_start ) ;
*32flat.*(.text.smbios_next)
. = ( 0xd0ab4 - code32flat_start ) ;
*32flat.*(.text.smbios_get_tables)
. = ( 0xd0ae2 - code32flat_start ) ;
*32flat.*(.text.piix_pci_slot_get_irq)
. = ( 0xd0b0e - code32flat_start ) ;
*32flat.*(.text.mch_pci_slot_get_irq)
. = ( 0xd0b48 - code32flat_start ) ;
*32flat.*(.text.piix_ide_setup)
. = ( 0xd0b6a - code32flat_start ) ;
*32flat.*(.text.ich9_smbus_setup)
. = ( 0xd0b77 - code32flat_start ) ;
*32flat.*(.text.pci_region_align)
. = ( 0xd0b8d - code32flat_start ) ;
*32flat.*(.text.pci_region_sum)
. = ( 0xd0bb5 - code32flat_start ) ;
*32flat.*(.text.pci_region_migrate_64bit_entries)
. = ( 0xd0bf9 - code32flat_start ) ;
*32flat.*(.text.pci_bios_init_root_regions_mem)
. = ( 0xd0cae - code32flat_start ) ;
*32flat.*(.text.apic_id_is_present)
. = ( 0xd0cc3 - code32flat_start ) ;
*32flat.*(.text.piix4_fadt_setup)
. = ( 0xd0d0f - code32flat_start ) ;
*32flat.*(.text.ich9_lpc_fadt_setup)
. = ( 0xd0d5a - code32flat_start ) ;
*32flat.*(.text.getHex)
. = ( 0xd0d6a - code32flat_start ) ;
*32flat.*(.text.build_notify)
. = ( 0xd0e0c - code32flat_start ) ;
*32flat.*(.text.romfile_loader_find)
. = ( 0xd0e49 - code32flat_start ) ;
*32flat.*(.text.parse_resource_int)
. = ( 0xd0e8f - code32flat_start ) ;
*32flat.*(.text.parse_pkglength)
. = ( 0xd0ef5 - code32flat_start ) ;
*32flat.*(.text.vp_get_features)
. = ( 0xd0fba - code32flat_start ) ;
*32flat.*(.text.vp_set_features)
. = ( 0xd10aa - code32flat_start ) ;
*32flat.*(.text.const_read_file)
. = ( 0xd10d0 - code32flat_start ) ;
*32flat.*(.text.tpm20_write_EfiSpecIdEventStruct)
. = ( 0xd1205 - code32flat_start ) ;
*32flat.*(.text.fillbits)
. = ( 0xd127d - code32flat_start ) ;
*32flat.*(.text.dec_rec2)
. = ( 0xd137c - code32flat_start ) ;
*32flat.*(.text.idct)
. = ( 0xd168b - code32flat_start ) ;
*32flat.*(.text.parse_nameseg)
. = ( 0xd16e6 - code32flat_start ) ;
*32flat.*(.text.vp_get_status)
. = ( 0xd171d - code32flat_start ) ;
*32flat.*(.text.vp_set_status)
. = ( 0xd1763 - code32flat_start ) ;
*32flat.*(.text.vp_reset)
. = ( 0xd17e0 - code32flat_start ) ;
*32flat.*(.text.ata_extract_model.constprop.0)
. = ( 0xd1805 - code32flat_start ) ;
*32flat.*(.text.detect_serial.constprop.0)
. = ( 0xd1849 - code32flat_start ) ;
*32flat.*(.text.pci_config_maskw.constprop.0)
. = ( 0xd186d - code32flat_start ) ;
*32flat.*(.text.get_acpi_rsdp_length)
. = ( 0xd18d3 - code32flat_start ) ;
*32flat.*(.text.build_header.constprop.0)
. = ( 0xd191b - code32flat_start ) ;
*32flat.*(.text.enable_hwirq.constprop.0)
. = ( 0xd1953 - code32flat_start ) ;
*32flat.*(.text.pci_set_io_region_addr)
. = ( 0xd19ab - code32flat_start ) ;
*32flat.*(.text.storage_ide_setup)
. = ( 0xd1a05 - code32flat_start ) ;
*32flat.*(.text.pic_ibm_setup)
. = ( 0xd1a19 - code32flat_start ) ;
*32flat.*(.text.apple_macio_setup)
. = ( 0xd1a2d - code32flat_start ) ;
*32flat.*(.text.tpm20_get_suppt_pcrbanks.isra.0)
. = ( 0xd1aaf - code32flat_start ) ;
*32flat.*(.text.readtables)
. = ( 0xd1e3a - code32flat_start ) ;
*32flat.*(.text.usb_get_period.isra.0)
. = ( 0xd1e5a - code32flat_start ) ;
*32flat.*(.text.getFBSize.isra.0)
. = ( 0xd1e7d - code32flat_start ) ;
*32flat.*(.text.memmove.isra.0)
. = ( 0xd1e9b - code32flat_start ) ;
*32flat.*(.text.remove_e820)
. = ( 0xd1eca - code32flat_start ) ;
*32flat.*(.text.vp_init_mmio)
. = ( 0xd1f06 - code32flat_start ) ;
*32flat.*(.text.tpm_set_log_area)
. = ( 0xd1f3e - code32flat_start ) ;
*32flat.*(.text.alloc_new.isra.0)
. = ( 0xd1f8a - code32flat_start ) ;
*32flat.*(.text.tpm12_get_capability)
. = ( 0xd1ffe - code32flat_start ) ;
*32flat.*(.text.tpm12_read_has_owner)
. = ( 0xd202f - code32flat_start ) ;
*32flat.*(.text.tpm12_read_permanent_flags.constprop.0)
. = ( 0xd2076 - code32flat_start ) ;
*32flat.*(.text.tpm12_enable_tpm.constprop.0)
. = ( 0xd20bf - code32flat_start ) ;
*32flat.*(.text.romfile_find)
. = ( 0xd20f0 - code32flat_start ) ;
*32flat.*(.text.romfile_loadint)
. = ( 0xd2144 - code32flat_start ) ;
*32flat.*(.text.uhci_hub_reset)
. = ( 0xd217f - code32flat_start ) ;
*32flat.*(.text.wait_threads)
. = ( 0xd2193 - code32flat_start ) ;
*32flat.*(.text.mutex_lock)
. = ( 0xd21aa - code32flat_start ) ;
*32flat.*(.text.iomemcpy)
. = ( 0xd21ee - code32flat_start ) ;
*32flat.*(.text.qemu_cfg_read_file)
. = ( 0xd2244 - code32flat_start ) ;
*32flat.*(.text.wait_preempt.isra.0)
. = ( 0xd2268 - code32flat_start ) ;
*32flat.*(.text.pci_enable_busmaster)
. = ( 0xd228b - code32flat_start ) ;
*32flat.*(.text.msleep)
. = ( 0xd22a7 - code32flat_start ) ;
*32flat.*(.text.uhci_hub_detect)
. = ( 0xd22d1 - code32flat_start ) ;
*32flat.*(.text.ehci_hub_reset)
. = ( 0xd230b - code32flat_start ) ;
*32flat.*(.text.ehci_hub_detect)
. = ( 0xd235b - code32flat_start ) ;
*32flat.*(.text.get_keystroke_full)
. = ( 0xd23eb - code32flat_start ) ;
*32flat.*(.text.get_keystroke)
. = ( 0xd23f8 - code32flat_start ) ;
*32flat.*(.text.call16_int10)
. = ( 0xd241d - code32flat_start ) ;
*32flat.*(.text.tpm12_activate_tpm.constprop.0)
. = ( 0xd2492 - code32flat_start ) ;
*32flat.*(.text.tpm12_set_owner_install.constprop.0)
. = ( 0xd2514 - code32flat_start ) ;
*32flat.*(.text.snprintf)
. = ( 0xd255f - code32flat_start ) ;
*32flat.*(.text.build_usb_path)
. = ( 0xd25a1 - code32flat_start ) ;
*32flat.*(.text.get_field)
. = ( 0xd25ec - code32flat_start ) ;
*32flat.*(.text.acpi_dsdt_find_string)
. = ( 0xd263d - code32flat_start ) ;
*32flat.*(.text.acpi_dsdt_find_eisaid)
. = ( 0xd26be - code32flat_start ) ;
*32flat.*(.text.virtio_scsi_init_lun)
. = ( 0xd276a - code32flat_start ) ;
*32flat.*(.text.smbios_init_type_4)
. = ( 0xd2988 - code32flat_start ) ;
*32flat.*(.text.smbios_init_type_17)
. = ( 0xd2ad9 - code32flat_start ) ;
*32flat.*(.text.build_pci_path.constprop.0)
. = ( 0xd2b85 - code32flat_start ) ;
*32flat.*(.text.pci_enable_iobar)
. = ( 0xd2bee - code32flat_start ) ;
*32flat.*(.text.add_drive)
. = ( 0xd2c0f - code32flat_start ) ;
*32flat.*(.text.deploy_romfile)
. = ( 0xd2c50 - code32flat_start ) ;
*32flat.*(.text.wrmsr_smp)
. = ( 0xd2c97 - code32flat_start ) ;
*32flat.*(.text.get_external)
. = ( 0xd2dd9 - code32flat_start ) ;
*32flat.*(.text.insert_e820)
. = ( 0xd2e75 - code32flat_start ) ;
*32flat.*(.text.alloc_new_detail)
. = ( 0xd2eff - code32flat_start ) ;
*32flat.*(.text.alloc_add)
. = ( 0xd2f4e - code32flat_start ) ;
*32flat.*(.text.ohci_hub_reset)
. = ( 0xd2fc7 - code32flat_start ) ;
*32flat.*(.text.ahci_port_reset)
. = ( 0xd305b - code32flat_start ) ;
*32flat.*(.text.wait_bit)
. = ( 0xd30a5 - code32flat_start ) ;
*32flat.*(.text.setup_translation)
. = ( 0xd3303 - code32flat_start ) ;
*32flat.*(.text.clock_setup)
. = ( 0xd3427 - code32flat_start ) ;
*32flat.*(.text.tsctimer_setfreq.part.0)
. = ( 0xd348a - code32flat_start ) ;
*32flat.*(.text.pmtimer_setup)
. = ( 0xd34bb - code32flat_start ) ;
*32flat.*(.text.piix4_pm_setup)
. = ( 0xd34e5 - code32flat_start ) ;
*32flat.*(.text.i8042_command)
. = ( 0xd35a3 - code32flat_start ) ;
*32flat.*(.text.i8042_flush)
. = ( 0xd3603 - code32flat_start ) ;
*32flat.*(.text.powerup_await_non_bsy)
. = ( 0xd3671 - code32flat_start ) ;
*32flat.*(.text.malloc_pfree)
. = ( 0xd36b9 - code32flat_start ) ;
*32flat.*(.text.free)
. = ( 0xd36d6 - code32flat_start ) ;
*32flat.*(.text.ahci_port_release)
. = ( 0xd3704 - code32flat_start ) ;
*32flat.*(.text.__end_thread)
. = ( 0xd373c - code32flat_start ) ;
*32flat.*(.text.boot_lchs_find)
. = ( 0xd3785 - code32flat_start ) ;
*32flat.*(.text.boot_lchs_find_ata_device.isra.0)
. = ( 0xd37f0 - code32flat_start ) ;
*32flat.*(.text.boot_lchs_find_scsi_device.isra.0)
. = ( 0xd385b - code32flat_start ) ;
*32flat.*(.text.find_prio)
. = ( 0xd389c - code32flat_start ) ;
*32flat.*(.text.is_bootprio_strict)
. = ( 0xd38bf - code32flat_start ) ;
*32flat.*(.text.bootprio_find_pci_device)
. = ( 0xd38e1 - code32flat_start ) ;
*32flat.*(.text.bootprio_find_scsi_device)
. = ( 0xd392c - code32flat_start ) ;
*32flat.*(.text.bootprio_find_ata_device)
. = ( 0xd3977 - code32flat_start ) ;
*32flat.*(.text.bootprio_find_named_rom)
. = ( 0xd39c4 - code32flat_start ) ;
*32flat.*(.text.getRomPriority)
. = ( 0xd3a3d - code32flat_start ) ;
*32flat.*(.text.bootprio_find_usb)
. = ( 0xd3af3 - code32flat_start ) ;
*32flat.*(.text.pci_init_device)
. = ( 0xd3b90 - code32flat_start ) ;
*32flat.*(.text.pci_enable_membar)
. = ( 0xd3c1a - code32flat_start ) ;
*32flat.*(.text.xhci_hub_reset)
. = ( 0xd3ccc - code32flat_start ) ;
*32flat.*(.text.sdcard_set_frequency)
. = ( 0xd3d77 - code32flat_start ) ;
*32flat.*(.text.pci_find_resource_reserve_capability)
. = ( 0xd3e0d - code32flat_start ) ;
*32flat.*(.text.pci_bios_init_bus_rec)
. = ( 0xd409a - code32flat_start ) ;
*32flat.*(.text.dummy_pci_slot_get_irq)
. = ( 0xd40ab - code32flat_start ) ;
*32flat.*(.text.i440fx_mem_addr_setup)
. = ( 0xd410c - code32flat_start ) ;
*32flat.*(.text.pci_region_map_entries)
. = ( 0xd4309 - code32flat_start ) ;
*32flat.*(.text.piix_isa_bridge_setup)
. = ( 0xd437a - code32flat_start ) ;
*32flat.*(.text.mtrr_setup)
. = ( 0xd458f - code32flat_start ) ;
*32flat.*(.text.fill_dsdt)
. = ( 0xd45c3 - code32flat_start ) ;
*32flat.*(.text.vp_init_simple)
. = ( 0xd4833 - code32flat_start ) ;
*32flat.*(.text.nvme_init_queue_common)
. = ( 0xd487e - code32flat_start ) ;
*32flat.*(.text.nvme_wait_csts_rdy)
. = ( 0xd48f1 - code32flat_start ) ;
*32flat.*(.text.enable_vga_console)
. = ( 0xd4ac9 - code32flat_start ) ;
*32flat.*(.text.map_pcirom)
. = ( 0xd4c99 - code32flat_start ) ;
*32flat.*(.text.e820_add)
. = ( 0xd4eae - code32flat_start ) ;
*32flat.*(.text.mch_isa_bridge_setup)
. = ( 0xd4f63 - code32flat_start ) ;
*32flat.*(.text.malloc_palloc)
. = ( 0xd4fc7 - code32flat_start ) ;
*32flat.*(.text.malloc_tmphigh)
. = ( 0xd4fd8 - code32flat_start ) ;
*32flat.*(.text.malloc_tmplow)
. = ( 0xd4fe9 - code32flat_start ) ;
*32flat.*(.text.malloc_tmp)
. = ( 0xd4fff - code32flat_start ) ;
*32flat.*(.text.znprintf)
. = ( 0xd5060 - code32flat_start ) ;
*32flat.*(.text.qemu_romfile_add)
. = ( 0xd50f9 - code32flat_start ) ;
*32flat.*(.text.malloc_low)
. = ( 0xd510a - code32flat_start ) ;
*32flat.*(.text.create_bounce_buf)
. = ( 0xd513c - code32flat_start ) ;
*32flat.*(.text.malloc_fseg)
. = ( 0xd514d - code32flat_start ) ;
*32flat.*(.text.init_atadrive)
. = ( 0xd51a8 - code32flat_start ) ;
*32flat.*(.text.memalign_high)
. = ( 0xd51b4 - code32flat_start ) ;
*32flat.*(.text.malloc_high)
. = ( 0xd51c5 - code32flat_start ) ;
*32flat.*(.text.pvscsi_init_rings.constprop.0)
. = ( 0xd52e8 - code32flat_start ) ;
*32flat.*(.text.zalloc_page_aligned)
. = ( 0xd5304 - code32flat_start ) ;
*32flat.*(.text.run_thread)
. = ( 0xd53af - code32flat_start ) ;
*32flat.*(.text.usb_enumerate)
. = ( 0xd541d - code32flat_start ) ;
*32flat.*(.text.configure_uhci)
. = ( 0xd55e4 - code32flat_start ) ;
*32flat.*(.text.configure_ohci)
. = ( 0xd5845 - code32flat_start ) ;
*32flat.*(.text.configure_ehci)
. = ( 0xd5a98 - code32flat_start ) ;
*32flat.*(.text.romfile_loadfile)
. = ( 0xd5b15 - code32flat_start ) ;
*32flat.*(.text.ahci_port_setup)
. = ( 0xd5fcc - code32flat_start ) ;
*32flat.*(.text.bootentry_add)
. = ( 0xd607d - code32flat_start ) ;
*32flat.*(.text.boot_add_hd)
. = ( 0xd609e - code32flat_start ) ;
*32flat.*(.text.pci_probe_devices)
. = ( 0xd627b - code32flat_start ) ;
*32flat.*(.text.pci_region_create_entry)
. = ( 0xd636d - code32flat_start ) ;
*32flat.*(.text.pci_setup)
. = ( 0xd7036 - code32flat_start ) ;
*32flat.*(.text.configure_xhci)
. = ( 0xd7357 - code32flat_start ) ;
*32flat.*(.text.vp_find_vq)
. = ( 0xd7785 - code32flat_start ) ;
*32flat.*(.text.init_virtio_blk_mmio)
. = ( 0xd79c2 - code32flat_start ) ;
*32flat.*(.text.init_virtio_blk)
. = ( 0xd7d1e - code32flat_start ) ;
*32flat.*(.text.xhci_controller_setup)
. = ( 0xd7eb7 - code32flat_start ) ;
*32flat.*(.text.nvme_init_sq)
. = ( 0xd7f19 - code32flat_start ) ;
*32flat.*(.text.init_floppy)
. = ( 0xd7f98 - code32flat_start ) ;
*32flat.*(.text.addFloppy)
. = ( 0xd803f - code32flat_start ) ;
*32flat.*(.text.xhci_cmd_submit)
. = ( 0xd80c8 - code32flat_start ) ;
*32flat.*(.text.usb_send_default_control)
. = ( 0xd80ea - code32flat_start ) ;
*32flat.*(.text.get_port_status)
. = ( 0xd812c - code32flat_start ) ;
*32flat.*(.text.set_port_feature)
. = ( 0xd816b - code32flat_start ) ;
*32flat.*(.text.usb_hub_disconnect)
. = ( 0xd81bd - code32flat_start ) ;
*32flat.*(.text.usb_hub_detect)
. = ( 0xd81e7 - code32flat_start ) ;
*32flat.*(.text.usb_hub_reset)
. = ( 0xd828e - code32flat_start ) ;
*32flat.*(.text.sdcard_pio_app.constprop.0)
. = ( 0xd82d0 - code32flat_start ) ;
*32flat.*(.text.copy_fseg_table)
. = ( 0xd8315 - code32flat_start ) ;
*32flat.*(.text.copy_pir.part.0)
. = ( 0xd8344 - code32flat_start ) ;
*32flat.*(.text.copy_acpi_rsdp.part.0)
. = ( 0xd8368 - code32flat_start ) ;
*32flat.*(.text.copy_smbios_21)
. = ( 0xd83ce - code32flat_start ) ;
*32flat.*(.text.copy_smbios_30)
. = ( 0xd8416 - code32flat_start ) ;
*32flat.*(.text.copy_mptable.part.0)
. = ( 0xd84cd - code32flat_start ) ;
*32flat.*(.text.smbios_build_tables)
. = ( 0xd86fd - code32flat_start ) ;
*32flat.*(.text.qemu_cfg_detect)
. = ( 0xd877d - code32flat_start ) ;
*32flat.*(.text.sdcard_card_setup.constprop.0)
. = ( 0xd8b29 - code32flat_start ) ;
*32flat.*(.text.sdcard_controller_setup)
. = ( 0xd8c51 - code32flat_start ) ;
*32flat.*(.text.sdcard_pci_setup)
. = ( 0xd8c7a - code32flat_start ) ;
*32flat.*(.text.sdcard_romfile_setup)
. = ( 0xd8cb5 - code32flat_start ) ;
*32flat.*(.text.hex.constprop.0)
. = ( 0xd8d2b - code32flat_start ) ;
*32flat.*(.text.parse_namestring)
. = ( 0xd8e49 - code32flat_start ) ;
*32flat.*(.text.parse_pkg_skip)
. = ( 0xd8ea8 - code32flat_start ) ;
*32flat.*(.text.parse_termarg_int)
. = ( 0xd8f2e - code32flat_start ) ;
*32flat.*(.text.parse_termobj)
. = ( 0xd9255 - code32flat_start ) ;
*32flat.*(.text.parse_termlist)
. = ( 0xd92b4 - code32flat_start ) ;
*32flat.*(.text.acpi_dsdt_parse)
. = ( 0xd9303 - code32flat_start ) ;
*32flat.*(.text.ps2_recvbyte.constprop.0)
. = ( 0xd93a0 - code32flat_start ) ;
*32flat.*(.text.ps2_sendbyte.constprop.0)
. = ( 0xd93f5 - code32flat_start ) ;
*32flat.*(.text.ps2_kbd_command)
. = ( 0xd951a - code32flat_start ) ;
*32flat.*(.text.ps2_keyboard_setup)
. = ( 0xd9666 - code32flat_start ) ;
*32flat.*(.text.mch_mem_addr_setup)
. = ( 0xd96d9 - code32flat_start ) ;
*32flat.*(.text.nvme_admin_identify)
. = ( 0xd976c - code32flat_start ) ;
*32flat.*(.text.nvme_controller_setup)
. = ( 0xd9d6e - code32flat_start ) ;
*32flat.*(.text.send_ata_identity)
. = ( 0xd9e12 - code32flat_start ) ;
*32flat.*(.text.init_controller.constprop.0)
. = ( 0xd9eb3 - code32flat_start ) ;
*32flat.*(.text.found_genericata)
. = ( 0xd9f73 - code32flat_start ) ;
*32flat.*(.text.find_resource)
. = ( 0xda202 - code32flat_start ) ;
*32flat.*(.text.init_optionrom.isra.0)
. = ( 0xda309 - code32flat_start ) ;
*32flat.*(.text.run_file_roms)
. = ( 0xda353 - code32flat_start ) ;
*32flat.*(.text.init_pcirom)
. = ( 0xda493 - code32flat_start ) ;
*32flat.*(.text.optionrom_setup)
. = ( 0xda6a2 - code32flat_start ) ;
*32flat.*(.text.vgarom_setup)
. = ( 0xda9a9 - code32flat_start ) ;
*32flat.*(.text.memalign_tmp)
. = ( 0xda9d4 - code32flat_start ) ;
*32flat.*(.text.intel_igd_setup)
. = ( 0xdaae7 - code32flat_start ) ;
*32flat.*(.text.xhci_alloc_inctx)
. = ( 0xdabce - code32flat_start ) ;
*32flat.*(.text.qemu_platform_setup)
. = ( 0xdd15e - code32flat_start ) ;
*32flat.*(.text.usb_realloc_pipe)
. = ( 0xdde29 - code32flat_start ) ;
*32flat.*(.text.usb_alloc_pipe)
. = ( 0xdde32 - code32flat_start ) ;
*32flat.*(.text.usb_free_pipe)
. = ( 0xdde3e - code32flat_start ) ;
*32flat.*(.text.device_hardware_setup)
. = ( 0xdea4c - code32flat_start ) ;
*32flat.*(.text.interface_init)
. = ( 0xdf465 - code32flat_start ) ;
*32flat.*(.text.init../src/stacks.c.737)
. = ( 0xdf475 - code32flat_start ) ;
*32flat.*(.text.cdrom_media_info)
. = ( 0xdf532 - code32flat_start ) ;
*32flat.*(.text.boot_add_cd)
. = ( 0xdf58a - code32flat_start ) ;
*32flat.*(.text.ata_detect)
. = ( 0xdfa2c - code32flat_start ) ;
*32flat.*(.text.ahci_port_detect)
. = ( 0xdfbb7 - code32flat_start ) ;
*32flat.*(.text.scsi_rep_luns_scan)
. = ( 0xdfcd4 - code32flat_start ) ;
*32flat.*(.text.init_esp_scsi)
. = ( 0xdfd50 - code32flat_start ) ;
*32flat.*(.text.init_virtio_scsi_mmio)
. = ( 0xdfe67 - code32flat_start ) ;
*32flat.*(.text.init_virtio_scsi)
. = ( 0xdff99 - code32flat_start ) ;
*32flat.*(.text.scsi_drive_setup)
. = ( 0xe0293 - code32flat_start ) ;
*32flat.*(.text.usb_hub_port_setup)
. = ( 0xe0bc3 - code32flat_start ) ;
*32flat.*(.text.uas_add_lun)
. = ( 0xe0c75 - code32flat_start ) ;
*32flat.*(.text.lsi_scsi_add_lun)
. = ( 0xe0d38 - code32flat_start ) ;
*32flat.*(.text.init_lsi_scsi)
. = ( 0xe0dcb - code32flat_start ) ;
*32flat.*(.text.esp_scsi_add_lun)
. = ( 0xe0e8d - code32flat_start ) ;
*32flat.*(.text.mpt_scsi_add_lun)
. = ( 0xe0f50 - code32flat_start ) ;
*32flat.*(.text.init_mpt_scsi)
. = ( 0xe1048 - code32flat_start ) ;
*32flat.*(.text.virtio_scsi_add_lun)
. = ( 0xe1147 - code32flat_start ) ;
*32flat.*(.text.init_pvscsi)
. = ( 0xe1252 - code32flat_start ) ;
*32flat.*(.text.megasas_scan_target)
. = ( 0xe144f - code32flat_start ) ;
*32flat.*(.text.init_megasas)
. = ( 0xe1621 - code32flat_start ) ;
*32flat.*(.text.maininit)
. = ( 0xe4442 - code32flat_start ) ;
*32flat.*(.text.init../src/post.c.303)
. = ( 0xe4c32 - code32flat_start ) ;
*32flat.*(.text.init../src/pmm.c.133)
. = ( 0xe4e34 - code32flat_start ) ;
*32flat.*(.rodata.vp_init_simple)
. = ( 0xe4e48 - code32flat_start ) ;
*32flat.*(.rodata.parse_termarg_int)
. = ( 0xe4e7c - code32flat_start ) ;
*32flat.*(.rodata.parse_termobj)
. = ( 0xe4ed0 - code32flat_start ) ;
*32flat.*(.rodata.find_resource)
. = ( 0xe4ee4 - code32flat_start ) ;
*32flat.*(.rodata.maininit)
. = ( 0xe4f44 - code32flat_start ) ;
*32flat.*(.rodata.CSWTCH.1874)
. = ( 0xe4f58 - code32flat_start ) ;
*32flat.*(.rodata.__func__.2)
. = ( 0xe4f68 - code32flat_start ) ;
*32flat.*(.rodata.__func__.3)
. = ( 0xe4f7c - code32flat_start ) ;
*32flat.*(.rodata.__func__.4)
. = ( 0xe4f90 - code32flat_start ) ;
*32flat.*(.rodata.__func__.5)
. = ( 0xe4fa0 - code32flat_start ) ;
*32flat.*(.rodata.__func__.6)
. = ( 0xe4fb0 - code32flat_start ) ;
*32flat.*(.rodata.__func__.7)
. = ( 0xe4fc8 - code32flat_start ) ;
*32flat.*(.rodata.__func__.12)
. = ( 0xe4fdc - code32flat_start ) ;
*32flat.*(.rodata.__func__.13)
. = ( 0xe4ff0 - code32flat_start ) ;
*32flat.*(.rodata.__func__.14)
. = ( 0xe5008 - code32flat_start ) ;
*32flat.*(.rodata.__func__.15)
. = ( 0xe5018 - code32flat_start ) ;
*32flat.*(.rodata.__func__.16)
. = ( 0xe5040 - code32flat_start ) ;
*32flat.*(.rodata.names.17)
. = ( 0xe50ac - code32flat_start ) ;
*32flat.*(.rodata.__func__.19)
. = ( 0xe50b8 - code32flat_start ) ;
*32flat.*(.rodata.__func__.21)
. = ( 0xe50cc - code32flat_start ) ;
*32flat.*(.rodata.__func__.22)
. = ( 0xe50dc - code32flat_start ) ;
*32flat.*(.rodata.__func__.23)
. = ( 0xe50f0 - code32flat_start ) ;
*32flat.*(.rodata.__func__.24)
. = ( 0xe5100 - code32flat_start ) ;
*32flat.*(.rodata.__func__.25)
. = ( 0xe5110 - code32flat_start ) ;
*32flat.*(.rodata.__func__.26)
. = ( 0xe5124 - code32flat_start ) ;
*32flat.*(.rodata.__func__.27)
. = ( 0xe5134 - code32flat_start ) ;
*32flat.*(.rodata.__func__.28)
. = ( 0xe5154 - code32flat_start ) ;
*32flat.*(.rodata.__func__.29)
. = ( 0xe5170 - code32flat_start ) ;
*32flat.*(.rodata.__func__.30)
. = ( 0xe518c - code32flat_start ) ;
*32flat.*(.rodata.__func__.31)
. = ( 0xe51a4 - code32flat_start ) ;
*32flat.*(.rodata.__func__.32)
. = ( 0xe51bc - code32flat_start ) ;
*32flat.*(.rodata.__func__.33)
. = ( 0xe51d8 - code32flat_start ) ;
*32flat.*(.rodata.__func__.34)
. = ( 0xe51e8 - code32flat_start ) ;
*32flat.*(.rodata.__func__.36)
. = ( 0xe51fc - code32flat_start ) ;
*32flat.*(.rodata.__func__.37)
. = ( 0xe520c - code32flat_start ) ;
*32flat.*(.rodata.__func__.38)
. = ( 0xe521c - code32flat_start ) ;
*32flat.*(.rodata.__func__.39)
. = ( 0xe5228 - code32flat_start ) ;
*32flat.*(.rodata.__func__.40)
. = ( 0xe5234 - code32flat_start ) ;
*32flat.*(.rodata.__func__.41)
. = ( 0xe5240 - code32flat_start ) ;
*32flat.*(.rodata.__func__.42)
. = ( 0xe524c - code32flat_start ) ;
*32flat.*(.rodata.__func__.43)
. = ( 0xe5258 - code32flat_start ) ;
*32flat.*(.rodata.__func__.44)
. = ( 0xe5264 - code32flat_start ) ;
*32flat.*(.rodata.__func__.45)
. = ( 0xe5270 - code32flat_start ) ;
*32flat.*(.rodata.__func__.46)
. = ( 0xe527c - code32flat_start ) ;
*32flat.*(.rodata.__func__.48)
. = ( 0xe528c - code32flat_start ) ;
*32flat.*(.rodata.__func__.49)
. = ( 0xe52a4 - code32flat_start ) ;
*32flat.*(.rodata.__func__.50)
. = ( 0xe52bc - code32flat_start ) ;
*32flat.*(.rodata.__func__.51)
. = ( 0xe52c8 - code32flat_start ) ;
*32flat.*(.rodata.__func__.52)
. = ( 0xe52dc - code32flat_start ) ;
*32flat.*(.rodata.__func__.53)
. = ( 0xe52f4 - code32flat_start ) ;
*32flat.*(.rodata.__func__.54)
. = ( 0xe5308 - code32flat_start ) ;
*32flat.*(.rodata.__func__.57)
. = ( 0xe531c - code32flat_start ) ;
*32flat.*(.rodata.__func__.58)
. = ( 0xe5328 - code32flat_start ) ;
*32flat.*(.rodata.__func__.59)
. = ( 0xe533c - code32flat_start ) ;
*32flat.*(.rodata.__func__.60)
. = ( 0xe5358 - code32flat_start ) ;
*32flat.*(.rodata.__func__.61)
. = ( 0xe5368 - code32flat_start ) ;
*32flat.*(.rodata.__func__.62)
. = ( 0xe5378 - code32flat_start ) ;
*32flat.*(.rodata.__func__.63)
. = ( 0xe538c - code32flat_start ) ;
*32flat.*(.rodata.__func__.64)
. = ( 0xe53a4 - code32flat_start ) ;
*32flat.*(.rodata.__func__.67)
. = ( 0xe53b4 - code32flat_start ) ;
*32flat.*(.rodata.__func__.70)
. = ( 0xe53d0 - code32flat_start ) ;
*32flat.*(.rodata.__func__.71)
. = ( 0xe53e4 - code32flat_start ) ;
*32flat.*(.rodata.__func__.72)
. = ( 0xe5400 - code32flat_start ) ;
*32flat.*(.rodata.__func__.73)
. = ( 0xe5418 - code32flat_start ) ;
*32flat.*(.rodata.__func__.74)
. = ( 0xe5430 - code32flat_start ) ;
*32flat.*(.rodata.__func__.79)
. = ( 0xe5440 - code32flat_start ) ;
*32flat.*(.rodata.__func__.80)
. = ( 0xe5458 - code32flat_start ) ;
*32flat.*(.rodata.__func__.81)
. = ( 0xe5468 - code32flat_start ) ;
*32flat.*(.rodata.__func__.82)
. = ( 0xe5478 - code32flat_start ) ;
*32flat.*(.rodata.__func__.83)
. = ( 0xe548c - code32flat_start ) ;
*32flat.*(.rodata.__func__.84)
. = ( 0xe54a4 - code32flat_start ) ;
*32flat.*(.rodata.__func__.85)
. = ( 0xe54b0 - code32flat_start ) ;
*32flat.*(.rodata.__func__.86)
. = ( 0xe54c0 - code32flat_start ) ;
*32flat.*(.rodata.__func__.87)
. = ( 0xe54d0 - code32flat_start ) ;
*32flat.*(.rodata.__func__.88)
. = ( 0xe54e0 - code32flat_start ) ;
*32flat.*(.rodata.__func__.89)
. = ( 0xe54f4 - code32flat_start ) ;
*32flat.*(.rodata.__func__.90)
. = ( 0xe5504 - code32flat_start ) ;
*32flat.*(.rodata.__func__.91)
. = ( 0xe5518 - code32flat_start ) ;
*32flat.*(.rodata.__func__.92)
. = ( 0xe5528 - code32flat_start ) ;
*32flat.*(.rodata.__func__.93)
. = ( 0xe5538 - code32flat_start ) ;
*32flat.*(.rodata.__func__.94)
. = ( 0xe5550 - code32flat_start ) ;
*32flat.*(.rodata.__func__.96)
. = ( 0xe5564 - code32flat_start ) ;
*32flat.*(.rodata.__func__.97)
. = ( 0xe5578 - code32flat_start ) ;
*32flat.*(.rodata.__func__.98)
. = ( 0xe5588 - code32flat_start ) ;
*32flat.*(.rodata.__func__.99)
. = ( 0xe559c - code32flat_start ) ;
*32flat.*(.rodata.evt_separator.101)
. = ( 0xe55a0 - code32flat_start ) ;
*32flat.*(.rodata.__func__.102)
. = ( 0xe55b4 - code32flat_start ) ;
*32flat.*(.rodata.__func__.103)
. = ( 0xe55c8 - code32flat_start ) ;
*32flat.*(.rodata.__func__.106)
. = ( 0xe55d8 - code32flat_start ) ;
*32flat.*(.rodata.__func__.107)
. = ( 0xe55ec - code32flat_start ) ;
*32flat.*(.rodata.__func__.108)
. = ( 0xe55fc - code32flat_start ) ;
*32flat.*(.rodata.__func__.110)
. = ( 0xe560c - code32flat_start ) ;
*32flat.*(.rodata.__func__.111)
. = ( 0xe5618 - code32flat_start ) ;
*32flat.*(.rodata.__func__.112)
. = ( 0xe5628 - code32flat_start ) ;
*32flat.*(.rodata.__func__.113)
. = ( 0xe563c - code32flat_start ) ;
*32flat.*(.rodata.__func__.114)
. = ( 0xe5654 - code32flat_start ) ;
*32flat.*(.rodata.__func__.115)
. = ( 0xe5668 - code32flat_start ) ;
*32flat.*(.rodata.__func__.116)
. = ( 0xe5674 - code32flat_start ) ;
*32flat.*(.rodata.__func__.117)
. = ( 0xe567c - code32flat_start ) ;
*32flat.*(.rodata.__func__.118)
. = ( 0xe5690 - code32flat_start ) ;
*32flat.*(.rodata.__func__.119)
. = ( 0xe569c - code32flat_start ) ;
*32flat.*(.rodata.__func__.120)
. = ( 0xe56b0 - code32flat_start ) ;
*32flat.*(.rodata.__func__.121)
. = ( 0xe56c0 - code32flat_start ) ;
*32flat.*(.rodata.__func__.122)
. = ( 0xe56d4 - code32flat_start ) ;
*32flat.*(.rodata.__func__.124)
. = ( 0xe56e8 - code32flat_start ) ;
*32flat.*(.rodata.__func__.125)
. = ( 0xe56fc - code32flat_start ) ;
*32flat.*(.rodata.__func__.126)
. = ( 0xe570c - code32flat_start ) ;
*32flat.*(.rodata.__func__.127)
. = ( 0xe571c - code32flat_start ) ;
*32flat.*(.rodata.__func__.128)
. = ( 0xe5734 - code32flat_start ) ;
*32flat.*(.rodata.__func__.130)
. = ( 0xe5744 - code32flat_start ) ;
*32flat.*(.rodata.__func__.131)
. = ( 0xe5750 - code32flat_start ) ;
*32flat.*(.rodata.__func__.135)
. = ( 0xe575c - code32flat_start ) ;
*32flat.*(.rodata.__func__.136)
. = ( 0xe5770 - code32flat_start ) ;
*32flat.*(.rodata.__func__.137)
. = ( 0xe577c - code32flat_start ) ;
*32flat.*(.rodata.__func__.138)
. = ( 0xe5790 - code32flat_start ) ;
*32flat.*(.rodata.__func__.141)
. = ( 0xe57a8 - code32flat_start ) ;
*32flat.*(.rodata.__func__.142)
. = ( 0xe57bc - code32flat_start ) ;
*32flat.*(.rodata.__func__.144)
. = ( 0xe57cc - code32flat_start ) ;
*32flat.*(.rodata.__func__.145)
. = ( 0xe57e4 - code32flat_start ) ;
*32flat.*(.rodata.__func__.148)
. = ( 0xe57f8 - code32flat_start ) ;
*32flat.*(.rodata.__func__.150)
. = ( 0xe5808 - code32flat_start ) ;
*32flat.*(.rodata.__func__.151)
. = ( 0xe5814 - code32flat_start ) ;
*32flat.*(.rodata.__func__.152)
. = ( 0xe5824 - code32flat_start ) ;
*32flat.*(.rodata.__func__.153)
. = ( 0xe583c - code32flat_start ) ;
*32flat.*(.rodata.__func__.156)
. = ( 0xe5854 - code32flat_start ) ;
*32flat.*(.rodata.__func__.157)
. = ( 0xe5868 - code32flat_start ) ;
*32flat.*(.rodata.__func__.159)
. = ( 0xe5878 - code32flat_start ) ;
*32flat.*(.rodata.__func__.160)
. = ( 0xe5890 - code32flat_start ) ;
*32flat.*(.rodata.__func__.161)
. = ( 0xe58a4 - code32flat_start ) ;
*32flat.*(.rodata.__func__.162)
. = ( 0xe58b4 - code32flat_start ) ;
*32flat.*(.rodata.__func__.163)
. = ( 0xe58c0 - code32flat_start ) ;
*32flat.*(.rodata.__func__.164)
. = ( 0xe58d4 - code32flat_start ) ;
*32flat.*(.rodata.__func__.165)
. = ( 0xe58e4 - code32flat_start ) ;
*32flat.*(.rodata.__func__.166)
. = ( 0xe58f4 - code32flat_start ) ;
*32flat.*(.rodata.mem_power.173)
. = ( 0xe58fc - code32flat_start ) ;
*32flat.*(.rodata.__func__.241)
. = ( 0xe590c - code32flat_start ) ;
*32flat.*(.rodata.__func__.242)
. = ( 0xe5918 - code32flat_start ) ;
*32flat.*(.rodata.__func__.243)
. = ( 0xe592c - code32flat_start ) ;
*32flat.*(.rodata.__func__.244)
. = ( 0xe5940 - code32flat_start ) ;
*32flat.*(.rodata.acpi_find_tbl)
. = ( 0xe5980 - code32flat_start ) ;
*32flat.*(.rodata.fadt_init_tbl)
. = ( 0xe59c0 - code32flat_start ) ;
*32flat.*(.rodata.pci_platform_tbl)
. = ( 0xe5a00 - code32flat_start ) ;
*32flat.*(.rodata.pci_device_tbl)
. = ( 0xe5b18 - code32flat_start ) ;
*32flat.*(.rodata.pci_irqs)
. = ( 0xe5b1c - code32flat_start ) ;
*32flat.*(.rodata.region_type_name)
. = ( 0xe5b28 - code32flat_start ) ;
*32flat.*(.rodata.speed_to_xhci)
. = ( 0xe5b40 - code32flat_start ) ;
*32flat.*(.rodata.speed_from_xhci)
. = ( 0xe5b80 - code32flat_start ) ;
*32flat.*(.rodata.aaidct)
. = ( 0xe5ba0 - code32flat_start ) ;
*32flat.*(.rodata.zig)
. = ( 0xe5be0 - code32flat_start ) ;
*32flat.*(.rodata.menuchars)
. = ( 0xe5c20 - code32flat_start ) ;
*32flat.*(.rodata.pci_ata_tbl)
. = ( 0xe5c5c - code32flat_start ) ;
*32flat.*(.rodata.speed_to_ctlsize)
. = ( 0xe5c6c - code32flat_start ) ;
*32flat.*(.data.prio_halt.109)
. = ( 0xe5c70 - code32flat_start ) ;
*32flat.*(.data.varinit../src/fw/dsdt_parser.c.27)
. = ( 0xe5c80 - code32flat_start ) ;
*32flat.*(.data.PIR_TABLE)
. = ( 0xe5d00 - code32flat_start ) ;
*32flat.*(.data.ssdp_pcihp_aml)
. = ( 0xe5d60 - code32flat_start ) ;
*32flat.*(.data.ssdp_proc_aml)
. = ( 0xe5dd8 - code32flat_start ) ;
*32flat.*(.data.pci_slot_get_irq)
. = ( 0xe5de0 - code32flat_start ) ;
*32flat.*(.data.pci_io_low_end)
. = ( 0xe5de8 - code32flat_start ) ;
*32flat.*(.data.pcimem64_end)
. = ( 0xe5df0 - code32flat_start ) ;
*32flat.*(.data.pcimem64_start)
. = ( 0xe5df8 - code32flat_start ) ;
*32flat.*(.data.pcimem_start)
. = ( 0xe5e00 - code32flat_start ) ;
*32flat.*(.data.HubOp)
. = ( 0xe5e10 - code32flat_start ) ;
*32flat.*(.data.xhci_hub_ops)
. = ( 0xe5e20 - code32flat_start ) ;
*32flat.*(.data.varinit../src/hw/pcidevice.c.16)
. = ( 0xe5e40 - code32flat_start ) ;
*32flat.*(.data.zig2)
. = ( 0xe5e80 - code32flat_start ) ;
*32flat.*(.data.varinit../src/boot.c.514)
. = ( 0xe5e84 - code32flat_start ) ;
*32flat.*(.data.DefaultBEVPrio)
. = ( 0xe5e88 - code32flat_start ) ;
*32flat.*(.data.DefaultHDPrio)
. = ( 0xe5e8c - code32flat_start ) ;
*32flat.*(.data.DefaultCDPrio)
. = ( 0xe5e90 - code32flat_start ) ;
*32flat.*(.data.DefaultFloppyPrio)
. = ( 0xe5e94 - code32flat_start ) ;
*32flat.*(.data.varinit../src/boot.c.245)
. = ( 0xe5e98 - code32flat_start ) ;
*32flat.*(.data.varinit../src/boot.c.110)
. = ( 0xe5e9c - code32flat_start ) ;
*32flat.*(.data.varinit../src/romfile.c.13)
. = ( 0xe5ea0 - code32flat_start ) ;
*32flat.*(.data.RomEnd)
. = ( 0xe5ea4 - code32flat_start ) ;
*32flat.*(.data.varinit../src/malloc.c.40)
. = ( 0xe5eb8 - code32flat_start ) ;
*32flat.*(.data.varinit../src/malloc.c.38)
. = ( 0xe5ec0 - code32flat_start ) ;
*32flat.*(.data.varinit../src/malloc.c.37)
. = ( 0xe5ec4 - code32flat_start ) ;
*32flat.*(.data.varinit../src/malloc.c.36)
. = ( 0xe5ecc - code32flat_start ) ;
*32flat.*(.data.MptIOCInitRequest)
. = ( 0xe5ee4 - code32flat_start ) ;
*32flat.*(.data.ehci_HubOp)
. = ( 0xe5ef4 - code32flat_start ) ;
*32flat.*(.data.ohci_HubOp)
. = ( 0xe5f04 - code32flat_start ) ;
*32flat.*(.data.uhci_HubOp)
. = ( 0xe5f20 - code32flat_start ) ;
*32flat.*(.bss.used_bitmap.35)
. = ( 0xe5f40 - code32flat_start ) ;
*32flat.*(.bss.ataid.129)
. = ( 0xe5f44 - code32flat_start ) ;
*32flat.*(.bss.xen_hypercall_page)
. = ( 0xe5f48 - code32flat_start ) ;
*32flat.*(.bss.pci_pad_mem64)
. = ( 0xe5f50 - code32flat_start ) ;
*32flat.*(.bss.pci_mem64_top)
. = ( 0xe5f58 - code32flat_start ) ;
*32flat.*(.bss.kvmclock)
. = ( 0xe5f5c - code32flat_start ) ;
*32flat.*(.bss.kvm_cpuid_base)
. = ( 0xe5f60 - code32flat_start ) ;
*32flat.*(.bss.CPULongMode)
. = ( 0xe5f61 - code32flat_start ) ;
*32flat.*(.bss.CPUPhysBits)
. = ( 0xe5f68 - code32flat_start ) ;
*32flat.*(.bss.RamSizeOver4G)
. = ( 0xe5f70 - code32flat_start ) ;
*32flat.*(.bss.RamSize)
. = ( 0xe5f74 - code32flat_start ) ;
*32flat.*(.bss.SMBios30Addr)
. = ( 0xe5f78 - code32flat_start ) ;
*32flat.*(.bss.SMBios21Addr)
. = ( 0xe5f7c - code32flat_start ) ;
*32flat.*(.bss.TPM_has_physical_presence)
. = ( 0xe5f80 - code32flat_start ) ;
*32flat.*(.bss.BootsplashActive)
. = ( 0xe5f84 - code32flat_start ) ;
*32flat.*(.bss.HaveFDBoot)
. = ( 0xe5f88 - code32flat_start ) ;
*32flat.*(.bss.HaveHDBoot)
. = ( 0xe5f8c - code32flat_start ) ;
*32flat.*(.bss.BootorderCount)
. = ( 0xe5f90 - code32flat_start ) ;
*32flat.*(.bss.BiosGeometryCount)
. = ( 0xe5f94 - code32flat_start ) ;
*32flat.*(.bss.RunPCIroms)
. = ( 0xe5f98 - code32flat_start ) ;
*32flat.*(.bss.SpinupEnd)
. = ( 0xe5f9c - code32flat_start ) ;
*32flat.*(.bss.PendingEHCI)
. = ( 0xe5fa0 - code32flat_start ) ;
*32flat.*(.bss.usb_time_sigatt)
. = ( 0xe5fa4 - code32flat_start ) ;
*32flat.*(.bss.CDCount)
. = ( 0xe5fc0 - code32flat_start ) ;
*32flat.*(.text.set_a20)
. = ( 0xe5fda - code32flat_start ) ;
*32flat.*(.text.runningOnXen)
. = ( 0xe5fe5 - code32flat_start ) ;
*32flat.*(.text.threads_during_optionroms)
. = ( 0xe5ffd - code32flat_start ) ;
*32flat.*(.text.switch_next)
. = ( 0xe601b - code32flat_start ) ;
*32flat.*(.text.putc)
. = ( 0xe6020 - code32flat_start ) ;
*32flat.*(.text.putuint)
. = ( 0xe606e - code32flat_start ) ;
*32flat.*(.text.putsinglehex)
. = ( 0xe608e - code32flat_start ) ;
*32flat.*(.text.puthex)
. = ( 0xe6127 - code32flat_start ) ;
*32flat.*(.text.putprettyhex)
. = ( 0xe617c - code32flat_start ) ;
*32flat.*(.text.strlen)
. = ( 0xe618d - code32flat_start ) ;
*32flat.*(.text.memcmp)
. = ( 0xe61ae - code32flat_start ) ;
*32flat.*(.text.strcmp)
. = ( 0xe61ce - code32flat_start ) ;
*32flat.*(.text.pci_config_writel)
. = ( 0xe620d - code32flat_start ) ;
*32flat.*(.text.pci_config_writew)
. = ( 0xe6252 - code32flat_start ) ;
*32flat.*(.text.pci_config_writeb)
. = ( 0xe6295 - code32flat_start ) ;
*32flat.*(.text.pci_config_readl)
. = ( 0xe62c9 - code32flat_start ) ;
*32flat.*(.text.pci_config_readw)
. = ( 0xe6307 - code32flat_start ) ;
*32flat.*(.text.pci_config_readb)
. = ( 0xe6343 - code32flat_start ) ;
*32flat.*(.text.qemu_debug_putc)
. = ( 0xe6351 - code32flat_start ) ;
*32flat.*(.text.debug_putc)
. = ( 0xe6359 - code32flat_start ) ;
*32flat.*(.text.scsi_is_read)
. = ( 0xe637a - code32flat_start ) ;
*32flat.*(.text.rom_get_max)
. = ( 0xe638b - code32flat_start ) ;
*32flat.*(.text.cpuid)
. = ( 0xe63d4 - code32flat_start ) ;
*32flat.*(.text.make_bios_readonly_intel)
. = ( 0xe6482 - code32flat_start ) ;
*32flat.*(.text.mch_isa_lpc_setup)
. = ( 0xe64c2 - code32flat_start ) ;
*32flat.*(.text.piix4_pm_config_setup)
. = ( 0xe652f - code32flat_start ) ;
*32flat.*(.text.ich9_smbus_enable)
. = ( 0xe6561 - code32flat_start ) ;
*32flat.*(.text.smp_write_msrs)
. = ( 0xe6589 - code32flat_start ) ;
*32flat.*(.text.apic_id_init)
. = ( 0xe65f7 - code32flat_start ) ;
*32flat.*(.text._vp_read)
. = ( 0xe6790 - code32flat_start ) ;
*32flat.*(.text._vp_write)
. = ( 0xe689e - code32flat_start ) ;
*32flat.*(.text.tis_get_tpm_version)
. = ( 0xe68c6 - code32flat_start ) ;
*32flat.*(.text.crb_get_tpm_version)
. = ( 0xe68c9 - code32flat_start ) ;
*32flat.*(.text.crb_activate)
. = ( 0xe68d9 - code32flat_start ) ;
*32flat.*(.text.crb_waitdatavalid)
. = ( 0xe68dc - code32flat_start ) ;
*32flat.*(.text.tpm_log_event)
. = ( 0xe694b - code32flat_start ) ;
*32flat.*(.text.set_timeouts)
. = ( 0xe69a2 - code32flat_start ) ;
*32flat.*(.text.cpu_to_be32)
. = ( 0xe69a5 - code32flat_start ) ;
*32flat.*(.text.sha1_block)
. = ( 0xe6b18 - code32flat_start ) ;
*32flat.*(.text.crb_readresp)
. = ( 0xe6b72 - code32flat_start ) ;
*32flat.*(.text.tpmhw_transmit)
. = ( 0xe6be6 - code32flat_start ) ;
*32flat.*(.text.sha256_block)
. = ( 0xe6e47 - code32flat_start ) ;
*32flat.*(.text.code_mutable_preinit)
. = ( 0xe6e63 - code32flat_start ) ;
*32flat.*(.text.crb_senddata)
. = ( 0xe6e8e - code32flat_start ) ;
*32flat.*(.text.init_timeout)
. = ( 0xe6ee4 - code32flat_start ) ;
*32flat.*(.text.crb_init)
. = ( 0xe6f14 - code32flat_start ) ;
*32flat.*(.text.tis_init)
. = ( 0xe6f28 - code32flat_start ) ;
*32flat.*(.text.vring_kick.constprop.0)
. = ( 0xe701e - code32flat_start ) ;
*32flat.*(.text.checksum)
. = ( 0xe702e - code32flat_start ) ;
*32flat.*(.text.vring_get_buf.constprop.0.isra.0)
. = ( 0xe7083 - code32flat_start ) ;
*32flat.*(.text.vp_get_isr.isra.0)
. = ( 0xe70b9 - code32flat_start ) ;
*32flat.*(.text.ahci_port_writel.isra.0)
. = ( 0xe70cc - code32flat_start ) ;
*32flat.*(.text.ahci_port_readl.isra.0)
. = ( 0xe70db - code32flat_start ) ;
*32flat.*(.text.default_process_op.isra.0)
. = ( 0xe70f4 - code32flat_start ) ;
*32flat.*(.text.memset.isra.0)
. = ( 0xe70ff - code32flat_start ) ;
*32flat.*(.text.tpm_simple_cmd)
. = ( 0xe71ab - code32flat_start ) ;
*32flat.*(.text.sha1_do)
. = ( 0xe729a - code32flat_start ) ;
*32flat.*(.text.sha1)
. = ( 0xe72cd - code32flat_start ) ;
*32flat.*(.text.scsi_fill_cmd)
. = ( 0xe7330 - code32flat_start ) ;
*32flat.*(.text.tpm20_hierarchycontrol.constprop.0.isra.0)
. = ( 0xe739e - code32flat_start ) ;
*32flat.*(.text.tpm_set_failure)
. = ( 0xe73e7 - code32flat_start ) ;
*32flat.*(.text.tpm20_extend)
. = ( 0xe7482 - code32flat_start ) ;
*32flat.*(.text.tpm_extend)
. = ( 0xe7515 - code32flat_start ) ;
*32flat.*(.text.hash_log_extend.isra.0)
. = ( 0xe75bd - code32flat_start ) ;
*32flat.*(.text.irqtimer_calc)
. = ( 0xe7600 - code32flat_start ) ;
*32flat.*(.text.start_preempt)
. = ( 0xe7638 - code32flat_start ) ;
*32flat.*(.text.smm_relocate_and_restore)
. = ( 0xe7698 - code32flat_start ) ;
*32flat.*(.text.smm_save_and_copy)
. = ( 0xe76e8 - code32flat_start ) ;
*32flat.*(.text.tpm_build_digest)
. = ( 0xe786a - code32flat_start ) ;
*32flat.*(.text.tpm_add_measurement_to_log)
. = ( 0xe7904 - code32flat_start ) ;
*32flat.*(.text.tpm_add_action)
. = ( 0xe7928 - code32flat_start ) ;
*32flat.*(.text.cpu_to_be64)
. = ( 0xe7933 - code32flat_start ) ;
*32flat.*(.text.sha512_block)
. = ( 0xe7d59 - code32flat_start ) ;
*32flat.*(.text.sha256)
. = ( 0xe7e64 - code32flat_start ) ;
*32flat.*(.text.sha512_do)
. = ( 0xe7f8a - code32flat_start ) ;
*32flat.*(.text.sha384)
. = ( 0xe7fbd - code32flat_start ) ;
*32flat.*(.text.sha512)
. = ( 0xe7ff0 - code32flat_start ) ;
*32flat.*(.text.timer_read)
. = ( 0xe8060 - code32flat_start ) ;
*32flat.*(.text.timer_calc)
. = ( 0xe8073 - code32flat_start ) ;
*32flat.*(.text.timer_calc_usec)
. = ( 0xe80b7 - code32flat_start ) ;
*32flat.*(.text.timer_check)
. = ( 0xe80cb - code32flat_start ) ;
*32flat.*(.text.timer_delay)
. = ( 0xe80df - code32flat_start ) ;
*32flat.*(.text.udelay)
. = ( 0xe80e9 - code32flat_start ) ;
*32flat.*(.text.pci_ioconfig_next.constprop.0)
. = ( 0xe815a - code32flat_start ) ;
*32flat.*(.text.__make_bios_writable_intel)
. = ( 0xe8215 - code32flat_start ) ;
*32flat.*(.text.make_bios_writable_intel)
. = ( 0xe8254 - code32flat_start ) ;
*32flat.*(.text.bvprintf)
. = ( 0xe84cf - code32flat_start ) ;
*32flat.*(.text.panic)
. = ( 0xe84e5 - code32flat_start ) ;
*32flat.*(.text.call16_override)
. = ( 0xe8520 - code32flat_start ) ;
*32flat.*(.text.vring_add_buf.constprop.0)
. = ( 0xe8630 - code32flat_start ) ;
*32flat.*(.text.call16.isra.0)
. = ( 0xe86a5 - code32flat_start ) ;
*32flat.*(.text.reset)
. = ( 0xe86b8 - code32flat_start ) ;
*32flat.*(.text.check_irqs)
. = ( 0xe86d2 - code32flat_start ) ;
*32flat.*(.text.yield)
. = ( 0xe86ff - code32flat_start ) ;
*32flat.*(.text.finish_preempt)
. = ( 0xe8732 - code32flat_start ) ;
*32flat.*(.text.usleep)
. = ( 0xe874e - code32flat_start ) ;
*32flat.*(.text.virtio_blk_op_one_segment)
. = ( 0xe87b3 - code32flat_start ) ;
*32flat.*(.text.virtio_blk_op)
. = ( 0xe88ce - code32flat_start ) ;
*32flat.*(.text.yield_toirq)
. = ( 0xe88f6 - code32flat_start ) ;
*32flat.*(.text.qemu_cfg_dma_transfer)
. = ( 0xe894a - code32flat_start ) ;
*32flat.*(.text.qemu_cfg_read)
. = ( 0xe8970 - code32flat_start ) ;
*32flat.*(.text.qemu_cfg_read_entry)
. = ( 0xe89a6 - code32flat_start ) ;
*32flat.*(.text.qemu_get_present_cpus_count)
. = ( 0xe89f1 - code32flat_start ) ;
*32flat.*(.text.qemu_cfg_skip)
. = ( 0xe8a1a - code32flat_start ) ;
*32flat.*(.text.__call16_int)
. = ( 0xe8a3c - code32flat_start ) ;
*32flat.*(.text.screenc)
. = ( 0xe8a90 - code32flat_start ) ;
*32flat.*(.text.screen_putc)
. = ( 0xe8abd - code32flat_start ) ;
*32flat.*(.text.printf)
. = ( 0xe8ad0 - code32flat_start ) ;
*32flat.*(.text.boot_fail)
. = ( 0xe8b4a - code32flat_start ) ;
*32flat.*(.text.__dprintf)
. = ( 0xe8bb7 - code32flat_start ) ;
*32flat.*(.text.debug_banner)
. = ( 0xe8bd9 - code32flat_start ) ;
*32flat.*(.text.__warn_internalerror)
. = ( 0xe8be9 - code32flat_start ) ;
*32flat.*(.text.qemu_cfg_write_file_simple)
. = ( 0xe8c56 - code32flat_start ) ;
*32flat.*(.text.__warn_noalloc)
. = ( 0xe8c66 - code32flat_start ) ;
*32flat.*(.text.__warn_timeout)
. = ( 0xe8c76 - code32flat_start ) ;
*32flat.*(.text.uhci_waittick)
. = ( 0xe8cbf - code32flat_start ) ;
*32flat.*(.text.ohci_waittick)
. = ( 0xe8d07 - code32flat_start ) ;
*32flat.*(.text.ehci_waittick)
. = ( 0xe8d8a - code32flat_start ) ;
*32flat.*(.text.await_ide.constprop.0)
. = ( 0xe8dde - code32flat_start ) ;
*32flat.*(.text.await_not_bsy)
. = ( 0xe8ded - code32flat_start ) ;
*32flat.*(.text.ndelay_await_not_bsy)
. = ( 0xe8e21 - code32flat_start ) ;
*32flat.*(.text.send_cmd)
. = ( 0xe8eff - code32flat_start ) ;
*32flat.*(.text.wait_reg8)
. = ( 0xe8f4b - code32flat_start ) ;
*32flat.*(.text.crb_probe)
. = ( 0xe8fb4 - code32flat_start ) ;
*32flat.*(.text.tis_activate)
. = ( 0xe9022 - code32flat_start ) ;
*32flat.*(.text.tis_find_active_locality)
. = ( 0xe9044 - code32flat_start ) ;
*32flat.*(.text.tis_readresp)
. = ( 0xe9083 - code32flat_start ) ;
*32flat.*(.text.tis_probe)
. = ( 0xe90df - code32flat_start ) ;
*32flat.*(.text.crb_waitrespready)
. = ( 0xe90fb - code32flat_start ) ;
*32flat.*(.text.crb_ready)
. = ( 0xe9120 - code32flat_start ) ;
*32flat.*(.text.tis_ready)
. = ( 0xe9155 - code32flat_start ) ;
*32flat.*(.text.tis_waitdatavalid)
. = ( 0xe9189 - code32flat_start ) ;
*32flat.*(.text.tis_waitrespready)
. = ( 0xe91c8 - code32flat_start ) ;
*32flat.*(.text.tis_senddata)
. = ( 0xe9265 - code32flat_start ) ;
*32flat.*(.text.sdcard_reset.isra.0)
. = ( 0xe929e - code32flat_start ) ;
*32flat.*(.text.pic_setup)
. = ( 0xe92ce - code32flat_start ) ;
*32flat.*(.text.i8042_wait_write)
. = ( 0xe9310 - code32flat_start ) ;
*32flat.*(.text.wait_td)
. = ( 0xe9364 - code32flat_start ) ;
*32flat.*(.text.uhci_send_pipe)
. = ( 0xe9646 - code32flat_start ) ;
*32flat.*(.text.ohci_send_pipe)
. = ( 0xe9838 - code32flat_start ) ;
*32flat.*(.text.ehci_send_pipe)
. = ( 0xe9ad6 - code32flat_start ) ;
*32flat.*(.text.ata_wait_data)
. = ( 0xe9b26 - code32flat_start ) ;
*32flat.*(.text.megasas_fire_cmd)
. = ( 0xe9bd7 - code32flat_start ) ;
*32flat.*(.text.is_valid_rom)
. = ( 0xe9c40 - code32flat_start ) ;
*32flat.*(.text.ahci_command)
. = ( 0xe9ed8 - code32flat_start ) ;
*32flat.*(.text.ahci_disk_readwrite_aligned)
. = ( 0xea001 - code32flat_start ) ;
*32flat.*(.text.ahci_disk_readwrite)
. = ( 0xea0d0 - code32flat_start ) ;
*32flat.*(.text.xhci_print_port_state)
. = ( 0xea132 - code32flat_start ) ;
*32flat.*(.text.xhci_doorbell)
. = ( 0xea15b - code32flat_start ) ;
*32flat.*(.text.sdcard_waitw)
. = ( 0xea1c3 - code32flat_start ) ;
*32flat.*(.text.find_acpi_table)
. = ( 0xea2ac - code32flat_start ) ;
*32flat.*(.text.make_bios_readonly)
. = ( 0xea301 - code32flat_start ) ;
*32flat.*(.text.validate_info)
. = ( 0xea357 - code32flat_start ) ;
*32flat.*(.text.nvme_commit_sqe)
. = ( 0xea385 - code32flat_start ) ;
*32flat.*(.text.nvme_wait)
. = ( 0xea49f - code32flat_start ) ;
*32flat.*(.text.xhci_trb_queue)
. = ( 0xea562 - code32flat_start ) ;
*32flat.*(.text.xhci_xfer_normal)
. = ( 0xea58c - code32flat_start ) ;
*32flat.*(.text.xhci_process_events)
. = ( 0xea6dc - code32flat_start ) ;
*32flat.*(.text.xhci_event_wait)
. = ( 0xea734 - code32flat_start ) ;
*32flat.*(.text.usb_send_pipe)
. = ( 0xea87e - code32flat_start ) ;
*32flat.*(.text.sdcard_pio)
. = ( 0xea909 - code32flat_start ) ;
*32flat.*(.text.sdcard_pio_transfer)
. = ( 0xeaa1f - code32flat_start ) ;
*32flat.*(.text.make_bios_writable)
. = ( 0xeaab3 - code32flat_start ) ;
*32flat.*(.text.smm_setup)
. = ( 0xeabc3 - code32flat_start ) ;
*32flat.*(.text.usb_process_op)
. = ( 0xeacd6 - code32flat_start ) ;
*32flat.*(.text.uas_process_op)
. = ( 0xeae58 - code32flat_start ) ;
*32flat.*(.text.smp_scan)
. = ( 0xeaf72 - code32flat_start ) ;
*32flat.*(.text.mch_mmconfig_setup)
. = ( 0xeafc6 - code32flat_start ) ;
*32flat.*(.text.nvme_get_next_sqe.constprop.0)
. = ( 0xeb04a - code32flat_start ) ;
*32flat.*(.text.nvme_io_xfer)
. = ( 0xeb122 - code32flat_start ) ;
*32flat.*(.text.ata_pio_transfer.constprop.0)
. = ( 0xeb1d1 - code32flat_start ) ;
*32flat.*(.text.__callrom)
. = ( 0xeb262 - code32flat_start ) ;
*32flat.*(.text.call_boot_entry)
. = ( 0xeb2c4 - code32flat_start ) ;
*32flat.*(.text.boot_disk)
. = ( 0xeb3bc - code32flat_start ) ;
*32flat.*(.text.runtime../src/stacks.c.762)
. = ( 0xeb3cc - code32flat_start ) ;
*32flat.*(.text.runtime../src/block.c.571)
. = ( 0xec09a - code32flat_start ) ;
*32flat.*(.text.process_op)
. = ( 0xec0dc - code32flat_start ) ;
*32flat.*(.text.scsi_is_ready)
. = ( 0xec1f9 - code32flat_start ) ;
*32flat.*(.text.cdrom_boot)
. = ( 0xec4ff - code32flat_start ) ;
*32flat.*(.text.do_boot)
. = ( 0xec66d - code32flat_start ) ;
*32flat.*(.text.runtime../src/resume.c.146)
. = ( 0xec9b4 - code32flat_start ) ;
*32flat.*(.text.runtime../src/post.c.182)
. = ( 0xec9fa - code32flat_start ) ;
*32flat.*(.text.runtime../src/post.c.320)
. = ( 0xecadf - code32flat_start ) ;
*32flat.*(.text.runtime../src/boot.c.1027)
. = ( 0xecb0b - code32flat_start ) ;
*32flat.*(.text.runtime../src/boot.c.1037)
. = ( 0xecb35 - code32flat_start ) ;
*32flat.*(.text.runtime../src/tcgbios.c.1653)
. = ( 0xece45 - code32flat_start ) ;
*32flat.*(.text.runtime../src/hw/usb-xhci.c.1176)
. = ( 0xeced4 - code32flat_start ) ;
*32flat.*(.text.runtime../src/fw/smm.c.70)
. = ( 0xed147 - code32flat_start ) ;
*32flat.*(.text.runtime../src/fw/smp.c.83)
. = ( 0xed180 - code32flat_start ) ;
_rodata32flat = . ;
*32flat.*(.rodata)
. = ( 0xf31a0 - code32flat_start ) ;
*32flat.*(.rodata.puthex)
. = ( 0xf31bc - code32flat_start ) ;
*32flat.*(.rodata.runtime../src/tcgbios.c.1653)
. = ( 0xf31e0 - code32flat_start ) ;
*32flat.*(.rodata.sha_ko.0)
. = ( 0xf3460 - code32flat_start ) ;
*32flat.*(.rodata.sha_ko.1)
. = ( 0xf3560 - code32flat_start ) ;
*32flat.*(.rodata.__func__.8)
. = ( 0xf356c - code32flat_start ) ;
*32flat.*(.rodata.__func__.9)
. = ( 0xf357c - code32flat_start ) ;
*32flat.*(.rodata.__func__.10)
. = ( 0xf358c - code32flat_start ) ;
*32flat.*(.rodata.__func__.11)
. = ( 0xf3598 - code32flat_start ) ;
*32flat.*(.rodata.__func__.47)
. = ( 0xf35a4 - code32flat_start ) ;
*32flat.*(.rodata.__func__.55)
. = ( 0xf35b4 - code32flat_start ) ;
*32flat.*(.rodata.__func__.56)
. = ( 0xf35cc - code32flat_start ) ;
*32flat.*(.rodata.__func__.65)
. = ( 0xf35dc - code32flat_start ) ;
*32flat.*(.rodata.__func__.66)
. = ( 0xf35ec - code32flat_start ) ;
*32flat.*(.rodata.__func__.68)
. = ( 0xf35fc - code32flat_start ) ;
*32flat.*(.rodata.__func__.69)
. = ( 0xf360c - code32flat_start ) ;
*32flat.*(.rodata.__func__.75)
. = ( 0xf3620 - code32flat_start ) ;
*32flat.*(.rodata.__func__.76)
. = ( 0xf3630 - code32flat_start ) ;
*32flat.*(.rodata.__func__.77)
. = ( 0xf3640 - code32flat_start ) ;
*32flat.*(.rodata.__func__.78)
. = ( 0xf3650 - code32flat_start ) ;
*32flat.*(.rodata.__func__.95)
. = ( 0xf3660 - code32flat_start ) ;
*32flat.*(.rodata.sha_ko.100)
. = ( 0xf3670 - code32flat_start ) ;
*32flat.*(.rodata.__func__.104)
. = ( 0xf367c - code32flat_start ) ;
*32flat.*(.rodata.__func__.105)
. = ( 0xf3688 - code32flat_start ) ;
*32flat.*(.rodata.__func__.123)
. = ( 0xf369c - code32flat_start ) ;
*32flat.*(.rodata.__func__.132)
. = ( 0xf36a8 - code32flat_start ) ;
*32flat.*(.rodata.__func__.139)
. = ( 0xf36b8 - code32flat_start ) ;
*32flat.*(.rodata.__func__.140)
. = ( 0xf36c8 - code32flat_start ) ;
*32flat.*(.rodata.__func__.143)
. = ( 0xf36d8 - code32flat_start ) ;
*32flat.*(.rodata.__func__.146)
. = ( 0xf36e0 - code32flat_start ) ;
*32flat.*(.rodata.__func__.147)
. = ( 0xf36f0 - code32flat_start ) ;
*32flat.*(.rodata.__func__.149)
. = ( 0xf3700 - code32flat_start ) ;
*32flat.*(.rodata.__func__.154)
. = ( 0xf370c - code32flat_start ) ;
*32flat.*(.rodata.__func__.155)
. = ( 0xf3714 - code32flat_start ) ;
*32flat.*(.rodata.__func__.158)
. = ( 0xf3724 - code32flat_start ) ;
*32flat.*(.rodata.__func__.167)
. = ( 0xf3738 - code32flat_start ) ;
*32flat.*(.rodata.tpm_default_durations)
. = ( 0xf3744 - code32flat_start ) ;
*32flat.*(.rodata.tis_default_timeouts)
. = ( 0xf3760 - code32flat_start ) ;
*32flat.*(.rodata.speed_name)
. = ( 0xf37a0 - code32flat_start ) ;
*32flat.*(.rodata.hash_parameters)
. = ( 0xf3800 - code32flat_start ) ;
*32flat.*(.data.TPMHW_driver_to_use)
. = ( 0xf3820 - code32flat_start ) ;
*32flat.*(.data.tpm_drivers)
. = ( 0xf3880 - code32flat_start ) ;
*32flat.*(.data.SMMPMDeviceBDF)
. = ( 0xf3884 - code32flat_start ) ;
*32flat.*(.data.SMMISADeviceBDF)
. = ( 0xf3888 - code32flat_start ) ;
*32flat.*(.data.MCHMmcfgBDF)
. = ( 0xf388c - code32flat_start ) ;
*32flat.*(.data.ICH9SmbusBDF)
. = ( 0xf3890 - code32flat_start ) ;
*32flat.*(.data.PiixPmBDF)
. = ( 0xf3894 - code32flat_start ) ;
*32flat.*(.data.ICH9LpcBDF)
. = ( 0xf3898 - code32flat_start ) ;
*32flat.*(.data.ShadowBDF)
. = ( 0xf389c - code32flat_start ) ;
*32flat.*(.data.acpi_pm_base)
. = ( 0xf38a0 - code32flat_start ) ;
*32flat.*(.data.CheckFloppySig)
. = ( 0xf38a4 - code32flat_start ) ;
*32flat.*(.data.screeninfo)
. = ( 0xf38a8 - code32flat_start ) ;
*32flat.*(.data.debuginfo)
. = ( 0xf38c0 - code32flat_start ) ;
*32flat.*(.data.BUILDINFO)
. = ( 0xf3920 - code32flat_start ) ;
*32flat.*(.data.VERSION)
. = ( 0xf3954 - code32flat_start ) ;
*32flat.*(.bss.nvme_dma_buffer)
. = ( 0xf3958 - code32flat_start ) ;
*32flat.*(.bss.crb_resp)
. = ( 0xf395c - code32flat_start ) ;
*32flat.*(.bss.crb_cmd)
. = ( 0xf3960 - code32flat_start ) ;
*32flat.*(.bss.crb_cmd_size)
. = ( 0xf3964 - code32flat_start ) ;
*32flat.*(.bss.tpm_default_to)
. = ( 0xf3974 - code32flat_start ) ;
*32flat.*(.bss.tpm_default_dur)
. = ( 0xf3980 - code32flat_start ) ;
*32flat.*(.bss.romfile_pointer_list)
. = ( 0xf3984 - code32flat_start ) ;
*32flat.*(.bss.xen_cpuid_base)
. = ( 0xf3988 - code32flat_start ) ;
*32flat.*(.bss.SMPStack)
. = ( 0xf398c - code32flat_start ) ;
*32flat.*(.bss.SMPLock)
. = ( 0xf39a0 - code32flat_start ) ;
*32flat.*(.bss.FoundAPICIDs)
. = ( 0xf39c0 - code32flat_start ) ;
*32flat.*(.bss.CountCPUs)
. = ( 0xf39c4 - code32flat_start ) ;
*32flat.*(.bss.MaxCountCPUs)
. = ( 0xf39c8 - code32flat_start ) ;
*32flat.*(.bss.smp_msr_count)
. = ( 0xf39e0 - code32flat_start ) ;
*32flat.*(.bss.smp_msr)
. = ( 0xf3b60 - code32flat_start ) ;
*32flat.*(.bss.cfg_dma_enabled)
. = ( 0xf3b64 - code32flat_start ) ;
*32flat.*(.bss.cfg_enabled)
. = ( 0xf3b68 - code32flat_start ) ;
*32flat.*(.bss.acpi_reset_val)
. = ( 0xf3b6c - code32flat_start ) ;
*32flat.*(.bss.acpi_reset_reg)
. = ( 0xf3b78 - code32flat_start ) ;
*32flat.*(.bss.RsdpAddr)
. = ( 0xf3b7c - code32flat_start ) ;
*32flat.*(.bss.tpm20_pcr_selection)
. = ( 0xf3b80 - code32flat_start ) ;
*32flat.*(.bss.tpm20_pcr_selection_size)
. = ( 0xf3b84 - code32flat_start ) ;
*32flat.*(.bss.TPM_version)
. = ( 0xf3b88 - code32flat_start ) ;
*32flat.*(.bss.BEVCount)
. = ( 0xf3ba0 - code32flat_start ) ;
*32flat.*(.bss.BEV)
. = ( 0xf3c40 - code32flat_start ) ;
*32flat.*(.bss.BootRetryTime)
. = ( 0xf3c44 - code32flat_start ) ;
*32flat.*(.bss.VgaROM)
. = ( 0xf3c48 - code32flat_start ) ;
*32flat.*(.bss.ScreenAndDebug)
. = ( 0xf3c4c - code32flat_start ) ;
*32flat.*(.bss.S3ResumeVga)
. = ( 0xf3c50 - code32flat_start ) ;
*32flat.*(.bss.EnforceChecksum)
. = ( 0xf3c54 - code32flat_start ) ;
*32flat.*(.bss.RomBase)
. = ( 0xf3c58 - code32flat_start ) ;
*32flat.*(.bss.mmconfig)
. = ( 0xf3c5c - code32flat_start ) ;
*32flat.*(.bss.PreemptCount)
. = ( 0xf3c60 - code32flat_start ) ;
*32flat.*(.bss.ThreadControl)
. = ( 0xf3c61 - code32flat_start ) ;
*32flat.*(.bss.CanInterrupt)
. = ( 0xf4480 - code32flat_start ) ;
*32flat.*(.data.varfseg../src/fw/paravirt.c.40)
. = ( 0xf4484 - code32flat_start ) ;
*32flat.*(.data.varfseg../src/fw/biostables.c.196)
. = ( 0xf4488 - code32flat_start ) ;
*32flat.*(.data.varfseg../src/fw/biostables.c.22)
. = ( 0xf448c - code32flat_start ) ;
*32flat.*(.data.varfseg../src/hw/pcidevice.c.17)
. = ( 0xf4490 - code32flat_start ) ;
*32flat.*(.data.varfseg../src/pmm.c.20)
. = ( 0xf44a0 - code32flat_start ) ;
*32flat.*(.data.varfseg../src/malloc.c.473)
. = ( 0xf44a4 - code32flat_start ) ;
*32flat.*(.data.varfseg../src/e820map.c.19)
. = ( 0xf44c0 - code32flat_start ) ;
*32flat.*(.data.varfseg../src/e820map.c.18)
. = ( 0xf4ec0 - code32flat_start ) ;
*32flat.*(.data.varfseg../src/hw/floppy.c.88)
. = ( 0xf4f1c - code32flat_start ) ;
*32flat.*(.data.varfseg../src/hw/floppy.c.55)
. = ( 0xf4f2c - code32flat_start ) ;
*32flat.*(.data.varfseg../src/hw/usb-hid.c.16)
. = ( 0xf4f30 - code32flat_start ) ;
*32flat.*(.data.varfseg../src/hw/usb-hid.c.15)
. = ( 0xf4f34 - code32flat_start ) ;
*32flat.*(.data.varfseg../src/hw/serialio.c.104)
. = ( 0xf4f36 - code32flat_start ) ;
*32flat.*(.data.varfseg../src/hw/timer.c.54)
. = ( 0xf4f38 - code32flat_start ) ;
*32flat.*(.data.varfseg../src/hw/timer.c.53)
. = ( 0xf4f3c - code32flat_start ) ;
*32flat.*(.data.varfseg../src/hw/timer.c.52)
. = ( 0xf4f40 - code32flat_start ) ;
*32flat.*(.data.varfseg../src/pcibios.c.229)
. = ( 0xf4f50 - code32flat_start ) ;
*32flat.*(.data.varfseg../src/vgahooks.c.262)
. = ( 0xf4f51 - code32flat_start ) ;
*32flat.*(.data.varfseg../src/vgahooks.c.179)
. = ( 0xf4f54 - code32flat_start ) ;
*32flat.*(.data.varfseg../src/vgahooks.c.40)
. = ( 0xf4f5c - code32flat_start ) ;
*32flat.*(.data.varfseg../src/vgahooks.c.22)
. = ( 0xf4f60 - code32flat_start ) ;
*32flat.*(.data.varfseg../src/pnpbios.c.18)
. = ( 0xf4f84 - code32flat_start ) ;
*32flat.*(.data.varfseg../src/sercon.c.52)
. = ( 0xf4f88 - code32flat_start ) ;
*32flat.*(.data.varfseg../src/cdrom.c.27)
. = ( 0xf4f8c - code32flat_start ) ;
*32flat.*(.data.varfseg../src/block.c.34)
. = ( 0xf4fa0 - code32flat_start ) ;
*32flat.*(.data.varfseg../src/block.c.33)
. = ( 0xf5060 - code32flat_start ) ;
*32flat.*(.data.varfseg../src/block.c.31)
. = ( 0xf5064 - code32flat_start ) ;
*32flat.*(.data.varfseg../src/stacks.c.696)
. = ( 0xf5068 - code32flat_start ) ;
*32flat.*(.data.varfseg../src/stacks.c.476)
. = ( 0xf5074 - code32flat_start ) ;
*32flat.*(.data.varfseg../src/stacks.c.38)
. = ( 0xf5078 - code32flat_start ) ;
*32flat.*(.data.varfseg../src/misc.c.166)
. = ( 0xf5080 - code32flat_start ) ;
*32flat.*(.data.varfseg../src/misc.c.148)
. = ( 0xf50b8 - code32flat_start ) ;
*32flat.*(.data.varfseg../src/misc.c.142)
. = ( 0xf50be - code32flat_start ) ;
*32flat.*(.data.varfseg../src/misc.c.139)
. = ( 0xf50c0 - code32flat_start ) ;
*32flat.*(.data.varfseg../src/misc.c.132)
. = ( 0xf50c8 - code32flat_start ) ;
*32flat.*(.data.varfseg../src/misc.c.18)
. = ( 0xf50e0 - code32flat_start ) ;
*32flat.*(.text.32fseg../src/stacks.c.215)
. = ( 0xf5106 - code32flat_start ) ;
*32flat.*(.text.32fseg../src/stacks.c.300)
. = ( 0xf5130 - code32flat_start ) ;
*32seg.*(.text.set_code_success)
. = ( 0xf513a - code32flat_start ) ;
*32seg.*(.text.get_global_offset)
. = ( 0xf5146 - code32flat_start ) ;
*32seg.*(.text.qemu_debug_putc)
. = ( 0xf515e - code32flat_start ) ;
*32seg.*(.text.putsinglehex.constprop.0)
. = ( 0xf5178 - code32flat_start ) ;
*32seg.*(.text.puthex.constprop.0)
. = ( 0xf5212 - code32flat_start ) ;
*32seg.*(.text.pci_next)
. = ( 0xf5286 - code32flat_start ) ;
*32seg.*(.text.putuint.constprop.0)
. = ( 0xf52c5 - code32flat_start ) ;
*32seg.*(.text.__dprintf)
. = ( 0xf5549 - code32flat_start ) ;
*32seg.*(.text.dump_regs)
. = ( 0xf55b1 - code32flat_start ) ;
*32seg.*(.text.__set_code_invalid)
. = ( 0xf55df - code32flat_start ) ;
*32seg.*(.text.handle_pcibios)
. = ( 0xf5953 - code32flat_start ) ;
*32seg.*(.text.handle_apm)
. = ( 0xf5ae0 - code32flat_start ) ;
_rodata32seg = . ;
*32seg.*(.rodata)
. = ( 0xf5bb0 - code32flat_start ) ;
*32seg.*(.rodata.__func__.0)
. = ( 0xf5bc0 - code32flat_start ) ;
*32seg.*(.rodata.__func__.1)
. = ( 0xf5bd0 - code32flat_start ) ;
*32seg.*(.rodata.__func__.2)
. = ( 0xf5be0 - code32flat_start ) ;
*32seg.*(.rodata.__func__.3)
. = ( 0xf5bf0 - code32flat_start ) ;
*32seg.*(.rodata.__func__.4)
. = ( 0xf5c00 - code32flat_start ) ;
*16.*(.text.set_a20)
. = ( 0xf5c20 - code32flat_start ) ;
*16.*(.text.pic_eoi2)
. = ( 0xf5c28 - code32flat_start ) ;
*16.*(.text.call32_prep)
. = ( 0xf5cc1 - code32flat_start ) ;
*16.*(.text.need_hop_back)
. = ( 0xf5ce6 - code32flat_start ) ;
*16.*(.text.enqueue_key)
. = ( 0xf5d3f - code32flat_start ) ;
*16.*(.text.kbd_set_flag)
. = ( 0xf5d9c - code32flat_start ) ;
*16.*(.text.cursor_pos_row)
. = ( 0xf5dae - code32flat_start ) ;
*16.*(.text.shiftbuf)
. = ( 0xf5df4 - code32flat_start ) ;
*16.*(.text.irqtimer_check)
. = ( 0xf5e2d - code32flat_start ) ;
*16.*(.text.qemu_debug_putc)
. = ( 0xf5e39 - code32flat_start ) ;
*16.*(.text.ehci_reset_pipe)
. = ( 0xf5e7c - code32flat_start ) ;
*16.*(.text.lba2chs)
. = ( 0xf5ec3 - code32flat_start ) ;
*16.*(.text.getLCHS)
. = ( 0xf5f6d - code32flat_start ) ;
*16.*(.text.clear_usertimer)
. = ( 0xf5fae - code32flat_start ) ;
*16.*(.text.putsinglehex.constprop.0)
. = ( 0xf5fcf - code32flat_start ) ;
*16.*(.text.puthex.constprop.0)
. = ( 0xf609b - code32flat_start ) ;
*16.*(.text.call32_post)
. = ( 0xf613e - code32flat_start ) ;
*16.*(.text.default_process_op.isra.0)
. = ( 0xf615e - code32flat_start ) ;
*16.*(.text.memset.isra.0)
. = ( 0xf616d - code32flat_start ) ;
*16.*(.text.scsi_fill_cmd)
. = ( 0xf61db - code32flat_start ) ;
*16.*(.text.floppy_dor_mask)
. = ( 0xf61fe - code32flat_start ) ;
*16.*(.text.putuint.constprop.0)
. = ( 0xf6255 - code32flat_start ) ;
*16.*(.text.__dprintf)
. = ( 0xf6269 - code32flat_start ) ;
*16.*(.text.dump_regs)
. = ( 0xf6300 - code32flat_start ) ;
*16.*(.text.__debug_enter)
. = ( 0xf6322 - code32flat_start ) ;
*16.*(.text.__warn_invalid)
. = ( 0xf6348 - code32flat_start ) ;
*16.*(.text.__set_invalid)
. = ( 0xf635c - code32flat_start ) ;
*16.*(.text.getComAddr)
. = ( 0xf63ac - code32flat_start ) ;
*16.*(.text.getLptAddr)
. = ( 0xf63fd - code32flat_start ) ;
*16.*(.text.__set_code_invalid)
. = ( 0xf6423 - code32flat_start ) ;
*16.*(.text.__disk_ret)
. = ( 0xf6450 - code32flat_start ) ;
*16.*(.text.disk_1308)
. = ( 0xf6588 - code32flat_start ) ;
*16.*(.text.__warn_unimplemented)
. = ( 0xf65ae - code32flat_start ) ;
*16.*(.text.__set_code_unimplemented)
. = ( 0xf65d4 - code32flat_start ) ;
*16.*(.text.__disk_stub)
. = ( 0xf6609 - code32flat_start ) ;
*16.*(.text.__warn_timeout)
. = ( 0xf661f - code32flat_start ) ;
*16.*(.text.floppy_disable_controller)
. = ( 0xf6639 - code32flat_start ) ;
*16.*(.text.set_usertimer)
. = ( 0xf66b2 - code32flat_start ) ;
*16.*(.text.timer_read)
. = ( 0xf674f - code32flat_start ) ;
*16.*(.text.timer_calc)
. = ( 0xf676b - code32flat_start ) ;
*16.*(.text.timer_calc_usec)
. = ( 0xf679b - code32flat_start ) ;
*16.*(.text.udelay)
. = ( 0xf67bc - code32flat_start ) ;
*16.*(.text.i8042_wait_write)
. = ( 0xf680d - code32flat_start ) ;
*16.*(.text.i8042_command)
. = ( 0xf6886 - code32flat_start ) ;
*16.*(.text.sercon_lazy_lf)
. = ( 0xf68d6 - code32flat_start ) ;
*16.*(.text.fill_generic_edd)
. = ( 0xf6c36 - code32flat_start ) ;
*16.*(.text.__stack_hop_back.isra.0)
. = ( 0xf6c92 - code32flat_start ) ;
*16.*(.text.handle_12)
. = ( 0xf6cb7 - code32flat_start ) ;
*16.*(.text.handle_11)
. = ( 0xf6cdc - code32flat_start ) ;
*16.*(.text.handle_05)
. = ( 0xf6ce5 - code32flat_start ) ;
*16.*(.text.handle_02)
. = ( 0xf6d0a - code32flat_start ) ;
*16.*(.text.call16_helper)
. = ( 0xf6d4a - code32flat_start ) ;
*16.*(.text.__call32)
. = ( 0xf6e0e - code32flat_start ) ;
*16.*(.text.__call32_params.constprop.0)
. = ( 0xf6e55 - code32flat_start ) ;
*16.*(.text.usb_poll_intr)
. = ( 0xf71b8 - code32flat_start ) ;
*16.*(.text._farcall16)
. = ( 0xf7203 - code32flat_start ) ;
*16.*(.text.__call16_int)
. = ( 0xf7216 - code32flat_start ) ;
*16.*(.text.handle_75)
. = ( 0xf7282 - code32flat_start ) ;
*16.*(.text.process_key)
. = ( 0xf7664 - code32flat_start ) ;
*16.*(.text.prockeys)
. = ( 0xf76db - code32flat_start ) ;
*16.*(.text.procmodkey)
. = ( 0xf772c - code32flat_start ) ;
*16.*(.text.procscankey)
. = ( 0xf7752 - code32flat_start ) ;
*16.*(.text.ramdisk_copy)
. = ( 0xf78ef - code32flat_start ) ;
*16.*(.text.disk_1346.isra.0)
. = ( 0xf79a9 - code32flat_start ) ;
*16.*(.text.check_irqs)
. = ( 0xf79cb - code32flat_start ) ;
*16.*(.text.sercon_term_clear_screen)
. = ( 0xf79f8 - code32flat_start ) ;
*16.*(.text.sercon_print_utf8)
. = ( 0xf7a61 - code32flat_start ) ;
*16.*(.text.sercon_term_cursor_goto)
. = ( 0xf7b00 - code32flat_start ) ;
*16.*(.text.sercon_set_attr)
. = ( 0xf7bf5 - code32flat_start ) ;
*16.*(.text.sercon_lazy_putchar)
. = ( 0xf7caa - code32flat_start ) ;
*16.*(.text.usleep)
. = ( 0xf7cb3 - code32flat_start ) ;
*16.*(.text.lsi_scsi_process_op)
. = ( 0xf7ed0 - code32flat_start ) ;
*16.*(.text.mpt_scsi_process_op)
. = ( 0xf80ae - code32flat_start ) ;
*16.*(.text.rtc_updating)
. = ( 0xf80fb - code32flat_start ) ;
*16.*(.text.ps2_recvbyte)
. = ( 0xf81e9 - code32flat_start ) ;
*16.*(.text.ps2_sendbyte)
. = ( 0xf829a - code32flat_start ) ;
*16.*(.text.ps2_command)
. = ( 0xf8544 - code32flat_start ) ;
*16.*(.text.set_leds)
. = ( 0xf85aa - code32flat_start ) ;
*16.*(.text.mouse_command)
. = ( 0xf8678 - code32flat_start ) ;
*16.*(.text.mouse_15c201)
. = ( 0xf86bf - code32flat_start ) ;
*16.*(.text.handle_160a)
. = ( 0xf8708 - code32flat_start ) ;
*16.*(.text.uhci_waittick)
. = ( 0xf8764 - code32flat_start ) ;
*16.*(.text.uas_process_op)
. = ( 0xf8986 - code32flat_start ) ;
*16.*(.text.usb_process_op)
. = ( 0xf8b0f - code32flat_start ) ;
*16.*(.text.floppy_wait_irq)
. = ( 0xf8b8c - code32flat_start ) ;
*16.*(.text.floppy_enable_controller)
. = ( 0xf8bfd - code32flat_start ) ;
*16.*(.text.floppy_drive_pio)
. = ( 0xf8caf - code32flat_start ) ;
*16.*(.text.floppy_dma_cmd)
. = ( 0xf8de9 - code32flat_start ) ;
*16.*(.text.floppy_prep)
. = ( 0xf9157 - code32flat_start ) ;
*16.*(.text.floppy_read)
. = ( 0xf9210 - code32flat_start ) ;
*16.*(.text.floppy_write)
. = ( 0xf92c9 - code32flat_start ) ;
*16.*(.text.floppy_format)
. = ( 0xf9351 - code32flat_start ) ;
*16.*(.text.await_ide.constprop.0)
. = ( 0xf93c2 - code32flat_start ) ;
*16.*(.text.await_not_bsy)
. = ( 0xf93d2 - code32flat_start ) ;
*16.*(.text.ndelay_await_not_bsy)
. = ( 0xf9422 - code32flat_start ) ;
*16.*(.text.ata_wait_data)
. = ( 0xf948b - code32flat_start ) ;
*16.*(.text.send_cmd)
. = ( 0xf95b7 - code32flat_start ) ;
*16.*(.text.ata_pio_transfer)
. = ( 0xf970e - code32flat_start ) ;
*16.*(.text.ata_readwrite)
. = ( 0xf98a5 - code32flat_start ) ;
*16.*(.text.ata_atapi_process_op)
. = ( 0xf9a59 - code32flat_start ) ;
*16.*(.text.process_op)
. = ( 0xf9e1d - code32flat_start ) ;
*16.*(.text.cdemu_read)
. = ( 0xfa07e - code32flat_start ) ;
*16.*(.text.disk_1300)
. = ( 0xfa0c0 - code32flat_start ) ;
*16.*(.text.basic_access)
. = ( 0xfa232 - code32flat_start ) ;
*16.*(.text.disk_1305)
. = ( 0xfa35f - code32flat_start ) ;
*16.*(.text.extended_access)
. = ( 0xfa45f - code32flat_start ) ;
*16.*(.text.disk_13)
. = ( 0xfa807 - code32flat_start ) ;
*16.*(.text.handle_legacy_disk)
. = ( 0xfa8a5 - code32flat_start ) ;
*16.*(.text.wait_irq)
. = ( 0xfa8c5 - code32flat_start ) ;
*16.*(.text.dequeue_key)
. = ( 0xfa99e - code32flat_start ) ;
*16.*(.text.handle_1553)
. = ( 0xfab0e - code32flat_start ) ;
*16.*(.text.handle_40)
. = ( 0xfab31 - code32flat_start ) ;
*16.*(.text.handle_13)
. = ( 0xfabe5 - code32flat_start ) ;
*16.*(.text.handle_76)
. = ( 0xfabf6 - code32flat_start ) ;
*16.*(.text.invoke_mouse_handler)
. = ( 0xfac68 - code32flat_start ) ;
*16.*(.text.process_mouse)
. = ( 0xfacbf - code32flat_start ) ;
*16.*(.text.handle_16)
. = ( 0xfadd6 - code32flat_start ) ;
*16.*(.text.handle_1589)
. = ( 0xfae70 - code32flat_start ) ;
*16.*(.text.handle_15)
. = ( 0xfb6fd - code32flat_start ) ;
*16.*(.text.handle_14)
. = ( 0xfb8f0 - code32flat_start ) ;
*16.*(.text.handle_17)
. = ( 0xfba5a - code32flat_start ) ;
*16.*(.text.handle_sercon)
. = ( 0xfbe5e - code32flat_start ) ;
*16.*(.text.handle_08)
. = ( 0xfc279 - code32flat_start ) ;
*16.*(.text.handle_resume)
. = ( 0xfc34b - code32flat_start ) ;
*16.*(.text.handle_pnp)
. = ( 0xfc394 - code32flat_start ) ;
*16.*(.text.handle_pcibios)
. = ( 0xfc72c - code32flat_start ) ;
*16.*(.text.handle_hwpic1)
. = ( 0xfc74e - code32flat_start ) ;
*16.*(.text.handle_hwpic2)
. = ( 0xfc76d - code32flat_start ) ;
*16.*(.text.handle_09)
. = ( 0xfc7b6 - code32flat_start ) ;
*16.*(.text.handle_0e)
. = ( 0xfc7d0 - code32flat_start ) ;
*16.*(.text.asm.transition32)
. = ( 0xfc81e - code32flat_start ) ;
*16.*(.text.asm.transition16)
. = ( 0xfc86c - code32flat_start ) ;
*16.*(.text.asm.__farcall16)
. = ( 0xfc8f9 - code32flat_start ) ;
*16.*(.text.asm.irq_trampoline_0x02)
. = ( 0xfc8fc - code32flat_start ) ;
*16.*(.text.asm.irq_trampoline_0x05)
. = ( 0xfc8ff - code32flat_start ) ;
*16.*(.text.asm.entry_smi)
. = ( 0xfc914 - code32flat_start ) ;
*16.*(.text.asm.entry_smp)
. = ( 0xfc944 - code32flat_start ) ;
*16.*(.text.asm.entry_resume)
. = ( 0xfc959 - code32flat_start ) ;
*16.*(.text.asm.entry_pmm)
. = ( 0xfc9b7 - code32flat_start ) ;
*16.*(.text.asm.entry_pnp_real)
. = ( 0xfc9ff - code32flat_start ) ;
*16.*(.text.asm.entry_apm16)
. = ( 0xfca40 - code32flat_start ) ;
*16.*(.text.asm.entry_apm32)
. = ( 0xfca72 - code32flat_start ) ;
*16.*(.text.asm.entry_pcibios32)
. = ( 0xfcaa0 - code32flat_start ) ;
*16.*(.text.asm.entry_pcibios16)
. = ( 0xfcada - code32flat_start ) ;
*16.*(.text.asm.entry_1589)
. = ( 0xfcb14 - code32flat_start ) ;
*16.*(.text.asm.entry_bios32)
. = ( 0xfcb33 - code32flat_start ) ;
*16.*(.text.asm.entry_sercon)
. = ( 0xfcb7a - code32flat_start ) ;
*16.*(.text.asm.irqentry_extrastack)
. = ( 0xfcc07 - code32flat_start ) ;
*16.*(.text.asm.irqentry_arg_extrastack)
. = ( 0xfcca9 - code32flat_start ) ;
*16.*(.text.asm.entry_13)
. = ( 0xfccb2 - code32flat_start ) ;
*16.*(.text.asm.entry_76)
. = ( 0xfccbb - code32flat_start ) ;
*16.*(.text.asm.entry_70)
. = ( 0xfccc4 - code32flat_start ) ;
*16.*(.text.asm.entry_74)
. = ( 0xfcccd - code32flat_start ) ;
*16.*(.text.asm.entry_75)
. = ( 0xfccd6 - code32flat_start ) ;
*16.*(.text.asm.entry_hwpic1)
. = ( 0xfccdf - code32flat_start ) ;
*16.*(.text.asm.entry_hwpic2)
. = ( 0xfcce8 - code32flat_start ) ;
*16.*(.text.asm.entry_19)
. = ( 0xfccfb - code32flat_start ) ;
*16.*(.text.asm.entry_18)
. = ( 0xfcd0e - code32flat_start ) ;
_rodata16 = . ;
*16.*(.rodata)
. = ( 0xfd4d4 - code32flat_start ) ;
*16.*(.rodata.__func__.0)
. = ( 0xfd4e8 - code32flat_start ) ;
*16.*(.rodata.__func__.2)
. = ( 0xfd4f4 - code32flat_start ) ;
*16.*(.rodata.__func__.3)
. = ( 0xfd500 - code32flat_start ) ;
*16.*(.rodata.__func__.4)
. = ( 0xfd50c - code32flat_start ) ;
*16.*(.rodata.__func__.5)
. = ( 0xfd51c - code32flat_start ) ;
*16.*(.rodata.__func__.9)
. = ( 0xfd52c - code32flat_start ) ;
*16.*(.rodata.__func__.10)
. = ( 0xfd53c - code32flat_start ) ;
*16.*(.rodata.__func__.20)
. = ( 0xfd548 - code32flat_start ) ;
*16.*(.rodata.__func__.21)
. = ( 0xfd550 - code32flat_start ) ;
*16.*(.rodata.__func__.24)
. = ( 0xfd560 - code32flat_start ) ;
*16.*(.rodata.__func__.29)
. = ( 0xfd570 - code32flat_start ) ;
*16.*(.rodata.__func__.30)
. = ( 0xfd584 - code32flat_start ) ;
*16.*(.rodata.__func__.31)
. = ( 0xfd594 - code32flat_start ) ;
*16.*(.rodata.__func__.32)
. = ( 0xfd5a4 - code32flat_start ) ;
*16.*(.rodata.__func__.33)
. = ( 0xfd5b4 - code32flat_start ) ;
*16.*(.rodata.__func__.34)
. = ( 0xfd5c4 - code32flat_start ) ;
*16.*(.rodata.__func__.35)
. = ( 0xfd5d4 - code32flat_start ) ;
*16.*(.rodata.__func__.37)
. = ( 0xfd5e4 - code32flat_start ) ;
*16.*(.rodata.__func__.38)
. = ( 0xfd5f4 - code32flat_start ) ;
*16.*(.rodata.__func__.39)
. = ( 0xfd600 - code32flat_start ) ;
*16.*(.rodata.__func__.40)
. = ( 0xfd610 - code32flat_start ) ;
*16.*(.rodata.__func__.41)
. = ( 0xfd620 - code32flat_start ) ;
*16.*(.rodata.__func__.42)
. = ( 0xfd62c - code32flat_start ) ;
*16.*(.rodata.__func__.43)
. = ( 0xfd638 - code32flat_start ) ;
*16.*(.rodata.__func__.44)
. = ( 0xfd644 - code32flat_start ) ;
*16.*(.rodata.__func__.45)
. = ( 0xfd650 - code32flat_start ) ;
*16.*(.rodata.__func__.46)
. = ( 0xfd65c - code32flat_start ) ;
*16.*(.rodata.__func__.47)
. = ( 0xfd668 - code32flat_start ) ;
*16.*(.rodata.__func__.48)
. = ( 0xfd674 - code32flat_start ) ;
*16.*(.rodata.__func__.49)
. = ( 0xfd680 - code32flat_start ) ;
*16.*(.rodata.__func__.50)
. = ( 0xfd68c - code32flat_start ) ;
*16.*(.rodata.__func__.51)
. = ( 0xfd698 - code32flat_start ) ;
*16.*(.rodata.__func__.52)
. = ( 0xfd6a4 - code32flat_start ) ;
*16.*(.rodata.__func__.53)
. = ( 0xfd6b0 - code32flat_start ) ;
*16.*(.rodata.__func__.54)
. = ( 0xfd6bc - code32flat_start ) ;
*16.*(.rodata.__func__.55)
. = ( 0xfd6c8 - code32flat_start ) ;
*16.*(.rodata.__func__.56)
. = ( 0xfd6d8 - code32flat_start ) ;
*16.*(.rodata.__func__.57)
. = ( 0xfd6e8 - code32flat_start ) ;
*16.*(.rodata.__func__.58)
. = ( 0xfd6f8 - code32flat_start ) ;
*16.*(.rodata.__func__.59)
. = ( 0xfd704 - code32flat_start ) ;
*16.*(.rodata.__func__.60)
. = ( 0xfd714 - code32flat_start ) ;
*16.*(.rodata.__func__.61)
. = ( 0xfd724 - code32flat_start ) ;
*16.*(.rodata.__func__.62)
. = ( 0xfd734 - code32flat_start ) ;
*16.*(.rodata.__func__.63)
. = ( 0xfd744 - code32flat_start ) ;
*16.*(.rodata.__func__.64)
. = ( 0xfd754 - code32flat_start ) ;
*16.*(.rodata.__func__.65)
. = ( 0xfd764 - code32flat_start ) ;
*16.*(.rodata.__func__.66)
. = ( 0xfd774 - code32flat_start ) ;
*16.*(.rodata.__func__.67)
. = ( 0xfd784 - code32flat_start ) ;
*16.*(.rodata.__func__.68)
. = ( 0xfd794 - code32flat_start ) ;
*16.*(.rodata.__func__.69)
. = ( 0xfd7a4 - code32flat_start ) ;
*16.*(.rodata.__func__.70)
. = ( 0xfd7b4 - code32flat_start ) ;
*16.*(.rodata.__func__.71)
. = ( 0xfd7c4 - code32flat_start ) ;
*16.*(.rodata.__func__.72)
. = ( 0xfd7d4 - code32flat_start ) ;
*16.*(.rodata.__func__.73)
. = ( 0xfd7e0 - code32flat_start ) ;
*16.*(.rodata.__func__.74)
. = ( 0xfd7ec - code32flat_start ) ;
*16.*(.rodata.__func__.75)
. = ( 0xfd7f8 - code32flat_start ) ;
*16.*(.rodata.__func__.76)
. = ( 0xfd804 - code32flat_start ) ;
*16.*(.rodata.__func__.77)
. = ( 0xfd810 - code32flat_start ) ;
*16.*(.rodata.__func__.78)
. = ( 0xfd81c - code32flat_start ) ;
*16.*(.rodata.__func__.79)
. = ( 0xfd828 - code32flat_start ) ;
*16.*(.rodata.__func__.80)
. = ( 0xfd834 - code32flat_start ) ;
*16.*(.rodata.__func__.81)
. = ( 0xfd840 - code32flat_start ) ;
*16.*(.rodata.__func__.82)
. = ( 0xfd84c - code32flat_start ) ;
*16.*(.rodata.__func__.83)
. = ( 0xfd858 - code32flat_start ) ;
*16.*(.rodata.__func__.84)
. = ( 0xfd864 - code32flat_start ) ;
*16.*(.rodata.__func__.85)
. = ( 0xfd870 - code32flat_start ) ;
*16.*(.rodata.__func__.86)
. = ( 0xfd87c - code32flat_start ) ;
*16.*(.rodata.__func__.87)
. = ( 0xfd88c - code32flat_start ) ;
*16.*(.rodata.__func__.88)
. = ( 0xfd898 - code32flat_start ) ;
*16.*(.rodata.__func__.89)
. = ( 0xfd8a4 - code32flat_start ) ;
*16.*(.rodata.__func__.90)
. = ( 0xfd8b0 - code32flat_start ) ;
*16.*(.rodata.__func__.91)
. = ( 0xfd8bc - code32flat_start ) ;
*16.*(.rodata.__func__.92)
. = ( 0xfd8c8 - code32flat_start ) ;
*16.*(.rodata.__func__.93)
. = ( 0xfd8d4 - code32flat_start ) ;
*16.*(.rodata.__func__.94)
. = ( 0xfd8e0 - code32flat_start ) ;
*16.*(.rodata.__func__.95)
. = ( 0xfd8ec - code32flat_start ) ;
*16.*(.rodata.__func__.96)
. = ( 0xfd8f8 - code32flat_start ) ;
*16.*(.rodata.__func__.97)
. = ( 0xfd904 - code32flat_start ) ;
*16.*(.rodata.__func__.98)
. = ( 0xfd910 - code32flat_start ) ;
*16.*(.rodata.__func__.99)
. = ( 0xfd920 - code32flat_start ) ;
*16.*(.rodata.__func__.100)
. = ( 0xfd92c - code32flat_start ) ;
*16.*(.rodata.__func__.101)
. = ( 0xfd938 - code32flat_start ) ;
*16.*(.rodata.__func__.102)
. = ( 0xfd94c - code32flat_start ) ;
*16.*(.rodata.__func__.103)
. = ( 0xfd958 - code32flat_start ) ;
*16.*(.rodata.__func__.106)
. = ( 0xfd964 - code32flat_start ) ;
*16.*(.rodata.__func__.107)
. = ( 0xfd970 - code32flat_start ) ;
*16.*(.rodata.__func__.108)
. = ( 0xfd97c - code32flat_start ) ;
*16.*(.rodata.__func__.109)
. = ( 0xfd988 - code32flat_start ) ;
*16.*(.rodata.__func__.110)
. = ( 0xfd994 - code32flat_start ) ;
*16.*(.data16../src/hw/usb-hid.c.187)
. = ( 0xfd9c0 - code32flat_start ) ;
*16.*(.data16../src/hw/usb-hid.c.170)
. = ( 0xfdaa0 - code32flat_start ) ;
*16.*(.data16../src/cp437.c.11)
. = ( 0xfdca0 - code32flat_start ) ;
*16.*(.data16../src/sercon.c.554)
. = ( 0xfdd50 - code32flat_start ) ;
*16.*(.data16../src/sercon.c.70)
. = ( 0xfdd58 - code32flat_start ) ;
*16.*(.data16../src/kbd.c.374)
. = ( 0xfdd60 - code32flat_start ) ;
*16.*(.data16../src/kbd.c.371)
. = ( 0xfdd80 - code32flat_start ) ;
*16.*(.data16../src/kbd.c.279)
. = ( 0xfe048 - code32flat_start ) ;
*16.*(.data16../src/mouse.c.106)
. = ( 0xfe05b - code32flat_start ) ;
*16.*(.fixedaddr.0xe05b)
. = ( 0xfe079 - code32flat_start ) ;
*16.*(.text.fill_edd)
. = ( 0xfe2ad - code32flat_start ) ;
*16.*(.text.panic.constprop.0)
. = ( 0xfe2c3 - code32flat_start ) ;
*16.*(.fixedaddr.0xe2c3)
. = ( 0xfe2e8 - code32flat_start ) ;
*16.*(.text.sercon_lazy_flush)
. = ( 0xfe3f8 - code32flat_start ) ;
*16.*(.text.asm.irq_trampoline_0x19)
. = ( 0xfe3fb - code32flat_start ) ;
*16.*(.text.asm.irq_trampoline_0x18)
. = ( 0xfe3fe - code32flat_start ) ;
*16.*(.fixedaddr.0xe3fe)
. = ( 0xfe401 - code32flat_start ) ;
*32flat.*(.fixedaddr.0xe401)
. = ( 0xfe411 - code32flat_start ) ;
*16.*(.text.bvprintf.constprop.0)
. = ( 0xfe6ee - code32flat_start ) ;
*16.*(.text.asm.irq_trampoline_0x10)
. = ( 0xfe6f2 - code32flat_start ) ;
*16.*(.fixedaddr.0xe6f2)
. = ( 0xfe6f5 - code32flat_start ) ;
*32flat.*(.fixedaddr.0xe6f5)
. = ( 0xfe6ff - code32flat_start ) ;
*16.*(.text.sercon_cursor_pos_set)
. = ( 0xfe729 - code32flat_start ) ;
*32flat.*(.fixedaddr.0xe729)
. = ( 0xfe739 - code32flat_start ) ;
*16.*(.fixedaddr.0xe739)
. = ( 0xfe742 - code32flat_start ) ;
*16.*(.text.handle_70)
. = ( 0xfe829 - code32flat_start ) ;
*16.*(.text.asm.irq_trampoline_0x1b)
. = ( 0xfe82e - code32flat_start ) ;
*16.*(.fixedaddr.0xe82e)
. = ( 0xfe837 - code32flat_start ) ;
*16.*(.text.floppy_pio)
. = ( 0xfe980 - code32flat_start ) ;
*16.*(.text.asm.irq_trampoline_0x16)
. = ( 0xfe983 - code32flat_start ) ;
*16.*(.text.asm.irq_trampoline_0x15)
. = ( 0xfe987 - code32flat_start ) ;
*16.*(.fixedaddr.0xe987)
. = ( 0xfe990 - code32flat_start ) ;
*16.*(.text.megasas_process_op)
. = ( 0xfec4d - code32flat_start ) ;
*16.*(.text.set_code_success)
. = ( 0xfec59 - code32flat_start ) ;
*16.*(.fixedaddr.0xec59)
. = ( 0xfec62 - code32flat_start ) ;
*16.*(.text.handle_1a)
. = ( 0xfef2f - code32flat_start ) ;
*16.*(.text.__disk_ret_unimplemented)
. = ( 0xfef57 - code32flat_start ) ;
*16.*(.fixedaddr.0xef57)
. = ( 0xfef60 - code32flat_start ) ;
*16.*(.text.disk_1315)
. = ( 0xfefc7 - code32flat_start ) ;
*32flat.*(.fixedaddr.0xefc7)
. = ( 0xfefd2 - code32flat_start ) ;
*16.*(.fixedaddr.0xefd2)
. = ( 0xfefdb - code32flat_start ) ;
*16.*(.text.sercon_putchar)
. = ( 0xff045 - code32flat_start ) ;
*16.*(.fixedaddr.0xf045)
. = ( 0xff046 - code32flat_start ) ;
*16.*(.text.timer_sleep)
. = ( 0xff065 - code32flat_start ) ;
*16.*(.fixedaddr.0xf065)
. = ( 0xff066 - code32flat_start ) ;
*16.*(.text.handle_74)
. = ( 0xff0a0 - code32flat_start ) ;
*16.*(.text.asm.irq_trampoline_0x1c)
. = ( 0xff0a4 - code32flat_start ) ;
*32flat.*(.fixedaddr.0xf0a4)
. = ( 0xff0fc - code32flat_start ) ;
*16.*(.text.uhci_send_pipe.constprop.0)
. = ( 0xff517 - code32flat_start ) ;
*16.*(.text.ehci_send_pipe.constprop.0)
. = ( 0xff825 - code32flat_start ) ;
*16.*(.text.timer_check)
. = ( 0xff841 - code32flat_start ) ;
*16.*(.fixedaddr.0xf841)
. = ( 0xff84a - code32flat_start ) ;
*16.*(.text.handle_apm)
. = ( 0xff84d - code32flat_start ) ;
*16.*(.fixedaddr.0xf84d)
. = ( 0xff856 - code32flat_start ) ;
*16.*(.text.asm.irq_trampoline_0x4a)
. = ( 0xff859 - code32flat_start ) ;
*16.*(.fixedaddr.0xf859)
. = ( 0xff869 - code32flat_start ) ;
*16.*(.text.esp_scsi_process_op)
. = ( 0xffa6b - code32flat_start ) ;
*16.*(.text.asm.irq_trampoline_0x13)
. = ( 0xffa6e - code32flat_start ) ;
*32flat.*(.fixedaddr.0xfa6e)
. = ( 0xffe6e - code32flat_start ) ;
*16.*(.fixedaddr.0xfe6e)
. = ( 0xffe7e - code32flat_start ) ;
*16.*(.text.rtc_setup)
. = ( 0xffea5 - code32flat_start ) ;
*16.*(.fixedaddr.0xfea5)
. = ( 0xffeae - code32flat_start ) ;
*16.*(.text.disk_1310)
. = ( 0xffef3 - code32flat_start ) ;
*32flat.*(.fixedaddr.0xfef3)
. = ( 0xfff00 - code32flat_start ) ;
*16.*(.text.usb_send_bulk)
. = ( 0xfff53 - code32flat_start ) ;
*16.*(.fixedaddr.0xff53)
. = ( 0xfff54 - code32flat_start ) ;
*16.*(.fixedaddr.0xff54)
. = ( 0xfff5d - code32flat_start ) ;
*16.*(.text.pci_next)
. = ( 0xffff0 - code32flat_start ) ;
*16.*(.fixedaddr.0xfff0)
. = ( 0xffff5 - code32flat_start ) ;
*32flat.*(.fixedaddr.0xfff5)
. = ( 0xffffe - code32flat_start ) ;
*32flat.*(.fixedaddr.0xfffe)
. = ( 0xfffff - code32flat_start ) ;
*32flat.*(.fixedaddr.0xffff)

        code32flat_end = ABSOLUTE(.) ;
    } :text


        /* Discard regular data sections to force a link error if
         * code attempts to access data not marked with VAR16 (or other
         * appropriate macro)
         */
        /DISCARD/ : {
                *(.text*) *(.data*) *(.bss*) *(.rodata*)
                *(COMMON) *(.discard*) *(.eh_frame) *(.note*)
                }
}

ENTRY(reset_vector)
PHDRS
{
        text PT_LOAD AT ( code32flat_start ) ;
}
